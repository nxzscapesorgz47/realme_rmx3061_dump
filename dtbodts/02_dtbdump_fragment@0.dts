/dts-v1/;

/ {

	__fixups__ {
		accdet = "/fragment@13:target:0", "/fragment@45:target:0";
		audgpio = "/fragment@18:target:0";
		auxadc = "/fragment@25:target:0";
		bat_gm30 = "/fragment@15:target:0";
		charger = "/fragment@23:target:0";
		chosen = "/fragment@0:target:0";
		chr_stat = "/fragment@46:target:0";
		consys = "/fragment@12:target:0";
		dsi_te = "/fragment@49:target:0";
		goodix_fp = "/fragment@4:target:0";
		gpio = "/fragment@38:target:0";
		gpio_usage_mapping = "/fragment@37:target:0";
		i2c0 = "/fragment@27:target:0";
		i2c1 = "/fragment@28:target:0";
		i2c2 = "/fragment@29:target:0";
		i2c3 = "/fragment@30:target:0";
		i2c4 = "/fragment@31:target:0";
		i2c5 = "/fragment@24:target:0", "/fragment@32:target:0";
		i2c6 = "/fragment@33:target:0";
		i2c7 = "/fragment@34:target:0";
		i2c8 = "/fragment@35:target:0";
		i2c9 = "/fragment@36:target:0";
		irq_nfc = "/fragment@43:target:0";
		irtx_pwm = "/fragment@16:target:0";
		kd_camera_hw1 = "/fragment@60:target:0", "/fragment@64:target:0";
		keypad = "/fragment@20:target:0", "/fragment@62:target:0";
		main_pmic = "/fragment@51:target:0";
		md1_sim1_hot_plug_eint = "/fragment@52:target:0";
		md1_sim2_hot_plug_eint = "/fragment@53:target:0";
		mrdump_ext_rst = "/fragment@41:target:0";
		msdc1_ins = "/fragment@40:target:0";
		mt6370_pmu = "/fragment@22:target:0";
		mt_pmic_vcama_ldo_reg = "/fragment@54:target:0", "/fragment@60/__overlay__:vcama-supply:0", "/fragment@64/__overlay__:cam0_vcama-supply:0", "/fragment@64/__overlay__:cam1_vcama-supply:0", "/fragment@64/__overlay__:cam2_vcama-supply:0";
		mt_pmic_vcamd_ldo_reg = "/fragment@57:target:0", "/fragment@60/__overlay__:vcamd_main2-supply:0", "/fragment@64/__overlay__:cam0_vcamd-supply:0", "/fragment@64/__overlay__:cam1_vcamd-supply:0", "/fragment@64/__overlay__:cam2_vcamd-supply:0";
		mt_pmic_vcamio_ldo_reg = "/fragment@58:target:0", "/fragment@60/__overlay__:vcamio-supply:0", "/fragment@60/__overlay__:vcamio_sub-supply:0", "/fragment@60/__overlay__:vcamio_main2-supply:0", "/fragment@64/__overlay__:cam0_vcamio-supply:0", "/fragment@64/__overlay__:cam1_vcamio-supply:0", "/fragment@64/__overlay__:cam2_vcamio-supply:0", "/fragment@64/__overlay__:cam3_vcamio-supply:0";
		mt_pmic_vldo28_ldo_reg = "/fragment@59:target:0", "/fragment@60/__overlay__:vcamaf-supply:0", "/fragment@60/__overlay__:vcamaf_sub-supply:0", "/fragment@60/__overlay__:vcamaf_main2-supply:0", "/fragment@61/__overlay__:vtouch-supply:0", "/fragment@64/__overlay__:cam0_vcamaf-supply:0";
		mt_pmic_vsim1_ldo_reg = "/fragment@55:target:0";
		mt_pmic_vsim2_ldo_reg = "/fragment@56:target:0";
		mtkfb = "/fragment@10:target:0";
		odm = "/fragment@1:target:0";
		oppo_fp_common = "/fragment@8:target:0";
		otg_iddig = "/fragment@48:target:0";
		pio = "/fragment@1/__overlay__/kpd_volume_up:interrupt-parent:0", "/fragment@1/__overlay__/kpd_volume_down:interrupt-parent:0", "/fragment@1/__overlay__/oppo_devinfo:sub_board-gpio:0", "/fragment@1/__overlay__/oppo_devinfo:sdcard-gpio:0", "/fragment@3:target:0", "/fragment@4/__overlay__:interrupt-parent:0", "/fragment@4/__overlay__:goodix,gpio_irq:0", "/fragment@4/__overlay__:goodix,gpio_reset:0", "/fragment@4/__overlay__:goodix,vdd-en:0", "/fragment@5:target:0", "/fragment@7:target:0", "/fragment@8/__overlay__:oppo,fp-id0:0", "/fragment@8/__overlay__:oppo,fp-id1:0", "/fragment@9:target:0", "/fragment@11:target:0", "/fragment@14:target:0", "/fragment@17:target:0", "/fragment@19:target:0", "/fragment@20/__overlay__:keypad,volume-up:0", "/fragment@20/__overlay__:keypad,volume-down:0", "/fragment@21:target:0", "/fragment@22/__overlay__:mt6370,intr_gpio:0", "/fragment@24/__overlay__/rt-swchg@53:rt,intr_gpio:0", "/fragment@37/__overlay__:GPIO_SIM2_SIO:0", "/fragment@37/__overlay__:GPIO_SIM2_SRST:0", "/fragment@37/__overlay__:GPIO_SIM2_SCLK:0", "/fragment@37/__overlay__:GPIO_SIM1_SCLK:0", "/fragment@37/__overlay__:GPIO_SIM1_SRST:0", "/fragment@37/__overlay__:GPIO_SIM1_SIO:0", "/fragment@37/__overlay__:GPIO_SIM2_HOT_PLUG:0", "/fragment@37/__overlay__:GPIO_SIM1_HOT_PLUG:0", "/fragment@37/__overlay__:GPIO_FDD_BAND_SUPPORT_DETECT_3RD_PIN:0", "/fragment@37/__overlay__:GPIO_FDD_BAND_SUPPORT_DETECT_4TH_PIN:0", "/fragment@37/__overlay__:GPIO_FDD_BAND_SUPPORT_DETECT_1ST_PIN:0", "/fragment@37/__overlay__:GPIO_FDD_BAND_SUPPORT_DETECT_2ND_PIN:0", "/fragment@39/__overlay__:interrupt-parent:0", "/fragment@40/__overlay__:interrupt-parent:0", "/fragment@41/__overlay__:interrupt-parent:0", "/fragment@41/__overlay__:deb-gpios:0", "/fragment@42/__overlay__:interrupt-parent:0", "/fragment@43/__overlay__:interrupt-parent:0", "/fragment@44/__overlay__:interrupt-parent:0", "/fragment@45/__overlay__:interrupt-parent:0", "/fragment@45/__overlay__:deb-gpios:0", "/fragment@46/__overlay__:interrupt-parent:0", "/fragment@47/__overlay__:interrupt-parent:0", "/fragment@48/__overlay__:interrupt-parent:0", "/fragment@49/__overlay__:interrupt-parent:0", "/fragment@50/__overlay__:interrupt-parent:0", "/fragment@50/__overlay__:deb-gpios:0", "/fragment@51/__overlay__:interrupt-parent:0", "/fragment@63:target:0", "/fragment@65/__overlay__/ilitek_spi@0:reset-gpio:0", "/fragment@65/__overlay__/ilitek_spi@0:interrupt-parent:0", "/fragment@65/__overlay__/ilitek_spi@0:irq-gpio:0";
		pmic_clock_buffer_ctrl = "/fragment@26:target:0";
		rt9465_slave_chr = "/fragment@47:target:0";
		silead_fp = "/fragment@6:target:0", "/fragment@42:target:0";
		smart_pa = "/fragment@44:target:0";
		spi1 = "/fragment@2:target:0";
		spi2 = "/fragment@65:target:0";
		swtp = "/fragment@50:target:0";
		touch = "/fragment@39:target:0", "/fragment@61:target:0";
	};

	__local_fixups__ {

		fragment@10 {

			__overlay__ {
				pinctrl-0 = <0x0>;
				pinctrl-1 = <0x0>;
				pinctrl-2 = <0x0>;
				pinctrl-3 = <0x0>;
				pinctrl-4 = <0x0>;
				pinctrl-5 = <0x0>;
			};
		};

		fragment@12 {

			__overlay__ {
				pinctrl-0 = <0x0>;
				pinctrl-1 = <0x0>;
				pinctrl-2 = <0x0>;
				pinctrl-3 = <0x0>;
			};
		};

		fragment@13 {

			__overlay__ {
				pinctrl-0 = <0x0>;
				pinctrl-1 = <0x0>;
			};
		};

		fragment@16 {

			__overlay__ {
				pinctrl-0 = <0x0>;
				pinctrl-1 = <0x0>;
			};
		};

		fragment@18 {

			__overlay__ {
				pinctrl-0 = <0x0>;
				pinctrl-1 = <0x0>;
				pinctrl-2 = <0x0>;
				pinctrl-3 = <0x0>;
				pinctrl-4 = <0x0>;
				pinctrl-5 = <0x0>;
				pinctrl-6 = <0x0>;
				pinctrl-7 = <0x0>;
				pinctrl-8 = <0x0>;
				pinctrl-9 = <0x0>;
			};
		};

		fragment@20 {

			__overlay__ {
				pinctrl-0 = <0x0>;
				pinctrl-1 = <0x0>;
			};
		};

		fragment@4 {

			__overlay__ {
				pinctrl-0 = <0x0>;
				pinctrl-1 = <0x0>;
				pinctrl-2 = <0x0>;
				pinctrl-3 = <0x0>;
			};
		};

		fragment@6 {

			__overlay__ {
				pinctrl-0 = <0x0>;
				pinctrl-1 = <0x0>;
				pinctrl-2 = <0x0>;
				pinctrl-3 = <0x0>;
				pinctrl-4 = <0x0>;
				pinctrl-5 = <0x0>;
				pinctrl-6 = <0x0>;
				pinctrl-7 = <0x0>;
			};
		};

		fragment@64 {

			__overlay__ {
				pinctrl-0 = <0x0>;
				pinctrl-1 = <0x0>;
				pinctrl-10 = <0x0>;
				pinctrl-11 = <0x0>;
				pinctrl-12 = <0x0>;
				pinctrl-13 = <0x0>;
				pinctrl-14 = <0x0>;
				pinctrl-15 = <0x0>;
				pinctrl-16 = <0x0>;
				pinctrl-17 = <0x0>;
				pinctrl-18 = <0x0>;
				pinctrl-19 = <0x0>;
				pinctrl-2 = <0x0>;
				pinctrl-20 = <0x0>;
				pinctrl-21 = <0x0>;
				pinctrl-22 = <0x0>;
				pinctrl-3 = <0x0>;
				pinctrl-4 = <0x0>;
				pinctrl-5 = <0x0>;
				pinctrl-6 = <0x0>;
				pinctrl-7 = <0x0>;
				pinctrl-8 = <0x0>;
				pinctrl-9 = <0x0>;
			};
		};

		fragment@8 {

			__overlay__ {
				pinctrl-0 = <0x0>;
				pinctrl-1 = <0x0>;
				pinctrl-2 = <0x0>;
			};
		};
	};

	__symbols__ {
		accdet_pins_default = "/fragment@14/__overlay__/accdetdefault";
		accdet_pins_eint_as_int = "/fragment@14/__overlay__/accdeteint@0";
		aud_clk_miso_off = "/fragment@19/__overlay__/aud_clk_miso_off";
		aud_clk_miso_on = "/fragment@19/__overlay__/aud_clk_miso_on";
		aud_clk_mosi_off = "/fragment@19/__overlay__/aud_clk_mosi_off";
		aud_clk_mosi_on = "/fragment@19/__overlay__/aud_clk_mosi_on";
		aud_dat_miso_off = "/fragment@19/__overlay__/aud_dat_miso_off";
		aud_dat_miso_on = "/fragment@19/__overlay__/aud_dat_miso_on";
		aud_dat_mosi_off = "/fragment@19/__overlay__/aud_dat_mosi_off";
		aud_dat_mosi_on = "/fragment@19/__overlay__/aud_dat_mosi_on";
		aud_pins_extamp_pullhigh = "/fragment@19/__overlay__/aud_pins_extamp_pullhigh";
		aud_pins_extamp_pulllow = "/fragment@19/__overlay__/aud_pins_extamp_pulllow";
		camera0_mclk_off = "/fragment@63/__overlay__/camera0_mclk_gpio_mode@gpio99";
		camera0_mclk_on = "/fragment@63/__overlay__/camera0_mclk_2ma@gpio99";
		camera0_rst_high = "/fragment@63/__overlay__/camera0_rst_output_high@gpio101";
		camera0_rst_low = "/fragment@63/__overlay__/camera0_rst_output_low@gpio101";
		camera0_vcama_off = "/fragment@63/__overlay__/camera0_vcama_off@gpio156";
		camera0_vcama_on = "/fragment@63/__overlay__/camera0_vcama_on@gpio156";
		camera1_mclk_off = "/fragment@63/__overlay__/camera1_mclk_gpio_mode@gpio100";
		camera1_mclk_on = "/fragment@63/__overlay__/camera1_mclk_2ma@gpio100";
		camera1_rst_high = "/fragment@63/__overlay__/camera1_rst_output_high@gpio102";
		camera1_rst_low = "/fragment@63/__overlay__/camera1_rst_output_low@gpio102";
		camera1_vcama_off = "/fragment@63/__overlay__/camera1_vcama_off@gpio155";
		camera1_vcama_on = "/fragment@63/__overlay__/camera1_vcama_on@gpio155";
		camera2_mclk_off = "/fragment@63/__overlay__/camera2_mclk_gpio_mode@gpio108";
		camera2_mclk_on = "/fragment@63/__overlay__/camera2_mclk_2ma@gpio108";
		camera2_pnd_high = "/fragment@63/__overlay__/camera2_pnd_output_high@gpio107";
		camera2_pnd_low = "/fragment@63/__overlay__/camera2_pnd_output_low@gpio107";
		camera3_mclk_off = "/fragment@63/__overlay__/camera3_mclk_gpio_mode@gpio88";
		camera3_mclk_on = "/fragment@63/__overlay__/camera3_mclk_2ma@gpio88";
		camera3_rst_high = "/fragment@63/__overlay__/camera3_rst_output_high@gpio160";
		camera3_rst_low = "/fragment@63/__overlay__/camera3_rst_output_low@gpio160";
		camera3_vcama_off = "/fragment@63/__overlay__/camera3_vcama_off@gpio156";
		camera3_vcama_on = "/fragment@63/__overlay__/camera3_vcama_on@gpio156";
		camera_main_af_mtk = "/fragment@29/__overlay__/camera_main_af@0c";
		camera_main_eeprom_mtk = "/fragment@29/__overlay__/camera_main_eeprom@50";
		camera_main_mtk = "/fragment@29/__overlay__/camera_main@1a";
		camera_pins_default = "/fragment@63/__overlay__/camdefault";
		camera_sub_eeprom_mtk = "/fragment@31/__overlay__/camera_sub_eeprom@52";
		camera_sub_mtk = "/fragment@31/__overlay__/camera_sub@2d";
		cap_touch_mtk = "/fragment@27/__overlay__/cap_touch@5d";
		consys_pins_default = "/fragment@11/__overlay__/consys_default";
		ext_buck_lp4_mtk = "/fragment@33/__overlay__/ext_buck_lp4@57";
		ext_buck_lp4x_mtk = "/fragment@33/__overlay__/ext_buck_lp4x@50";
		ext_buck_vgpu_mtk = "/fragment@33/__overlay__/ext_buck_vgpu@55";
		fingerfp_power18_high = "/fragment@5/__overlay__/state_power18_high";
		fingerfp_power18_low = "/fragment@5/__overlay__/state_power18_low";
		fingerfp_power_high = "/fragment@5/__overlay__/state_power_high";
		fingerfp_power_low = "/fragment@5/__overlay__/state_power_low";
		goodix_irq_no_pull = "/fragment@3/__overlay__/goodix_irq_no_pull";
		goodix_irq_out_low = "/fragment@3/__overlay__/goodix_irq_out_low";
		goodix_power_cs = "/fragment@3/__overlay__/goodix_power_cs";
		goodix_reset_default = "/fragment@3/__overlay__/goodix_reset_default";
		gpio_id0_default = "/fragment@7/__overlay__/gpio_id0_default";
		gpio_id0_pull_down = "/fragment@7/__overlay__/gpio_id0_pull_down";
		gpio_id0_pull_up = "/fragment@7/__overlay__/gpio_id0_pull_up";
		gpslna_pins_init = "/fragment@11/__overlay__/gpslna@0";
		gpslna_pins_oh = "/fragment@11/__overlay__/gpslna@1";
		gpslna_pins_ol = "/fragment@11/__overlay__/gpslna@2";
		i2c_lcd_bias_mtk = "/fragment@30/__overlay__/i2c_lcd_bias@3e";
		irtx_gpio_led_default = "/fragment@17/__overlay__/irtx_gpio_led_def@gpio90";
		irtx_gpio_led_set = "/fragment@17/__overlay__/irtx_gpio_led_set@gpio90";
		kpd_volume_down = "/fragment@1/__overlay__/kpd_volume_down";
		kpd_volume_up = "/fragment@1/__overlay__/kpd_volume_up";
		led0 = "/fragment@1/__overlay__/led@0";
		led1 = "/fragment@1/__overlay__/led@1";
		led2 = "/fragment@1/__overlay__/led@2";
		led3 = "/fragment@1/__overlay__/led@3";
		led4 = "/fragment@1/__overlay__/led@4";
		led5 = "/fragment@1/__overlay__/led@5";
		led6 = "/fragment@1/__overlay__/led@6";
		mtkfb_pins_lcd_bias_enn0 = "/fragment@9/__overlay__/lcd_bias_enn0_gpio";
		mtkfb_pins_lcd_bias_enn1 = "/fragment@9/__overlay__/lcd_bias_enn1_gpio";
		mtkfb_pins_lcd_bias_enp0 = "/fragment@9/__overlay__/lcd_bias_enp0_gpio";
		mtkfb_pins_lcd_bias_enp1 = "/fragment@9/__overlay__/lcd_bias_enp1_gpio";
		mtkfb_pins_lcm_rst_out0_gpio = "/fragment@9/__overlay__/lcm_rst_out0_gpio";
		mtkfb_pins_lcm_rst_out1_gpio = "/fragment@9/__overlay__/lcm_rst_out1_gpio";
		oppo_devinfo = "/fragment@1/__overlay__/oppo_devinfo";
		oppo_fp = "/fragment@2/__overlay__/fingerprint@0";
		oppo_project = "/fragment@1/__overlay__/oppo_project";
		silfp_default = "/fragment@5/__overlay__/silfpdefault";
		silfp_irq = "/fragment@5/__overlay__/fp_eint@8";
		silfp_rst_high = "/fragment@5/__overlay__/state_reset_high";
		silfp_rst_low = "/fragment@5/__overlay__/state_reset_low";
		vibrator0 = "/fragment@1/__overlay__/vibrator@0";
		volume_down_gpio_eint = "/fragment@21/__overlay__/volume_down@0";
		volume_up_gpio_eint = "/fragment@21/__overlay__/volume_up@0";
	};

	fragment@0 {
		target = <0xffffffff>;

		__overlay__ {
			atag,videolfb-fb_base_h = <0x0>;
			atag,videolfb-fb_base_l = "^`P";
			atag,videolfb-fps = <0x1770>;
			atag,videolfb-islcm_inited = <0x0>;
			atag,videolfb-islcmfound = <0x1>;
			atag,videolfb-lcmname = "nt35695B_fhd_dsi_cmd_auo_rt5081_drv";
			atag,videolfb-vramSize = <0x17bb000>;
		};
	};

	fragment@1 {
		target = <0xffffffff>;

		__overlay__ {

			kpd_volume_down {
				compatible = "mediatek, VOLUME_DOWN-eint";
				debounce = <0x7d00>;
				interrupt-parent = <0xffffffff>;
				interrupts = <0x5e 0x2 0x5e 0x0>;
				linux,phandle = <0x4b>;
				phandle = <0x4b>;
				status = "okay";
			};

			kpd_volume_up {
				compatible = "mediatek, VOLUME_UP-eint";
				debounce = <0x7d00>;
				interrupt-parent = <0xffffffff>;
				interrupts = <0x14 0x2 0x14 0x0>;
				linux,phandle = <0x4a>;
				phandle = <0x4a>;
				status = "okay";
			};

			led@0 {
				compatible = "mediatek,red";
				data = <0x1>;
				led_mode = <0x0>;
				linux,phandle = <0x41>;
				phandle = <0x41>;
				pwm_config = <0x0 0x0 0x0 0x0 0x0>;
			};

			led@1 {
				compatible = "mediatek,green";
				data = <0x1>;
				led_mode = <0x0>;
				linux,phandle = <0x42>;
				phandle = <0x42>;
				pwm_config = <0x0 0x0 0x0 0x0 0x0>;
			};

			led@2 {
				compatible = "mediatek,blue";
				data = <0x1>;
				led_mode = <0x0>;
				linux,phandle = <0x43>;
				phandle = <0x43>;
				pwm_config = <0x0 0x0 0x0 0x0 0x0>;
			};

			led@3 {
				compatible = "mediatek,jogball-backlight";
				data = <0x1>;
				led_mode = <0x0>;
				linux,phandle = <0x44>;
				phandle = <0x44>;
				pwm_config = <0x0 0x0 0x0 0x0 0x0>;
			};

			led@4 {
				compatible = "mediatek,keyboard-backlight";
				data = <0x1>;
				led_mode = <0x0>;
				linux,phandle = <0x45>;
				phandle = <0x45>;
				pwm_config = <0x0 0x0 0x0 0x0 0x0>;
			};

			led@5 {
				compatible = "mediatek,button-backlight";
				data = <0x1>;
				led_mode = <0x0>;
				linux,phandle = <0x46>;
				phandle = <0x46>;
				pwm_config = <0x0 0x0 0x0 0x0 0x0>;
			};

			led@6 {
				compatible = "mediatek,lcd-backlight";
				data = <0x1>;
				led_mode = <0x4>;
				linux,phandle = <0x47>;
				phandle = <0x47>;
				pwm_config = <0x0 0x3 0x0 0x0 0x0>;
			};

			oppo_devinfo {
				compatible = "oppo, device_info";
				linux,phandle = <0x4c>;
				phandle = <0x4c>;
				sdcard-gpio = <0xffffffff 0x1 0x0>;
				sub_board-gpio = <0xffffffff 0x2b 0x0>;
			};

			oppo_project {
				compatible = "oppo,oppo_project";
				linux,phandle = <0x49>;
				phandle = <0x49>;
			};

			vibrator@0 {
				compatible = "mediatek,vibrator";
				linux,phandle = <0x48>;
				phandle = <0x48>;
				vib_limit = <0x0>;
				vib_timer = <0x1e>;
				vib_vol = <0xb>;
			};
		};
	};

	fragment@10 {
		target = <0xffffffff>;

		__overlay__ {
			pinctrl-0 = <0x10>;
			pinctrl-1 = <0x11>;
			pinctrl-2 = <0x12>;
			pinctrl-3 = <0x13>;
			pinctrl-4 = <0x14>;
			pinctrl-5 = <0x15>;
			pinctrl-names = "lcm_rst_out0_gpio", "lcm_rst_out1_gpio", "lcd_bias_enp0_gpio", "lcd_bias_enp1_gpio", "lcd_bias_enn0_gpio", "lcd_bias_enn1_gpio";
			status = "okay";
		};
	};

	fragment@11 {
		target = <0xffffffff>;

		__overlay__ {

			consys_default {
				linux,phandle = <0x16>;
				phandle = <0x16>;
			};

			gpslna@0 {
				linux,phandle = <0x17>;
				phandle = <0x17>;

				pins_cmd_dat {
					bias-disable;
					output-low;
					pinmux = <0x5b00>;
					slew-rate = <0x1>;
				};
			};

			gpslna@1 {
				linux,phandle = <0x18>;
				phandle = <0x18>;

				pins_cmd_dat {
					output-high;
					pinmux = <0x5b00>;
					slew-rate = <0x1>;
				};
			};

			gpslna@2 {
				linux,phandle = <0x19>;
				phandle = <0x19>;

				pins_cmd_dat {
					output-low;
					pinmux = <0x5b00>;
					slew-rate = <0x1>;
				};
			};
		};
	};

	fragment@12 {
		target = <0xffffffff>;

		__overlay__ {
			pinctrl-0 = <0x16>;
			pinctrl-1 = <0x17>;
			pinctrl-2 = <0x18>;
			pinctrl-3 = <0x19>;
			pinctrl-names = "default", "gps_lna_state_init", "gps_lna_state_oh", "gps_lna_state_ol";
			status = "okay";
		};
	};

	fragment@13 {
		target = <0xffffffff>;

		__overlay__ {
			accdet-mic-mode = <0x1>;
			accdet-mic-vol = <0x7>;
			accdet-plugout-debounce = <0x1>;
			headset-eint-level-pol = <0x8>;
			headset-four-key-threshold = <0x0 0x3a 0x79 0xc0 0x190>;
			headset-mode-setting = <0x500 0x500 0x1 0x1f0 0x800 0x800 0x20 0x44>;
			headset-three-key-threshold = <0x0 0x50 0xdc 0x190>;
			headset-three-key-threshold-CDD = <0x0 0x79 0xc0 0x258>;
			pinctrl-0 = <0x1a>;
			pinctrl-1 = <0x1b>;
			pinctrl-names = "default", "state_eint_as_int";
			status = "okay";
		};
	};

	fragment@14 {
		target = <0xffffffff>;

		__overlay__ {

			accdetdefault {
				linux,phandle = <0x1a>;
				phandle = <0x1a>;
			};

			accdeteint@0 {
				linux,phandle = <0x1b>;
				phandle = <0x1b>;

				pins_cmd_dat {
					bias-disable;
					pinmux = <0x900>;
					slew-rate = <0x0>;
				};
			};
		};
	};

	fragment@15 {
		target = <0xffffffff>;

		__overlay__ {
			EMBEDDED_SEL = <0x1>;
		};
	};

	fragment@16 {
		target = <0xffffffff>;

		__overlay__ {
			pinctrl-0 = <0x1c>;
			pinctrl-1 = <0x1d>;
			pinctrl-names = "irtx_gpio_led_default", "irtx_gpio_led_set";
			status = "okay";
		};
	};

	fragment@17 {
		target = <0xffffffff>;

		__overlay__ {

			irtx_gpio_led_def@gpio90 {
				linux,phandle = <0x1c>;
				phandle = <0x1c>;

				pins_cmd_dat {
					bias-disable;
					input-schmitt-enable = <0x0>;
					output-low;
					pinmux = <0x5a00>;
					slew-rate = <0x1>;
				};
			};

			irtx_gpio_led_set@gpio90 {
				linux,phandle = <0x1d>;
				phandle = <0x1d>;

				pins_cmd_dat {
					output-high;
					pinmux = <0x5a02>;
					slew-rate = <0x1>;
				};
			};
		};
	};

	fragment@18 {
		target = <0xffffffff>;

		__overlay__ {
			pinctrl-0 = <0x1e>;
			pinctrl-1 = <0x1f>;
			pinctrl-2 = <0x20>;
			pinctrl-3 = <0x21>;
			pinctrl-4 = <0x22>;
			pinctrl-5 = <0x23>;
			pinctrl-6 = <0x24>;
			pinctrl-7 = <0x25>;
			pinctrl-8 = <0x26>;
			pinctrl-9 = <0x27>;
			pinctrl-names = "aud_clk_mosi_off", "aud_clk_mosi_on", "aud_clk_miso_off", "aud_clk_miso_on", "aud_dat_mosi_off", "aud_dat_mosi_on", "aud_dat_miso_off", "aud_dat_miso_on", "extamp-pulllow", "extamp-pullhigh";
			status = "okay";
		};
	};

	fragment@19 {
		target = <0xffffffff>;

		__overlay__ {

			aud_clk_miso_off {
				linux,phandle = <0x20>;
				phandle = <0x20>;

				pins_cmd0_dat {
					pinmux = <0x8c00>;
				};
			};

			aud_clk_miso_on {
				linux,phandle = <0x21>;
				phandle = <0x21>;

				pins_cmd0_dat {
					pinmux = <0x8c01>;
				};
			};

			aud_clk_mosi_off {
				linux,phandle = <0x1e>;
				phandle = <0x1e>;

				pins_cmd0_dat {
					pinmux = <0x8800>;
				};
			};

			aud_clk_mosi_on {
				linux,phandle = <0x1f>;
				phandle = <0x1f>;

				pins_cmd0_dat {
					pinmux = <0x8801>;
				};
			};

			aud_dat_miso_off {
				linux,phandle = <0x24>;
				phandle = <0x24>;

				pins_cmd1_dat {
					bias-disable;
					input-enable;
					pinmux = <0x8e00>;
					slew-rate = <0x0>;
				};

				pins_cmd2_dat {
					bias-disable;
					input-enable;
					pinmux = <0x8f00>;
					slew-rate = <0x0>;
				};
			};

			aud_dat_miso_on {
				linux,phandle = <0x25>;
				phandle = <0x25>;

				pins_cmd1_dat {
					pinmux = <0x8e01>;
				};

				pins_cmd2_dat {
					pinmux = <0x8f01>;
				};
			};

			aud_dat_mosi_off {
				linux,phandle = <0x22>;
				phandle = <0x22>;

				pins_cmd1_dat {
					bias-disable;
					input-enable;
					pinmux = <0x8a00>;
					slew-rate = <0x0>;
				};

				pins_cmd2_dat {
					bias-disable;
					input-enable;
					pinmux = <0x8b00>;
					slew-rate = <0x0>;
				};
			};

			aud_dat_mosi_on {
				linux,phandle = <0x23>;
				phandle = <0x23>;

				pins_cmd1_dat {
					pinmux = <0x8a01>;
				};

				pins_cmd2_dat {
					pinmux = <0x8b01>;
				};
			};

			aud_pins_extamp_pullhigh {
				linux,phandle = <0x27>;
				phandle = <0x27>;

				pins_cmd_dat {
					output-high;
					pinmux = <0x9600>;
					slew-rate = <0x1>;
				};
			};

			aud_pins_extamp_pulllow {
				linux,phandle = <0x26>;
				phandle = <0x26>;

				pins_cmd_dat {
					output-low;
					pinmux = <0x9600>;
					slew-rate = <0x1>;
				};
			};
		};
	};

	fragment@2 {
		target = <0xffffffff>;

		__overlay__ {
			#address-cells = <0x1>;
			#size-cells = <0x0>;
			status = "okay";

			fingerprint@0 {
				compatible = "oppo,oppo_fp";
				linux,phandle = <0x4d>;
				netlink-event = <0x1e>;
				phandle = <0x4d>;
				reg = <0x0>;
				spi-id = <0x1>;
				spi-irq = <0x7a>;
				spi-max-frequency = <0x7a1200>;
				spi-reg = <0x11010000>;
				status = "okay";
			};
		};
	};

	fragment@20 {
		target = <0xffffffff>;

		__overlay__ {
			keypad,volume-down = <0xffffffff 0x5e 0x0>;
			keypad,volume-up = <0xffffffff 0x14 0x0>;
			pinctrl-0 = <0x28>;
			pinctrl-1 = <0x29>;
			pinctrl-names = "volume_up_as_int", "volume_down_as_int";
			status = "okay";
		};
	};

	fragment@21 {
		target = <0xffffffff>;

		__overlay__ {

			volume_down@0 {
				linux,phandle = <0x29>;
				phandle = <0x29>;

				pins_cmd_dat {
					bias-pull-up = <0x0>;
					input-enable;
					pinmux = <0x5e00>;
					slew-rate = <0x0>;
				};
			};

			volume_up@0 {
				linux,phandle = <0x28>;
				phandle = <0x28>;

				pins_cmd_dat {
					bias-pull-up = <0x0>;
					input-enable;
					pinmux = <0x1400>;
					slew-rate = <0x0>;
				};
			};
		};
	};

	fragment@22 {
		target = <0xffffffff>;

		__overlay__ {
			mt6370,intr_gpio = <0xffffffff 0xb 0x0>;
			mt6370,intr_gpio_num = <0xb>;
		};
	};

	fragment@23 {
		target = <0xffffffff>;

		__overlay__ {
			algorithm_name = "SwitchCharging";
			chg1_ta_ac_charger_current = <0x1e8480>;
			chg2_ta_ac_charger_current = <0x1e8480>;
		};
	};

	fragment@24 {
		target = <0xffffffff>;

		__overlay__ {

			bq25601@6B {
				compatible = "ti,bq25601";
				reg = <0x6b>;
				ti,bq2560x,boost-current = <0x4b0>;
				ti,bq2560x,boost-voltage = <0x1386>;
				ti,bq2560x,enable_term;
				ti,bq2560x,precharge-current = <0x100>;
				ti,bq2560x,stat-pin-ctrl = <0x3>;
				ti,bq2560x,termination-current = <0xf0>;
				ti,bq2560x,usb-ichg = <0x1f4>;
				ti,bq2560x,usb-ilim = <0x1f4>;
				ti,bq2560x,usb-vlim = <0x11f8>;
				ti,bq2560x,usb-vreg = <0x1130>;
				ti,bq2560x,vac-ovp-threshold = <0x1964>;
			};

			rt-swchg@53 {
				compatible = "richtek,swchg";
				reg = <0x53>;
				rt,intr_gpio = <0xffffffff 0xb 0x0>;
				rt,intr_gpio_num = <0xb>;
				status = "okay";

				rt9471 {
					aicr = <0x7a120>;
					charger_name = "primary_chg";
					chg_alias_name = "rt9471_chg";
					cv = <0x44aa20>;
					en-qon-rst;
					en-te;
					ichg = <0xf4240>;
					ieoc = <0x30d40>;
					interrupt-names = "wdt", "chg_mivr", "vbus_gd", "bc12_done", "detach", "vac_ov", "otg_fault", "chg_rdy", "chg_done";
					mivr = <0x401640>;
					mivr-track = <0x0>;
					rm-name = "rt9471";
					rm-slave-addr = [53];
					safe-tmr = <0xa>;
					wdt = <0x28>;
				};
			};
		};
	};

	fragment@25 {
		target = <0xffffffff>;

		__overlay__ {

			adc_channel@ {
				compatible = "mediatek,adc_channel";
				mediatek,adc_fdd_rf_params_dynamic_custom_ch = <0x2>;
				mediatek,temperature0 = <0x0>;
				mediatek,temperature1 = <0x1>;
				status = "okay";
			};
		};
	};

	fragment@26 {
		target = <0xffffffff>;

		__overlay__ {
			mediatek,clkbuf-config = <0x2 0x1 0x1 0x2 0x0 0x0 0x0>;
			mediatek,clkbuf-driving-current = <0x1 0x1 0x1 0x1 0x1 0x1 0x1>;
			mediatek,clkbuf-quantity = <0x7>;
			status = "okay";
		};
	};

	fragment@27 {
		target = <0xffffffff>;

		__overlay__ {
			#address-cells = <0x1>;
			#size-cells = <0x0>;
			clock-frequency = <0x61a80>;
			mediatek,use-open-drain;

			cap_touch@5d {
				compatible = "mediatek,cap_touch";
				linux,phandle = <0x4e>;
				phandle = <0x4e>;
				reg = <0x5d>;
				status = "okay";
			};
		};
	};

	fragment@28 {
		target = <0xffffffff>;

		__overlay__ {
			#address-cells = <0x1>;
			#size-cells = <0x0>;
			clock-frequency = <0x61a80>;
			mediatek,use-open-drain;
		};
	};

	fragment@29 {
		target = <0xffffffff>;

		__overlay__ {
			#address-cells = <0x1>;
			#size-cells = <0x0>;
			clock-frequency = <0x61a80>;
			mediatek,use-open-drain;

			camera_main@1a {
				compatible = "mediatek,camera_main";
				linux,phandle = <0x4f>;
				phandle = <0x4f>;
				reg = <0x1a>;
				status = "okay";
			};

			camera_main_af@0c {
				compatible = "mediatek,camera_main_af";
				linux,phandle = <0x51>;
				phandle = <0x51>;
				reg = <0xc>;
				status = "okay";
			};

			camera_main_eeprom@50 {
				compatible = "mediatek,camera_main_eeprom";
				linux,phandle = <0x50>;
				phandle = <0x50>;
				reg = <0x50>;
				status = "okay";
			};
		};
	};

	fragment@3 {
		target = <0xffffffff>;

		__overlay__ {

			goodix_irq_no_pull {
				linux,phandle = <0x3>;
				phandle = <0x3>;

				pins_cmd_dat {
					bias-disable;
					pinmux = <0x300>;
					slew-rate = <0x0>;
				};
			};

			goodix_irq_out_low {
				linux,phandle = <0x2>;
				phandle = <0x2>;

				pins_cmd_dat {
					output-low;
					pinmux = <0x300>;
					slew-rate = <0x1>;
				};
			};

			goodix_power_cs {
				linux,phandle = <0x4>;
				phandle = <0x4>;

				pins_cmd_dat {
					bias-disable;
					output-high;
					pinmux = <0x9e00>;
					slew-rate = <0x1>;
				};
			};

			goodix_reset_default {
				linux,phandle = <0x1>;
				phandle = <0x1>;

				pins_cmd_dat {
					output-low;
					pinmux = <0xab00>;
					slew-rate = <0x1>;
				};
			};
		};
	};

	fragment@30 {
		target = <0xffffffff>;

		__overlay__ {
			#address-cells = <0x1>;
			#size-cells = <0x0>;
			clock-frequency = <0x61a80>;
			mediatek,use-open-drain;

			i2c_lcd_bias@3e {
				compatible = "mediatek,i2c_lcd_bias";
				linux,phandle = <0x52>;
				phandle = <0x52>;
				reg = <0x3e>;
				status = "okay";
			};
		};
	};

	fragment@31 {
		target = <0xffffffff>;

		__overlay__ {
			#address-cells = <0x1>;
			#size-cells = <0x0>;
			clock-frequency = <0x61a80>;
			mediatek,use-open-drain;

			camera_sub@2d {
				compatible = "mediatek,camera_sub";
				linux,phandle = <0x53>;
				phandle = <0x53>;
				reg = <0x2d>;
				status = "okay";
			};

			camera_sub_eeprom@52 {
				compatible = "mediatek,camera_sub_eeprom";
				linux,phandle = <0x54>;
				phandle = <0x54>;
				reg = <0x52>;
				status = "okay";
			};
		};
	};

	fragment@32 {
		target = <0xffffffff>;

		__overlay__ {
			#address-cells = <0x1>;
			#size-cells = <0x0>;
			clock-frequency = <0x61a80>;
			mediatek,use-push-pull;
		};
	};

	fragment@33 {
		target = <0xffffffff>;

		__overlay__ {
			#address-cells = <0x1>;
			#size-cells = <0x0>;
			clock-frequency = <0x61a80>;
			mediatek,use-open-drain;

			ext_buck_lp4@57 {
				compatible = "mediatek,ext_buck_lp4";
				linux,phandle = <0x56>;
				phandle = <0x56>;
				reg = <0x57>;
				status = "okay";
			};

			ext_buck_lp4x@50 {
				compatible = "mediatek,ext_buck_lp4x";
				linux,phandle = <0x57>;
				phandle = <0x57>;
				reg = <0x50>;
				status = "okay";
			};

			ext_buck_vgpu@55 {
				compatible = "mediatek,ext_buck_vgpu";
				linux,phandle = <0x55>;
				phandle = <0x55>;
				reg = <0x55>;
				status = "okay";
			};
		};
	};

	fragment@34 {
		target = <0xffffffff>;

		__overlay__ {
			#address-cells = <0x1>;
			#size-cells = <0x0>;
			clock-frequency = <0x61a80>;
			mediatek,use-open-drain;
		};
	};

	fragment@35 {
		target = <0xffffffff>;

		__overlay__ {
			#address-cells = <0x1>;
			#size-cells = <0x0>;
			clock-frequency = <0x61a80>;
			mediatek,use-open-drain;
		};
	};

	fragment@36 {
		target = <0xffffffff>;

		__overlay__ {
			#address-cells = <0x1>;
			#size-cells = <0x0>;
			clock-frequency = <0x61a80>;
			mediatek,use-open-drain;
		};
	};

	fragment@37 {
		target = <0xffffffff>;

		__overlay__ {
			GPIO_FDD_BAND_SUPPORT_DETECT_1ST_PIN = <0xffffffff 0x4f 0x0>;
			GPIO_FDD_BAND_SUPPORT_DETECT_2ND_PIN = <0xffffffff 0x50 0x0>;
			GPIO_FDD_BAND_SUPPORT_DETECT_3RD_PIN = <0xffffffff 0x34 0x0>;
			GPIO_FDD_BAND_SUPPORT_DETECT_4TH_PIN = <0xffffffff 0x4d 0x0>;
			GPIO_SIM1_HOT_PLUG = <0xffffffff 0x2f 0x0>;
			GPIO_SIM1_SCLK = <0xffffffff 0x26 0x0>;
			GPIO_SIM1_SIO = <0xffffffff 0x28 0x0>;
			GPIO_SIM1_SRST = <0xffffffff 0x27 0x0>;
			GPIO_SIM2_HOT_PLUG = <0xffffffff 0x2e 0x0>;
			GPIO_SIM2_SCLK = <0xffffffff 0x25 0x0>;
			GPIO_SIM2_SIO = <0xffffffff 0x23 0x0>;
			GPIO_SIM2_SRST = <0xffffffff 0x24 0x0>;
		};
	};

	fragment@38 {
		target = <0xffffffff>;

		__overlay__ {
			gpio_init_default = <0x0 0x0 0x0 0x0 0x1 0x1 0x1 0x1 0x0 0x0 0x0 0x1 0x1 0x1 0x2 0x0 0x0 0x0 0x1 0x1 0x1 0x3 0x0 0x0 0x0 0x0 0x0 0x1 0x4 0x0 0x0 0x0 0x0 0x0 0x0 0x5 0x0 0x0 0x0 0x1 0x0 0x0 0x6 0x0 0x1 0x0 0x0 0x0 0x0 0x7 0x0 0x0 0x0 0x1 0x1 0x0 0x8 0x0 0x1 0x0 0x0 0x0 0x0 0x9 0x0 0x0 0x0 0x1 0x1 0x0 0xa 0x0 0x0 0x0 0x1 0x0 0x0 0xb 0x0 0x0 0x0 0x1 0x1 0x0 0xc 0x0 0x0 0x0 0x1 0x1 0x0 0xd 0x3 0x0 0x0 0x1 0x0 0x0 0xe 0x3 0x1 0x0 0x0 0x0 0x0 0xf 0x3 0x1 0x0 0x0 0x0 0x0 0x10 0x3 0x1 0x0 0x0 0x0 0x0 0x11 0x2 0x0 0x0 0x1 0x0 0x0 0x12 0x2 0x1 0x0 0x0 0x0 0x0 0x13 0x2 0x1 0x0 0x0 0x0 0x0 0x14 0x2 0x1 0x0 0x0 0x0 0x0 0x15 0x3 0x0 0x0 0x1 0x1 0x0 0x16 0x3 0x0 0x0 0x1 0x0 0x0 0x17 0x0 0x0 0x0 0x1 0x1 0x0 0x18 0x0 0x0 0x0 0x0 0x0 0x0 0x19 0x1 0x0 0x0 0x0 0x0 0x0 0x1a 0x0 0x0 0x0 0x0 0x0 0x0 0x1b 0x1 0x1 0x0 0x0 0x0 0x0 0x1c 0x1 0x1 0x0 0x0 0x0 0x0 0x1d 0x1 0x1 0x0 0x0 0x0 0x1 0x1e 0x1 0x0 0x0 0x1 0x1 0x1 0x1f 0x1 0x0 0x0 0x1 0x1 0x1 0x20 0x1 0x0 0x0 0x1 0x1 0x1 0x21 0x1 0x0 0x0 0x1 0x1 0x1 0x22 0x1 0x0 0x0 0x1 0x1 0x1 0x23 0x1 0x0 0x0 0x1 0x1 0x0 0x24 0x1 0x1 0x0 0x0 0x0 0x0 0x25 0x1 0x1 0x0 0x0 0x0 0x0 0x26 0x1 0x1 0x0 0x0 0x0 0x0 0x27 0x1 0x1 0x0 0x0 0x0 0x0 0x28 0x1 0x0 0x0 0x1 0x1 0x0 0x29 0x0 0x0 0x0 0x1 0x1 0x0 0x2a 0x0 0x0 0x0 0x1 0x0 0x0 0x2b 0x1 0x1 0x0 0x0 0x0 0x0 0x2c 0x1 0x0 0x0 0x1 0x0 0x0 0x2d 0x0 0x1 0x0 0x1 0x0 0x0 0x2e 0x1 0x0 0x0 0x1 0x1 0x0 0x2f 0x1 0x0 0x0 0x1 0x1 0x0 0x30 0x1 0x0 0x0 0x1 0x1 0x1 0x31 0x1 0x0 0x0 0x1 0x1 0x1 0x32 0x1 0x0 0x0 0x1 0x1 0x1 0x33 0x1 0x0 0x0 0x1 0x1 0x1 0x34 0x0 0x0 0x0 0x1 0x0 0x0 0x35 0x1 0x1 0x0 0x1 0x0 0x0 0x36 0x1 0x1 0x0 0x1 0x0 0x0 0x37 0x0 0x0 0x0 0x0 0x0 0x0 0x38 0x1 0x1 0x0 0x1 0x0 0x0 0x39 0x1 0x1 0x0 0x1 0x0 0x0 0x3a 0x0 0x0 0x0 0x1 0x0 0x0 0x3b 0x1 0x0 0x0 0x1 0x0 0x0 0x3c 0x1 0x0 0x0 0x1 0x0 0x0 0x3d 0x1 0x0 0x0 0x1 0x0 0x0 0x3e 0x1 0x0 0x0 0x1 0x0 0x0 0x3f 0x1 0x0 0x0 0x1 0x0 0x0 0x40 0x1 0x0 0x0 0x1 0x0 0x0 0x41 0x1 0x0 0x0 0x1 0x0 0x0 0x42 0x1 0x0 0x0 0x1 0x0 0x0 0x43 0x1 0x0 0x0 0x1 0x0 0x0 0x44 0x1 0x0 0x0 0x1 0x0 0x0 0x45 0x1 0x1 0x0 0x1 0x0 0x0 0x46 0x1 0x1 0x0 0x1 0x0 0x0 0x47 0x1 0x1 0x0 0x1 0x0 0x0 0x48 0x1 0x1 0x0 0x1 0x0 0x0 0x49 0x1 0x1 0x0 0x1 0x0 0x0 0x4a 0x1 0x1 0x0 0x1 0x0 0x0 0x4b 0x1 0x1 0x0 0x1 0x0 0x0 0x4c 0x1 0x1 0x0 0x1 0x0 0x0 0x4d 0x0 0x0 0x0 0x1 0x0 0x0 0x4e 0x1 0x1 0x0 0x1 0x0 0x0 0x4f 0x0 0x0 0x0 0x1 0x0 0x0 0x50 0x0 0x0 0x0 0x1 0x0 0x0 0x51 0x1 0x0 0x0 0x1 0x1 0x1 0x52 0x1 0x0 0x0 0x1 0x1 0x1 0x53 0x1 0x0 0x0 0x1 0x1 0x1 0x54 0x1 0x0 0x0 0x1 0x1 0x1 0x55 0x1 0x1 0x0 0x1 0x0 0x0 0x56 0x1 0x1 0x0 0x1 0x0 0x0 0x57 0x0 0x1 0x1 0x0 0x0 0x0 0x58 0x0 0x1 0x0 0x1 0x0 0x0 0x59 0x1 0x0 0x0 0x1 0x0 0x0 0x5a 0x2 0x1 0x0 0x0 0x0 0x0 0x5b 0x0 0x1 0x0 0x1 0x0 0x0 0x5c 0x1 0x1 0x0 0x0 0x0 0x0 0x5d 0x1 0x0 0x0 0x1 0x1 0x0 0x5e 0x1 0x0 0x0 0x1 0x1 0x0 0x5f 0x1 0x0 0x0 0x1 0x1 0x0 0x60 0x1 0x1 0x0 0x0 0x0 0x0 0x61 0x0 0x1 0x0 0x0 0x0 0x0 0x62 0x0 0x1 0x0 0x0 0x0 0x0 0x63 0x1 0x1 0x0 0x0 0x0 0x0 0x64 0x1 0x1 0x0 0x0 0x0 0x0 0x65 0x0 0x1 0x0 0x0 0x0 0x0 0x66 0x0 0x1 0x0 0x0 0x0 0x0 0x67 0x1 0x0 0x0 0x1 0x1 0x1 0x68 0x1 0x0 0x0 0x1 0x1 0x1 0x69 0x1 0x0 0x0 0x1 0x1 0x1 0x6a 0x1 0x0 0x0 0x1 0x1 0x1 0x6b 0x0 0x1 0x0 0x0 0x0 0x0 0x6c 0x1 0x1 0x0 0x0 0x0 0x0 0x6d 0x2 0x0 0x0 0x1 0x1 0x0 0x6e 0x0 0x0 0x0 0x1 0x0 0x0 0x6f 0x0 0x0 0x0 0x1 0x0 0x0 0x70 0x0 0x0 0x0 0x1 0x0 0x0 0x71 0x0 0x0 0x0 0x1 0x0 0x0 0x72 0x0 0x0 0x0 0x1 0x0 0x0 0x73 0x0 0x0 0x0 0x1 0x0 0x0 0x74 0x0 0x0 0x0 0x1 0x0 0x0 0x75 0x0 0x0 0x0 0x1 0x0 0x0 0x76 0x0 0x0 0x0 0x1 0x0 0x0 0x77 0x0 0x0 0x0 0x1 0x0 0x0 0x78 0x0 0x0 0x0 0x1 0x0 0x0 0x79 0x0 0x0 0x0 0x1 0x0 0x0 0x7a 0x1 0x0 0x0 0x1 0x1 0x1 0x7b 0x1 0x0 0x0 0x1 0x1 0x1 0x7c 0x1 0x1 0x0 0x0 0x0 0x1 0x7d 0x1 0x0 0x0 0x1 0x1 0x1 0x7e 0x1 0x0 0x0 0x1 0x1 0x1 0x7f 0x1 0x0 0x0 0x1 0x1 0x1 0x80 0x1 0x0 0x0 0x1 0x1 0x1 0x81 0x1 0x0 0x0 0x1 0x1 0x1 0x82 0x1 0x0 0x0 0x1 0x1 0x1 0x83 0x1 0x0 0x0 0x1 0x0 0x1 0x84 0x1 0x0 0x0 0x1 0x1 0x1 0x85 0x1 0x1 0x1 0x0 0x0 0x1 0x86 0x1 0x0 0x0 0x1 0x0 0x1 0x87 0x1 0x1 0x0 0x0 0x0 0x0 0x88 0x1 0x1 0x0 0x0 0x0 0x0 0x89 0x1 0x1 0x0 0x0 0x0 0x0 0x8a 0x1 0x1 0x0 0x0 0x0 0x0 0x8b 0x1 0x1 0x0 0x0 0x0 0x0 0x8c 0x1 0x0 0x0 0x1 0x0 0x0 0x8d 0x1 0x0 0x0 0x1 0x0 0x0 0x8e 0x1 0x0 0x0 0x1 0x0 0x0 0x8f 0x1 0x0 0x0 0x1 0x0 0x0 0x90 0x1 0x0 0x0 0x1 0x0 0x0 0x91 0x1 0x1 0x1 0x0 0x0 0x0 0x92 0x1 0x0 0x0 0x1 0x0 0x0 0x93 0x1 0x1 0x0 0x0 0x0 0x0 0x94 0x1 0x1 0x0 0x0 0x0 0x0 0x95 0x1 0x1 0x0 0x0 0x0 0x0 0x96 0x0 0x1 0x0 0x0 0x0 0x0 0x97 0x6 0x1 0x0 0x0 0x0 0x0 0x98 0x0 0x0 0x0 0x1 0x0 0x0 0x99 0x0 0x0 0x0 0x1 0x0 0x0 0x9a 0x0 0x1 0x0 0x0 0x0 0x0 0x9b 0x0 0x1 0x0 0x0 0x0 0x0 0x9c 0x0 0x1 0x0 0x0 0x0 0x0 0x9d 0x0 0x1 0x0 0x0 0x0 0x0 0x9e 0x0 0x1 0x1 0x0 0x0 0x0 0x9f 0x0 0x1 0x0 0x0 0x0 0x0 0xa0 0x0 0x1 0x0 0x0 0x0 0x0 0xa1 0x1 0x0 0x0 0x1 0x1 0x1 0xa2 0x1 0x0 0x0 0x1 0x1 0x1 0xa3 0x0 0x0 0x0 0x1 0x0 0x0 0xa4 0x0 0x0 0x0 0x1 0x0 0x0 0xa5 0x0 0x1 0x0 0x1 0x0 0x0 0xa6 0x0 0x1 0x0 0x1 0x0 0x0 0xa7 0x0 0x0 0x0 0x1 0x0 0x0 0xa8 0x0 0x0 0x0 0x1 0x1 0x0 0xa9 0x0 0x0 0x0 0x1 0x1 0x0 0xaa 0x0 0x0 0x0 0x0 0x0 0x0 0xab 0x0 0x1 0x0 0x0 0x0 0x0 0xac 0x0 0x1 0x1 0x0 0x0 0x0 0xad 0x0 0x0 0x0 0x0 0x0 0x0 0xae 0x0 0x0 0x0 0x1 0x0 0x0 0xaf 0x0 0x0 0x0 0x1 0x0 0x0 0xb0 0x0 0x0 0x0 0x1 0x0 0x0 0xb1 0x0 0x0 0x0 0x1 0x0 0x0 0xb2 0x0 0x1 0x0 0x0 0x0 0x0 0xb3 0x0 0x0 0x0 0x1 0x0 0x0>;
		};
	};

	fragment@39 {
		target = <0xffffffff>;

		__overlay__ {
			interrupt-parent = <0xffffffff>;
			interrupts = <0x0 0x2 0x0 0x0>;
			status = "okay";
		};
	};

	fragment@4 {
		target = <0xffffffff>;

		__overlay__ {
			goodix,gpio_irq = <0xffffffff 0x3 0x0>;
			goodix,gpio_reset = <0xffffffff 0xab 0x0>;
			goodix,vdd-en = <0xffffffff 0x9e 0x0>;
			interrupt-parent = <0xffffffff>;
			interrupts = <0x3 0x0>;
			pinctrl-0 = <0x1>;
			pinctrl-1 = <0x2>;
			pinctrl-2 = <0x3>;
			pinctrl-3 = <0x4>;
			pinctrl-names = "goodix_reset_default", "goodix_irq_out_low", "goodix_irq_no_pull", "goodix_power_cs";
			spi-max-frequency = <0x7a1200>;
			status = "okay";
		};
	};

	fragment@40 {
		target = <0xffffffff>;

		__overlay__ {
			interrupt-parent = <0xffffffff>;
			interrupts = <0x1 0x2 0x1 0x0>;
			status = "okay";
		};
	};

	fragment@41 {
		target = <0xffffffff>;

		__overlay__ {
			deb-gpios = <0xffffffff 0x2 0x0>;
			debounce = <0x7d000>;
			interrupt-parent = <0xffffffff>;
			interrupts = <0x2 0x8 0x2 0x0>;
			status = "okay";
		};
	};

	fragment@42 {
		target = <0xffffffff>;

		__overlay__ {
			interrupt-parent = <0xffffffff>;
			interrupts = <0x3 0x2 0x3 0x0>;
			status = "okay";
		};
	};

	fragment@43 {
		target = <0xffffffff>;

		__overlay__ {
			interrupt-parent = <0xffffffff>;
			interrupts = <0x4 0x4 0x4 0x0>;
			status = "okay";
		};
	};

	fragment@44 {
		target = <0xffffffff>;

		__overlay__ {
			interrupt-parent = <0xffffffff>;
			interrupts = <0x7 0x8 0x7 0x0>;
			status = "okay";
		};
	};

	fragment@45 {
		target = <0xffffffff>;

		__overlay__ {
			deb-gpios = <0xffffffff 0x9 0x0>;
			debounce = <0x3e800>;
			interrupt-parent = <0xffffffff>;
			interrupts = <0x9 0x8 0x9 0x0>;
			status = "okay";
		};
	};

	fragment@46 {
		target = <0xffffffff>;

		__overlay__ {
			interrupt-parent = <0xffffffff>;
			interrupts = <0xb 0x2 0xb 0x0>;
			status = "okay";
		};
	};

	fragment@47 {
		target = <0xffffffff>;

		__overlay__ {
			interrupt-parent = <0xffffffff>;
			interrupts = <0x17 0x8 0x17 0x0>;
			status = "okay";
		};
	};

	fragment@48 {
		target = <0xffffffff>;

		__overlay__ {
			interrupt-parent = <0xffffffff>;
			interrupts = <0x29 0x8 0x29 0x0>;
			status = "okay";
		};
	};

	fragment@49 {
		target = <0xffffffff>;

		__overlay__ {
			interrupt-parent = <0xffffffff>;
			interrupts = <0x2c 0x1 0x2c 0x1>;
			status = "okay";
		};
	};

	fragment@5 {
		target = <0xffffffff>;

		__overlay__ {

			fp_eint@8 {
				linux,phandle = <0x8>;
				phandle = <0x8>;

				pins_cmd_dat {
					bias-disable;
					pinmux = <0x300>;
					slew-rate = <0x0>;
				};
			};

			silfpdefault {
				linux,phandle = <0x5>;
				phandle = <0x5>;
			};

			state_power18_high {
				linux,phandle = <0xb>;
				phandle = <0xb>;

				pins_cmd_dat {
					output-high;
					pinmux = <0x9e00>;
					slew-rate = <0x1>;
				};
			};

			state_power18_low {
				linux,phandle = <0xc>;
				phandle = <0xc>;

				pins_cmd_dat {
					output-low;
					pinmux = <0x4f00>;
					slew-rate = <0x1>;
				};
			};

			state_power_high {
				linux,phandle = <0x9>;
				phandle = <0x9>;

				pins_cmd_dat {
					output-high;
					pinmux = <0x9e00>;
					slew-rate = <0x1>;
				};
			};

			state_power_low {
				linux,phandle = <0xa>;
				phandle = <0xa>;

				pins_cmd_dat {
					output-low;
					pinmux = <0x9e00>;
					slew-rate = <0x1>;
				};
			};

			state_reset_high {
				linux,phandle = <0x7>;
				phandle = <0x7>;

				pins_cmd_dat {
					output-high;
					pinmux = <0xab00>;
					slew-rate = <0x1>;
				};
			};

			state_reset_low {
				linux,phandle = <0x6>;
				phandle = <0x6>;

				pins_cmd_dat {
					output-low;
					pinmux = <0xab00>;
					slew-rate = <0x1>;
				};
			};
		};
	};

	fragment@50 {
		target = <0xffffffff>;

		__overlay__ {
			deb-gpios = <0xffffffff 0x37 0x0>;
			debounce = <0x7d000>;
			interrupt-parent = <0xffffffff>;
			interrupts = <0x37 0x4 0x37 0x0>;
			status = "okay";
		};
	};

	fragment@51 {
		target = <0xffffffff>;

		__overlay__ {
			interrupt-parent = <0xffffffff>;
			interrupts = <0x90 0x4 0x90 0x1>;
			status = "okay";
		};
	};

	fragment@52 {
		target = <0xffffffff>;

		__overlay__ {
			compatible = "mediatek,md1_sim1_hot_plug_eint-eint";
			debounce = <0x0 0x2710>;
			dedicated = <0x0 0x0>;
			interrupts = <0x0 0x8>;
			sockettype = <0x0 0x0>;
			src_pin = <0x0 0x1>;
			status = "okay";
		};
	};

	fragment@53 {
		target = <0xffffffff>;

		__overlay__ {
			compatible = "mediatek,md1_sim2_hot_plug_eint-eint";
			debounce = <0x1 0x2710>;
			dedicated = <0x1 0x0>;
			interrupts = <0x1 0x8>;
			sockettype = <0x1 0x0>;
			src_pin = <0x1 0x2>;
			status = "okay";
		};
	};

	fragment@54 {
		target = <0xffffffff>;

		__overlay__ {
			regulator-default-on = <0x1>;
			regulator-name = "vcama";
			status = "okay";
		};
	};

	fragment@55 {
		target = <0xffffffff>;

		__overlay__ {
			regulator-default-on = <0x1>;
			regulator-name = "vsim1";
			status = "okay";
		};
	};

	fragment@56 {
		target = <0xffffffff>;

		__overlay__ {
			regulator-default-on = <0x1>;
			regulator-name = "vsim2";
			status = "okay";
		};
	};

	fragment@57 {
		target = <0xffffffff>;

		__overlay__ {
			regulator-default-on = <0x1>;
			regulator-name = "vcamd";
			status = "okay";
		};
	};

	fragment@58 {
		target = <0xffffffff>;

		__overlay__ {
			regulator-default-on = <0x1>;
			regulator-name = "vcamio";
			status = "okay";
		};
	};

	fragment@59 {
		target = <0xffffffff>;

		__overlay__ {
			regulator-default-on = <0x1>;
			regulator-name = "vldo28";
			status = "okay";
		};
	};

	fragment@6 {
		target = <0xffffffff>;

		__overlay__ {
			pinctrl-0 = <0x5>;
			pinctrl-1 = <0x6>;
			pinctrl-2 = <0x7>;
			pinctrl-3 = <0x8>;
			pinctrl-4 = <0x9>;
			pinctrl-5 = <0xa>;
			pinctrl-6 = <0xb>;
			pinctrl-7 = <0xc>;
			pinctrl-names = "default", "rst-low", "rst-high", "irq-init", "power_high", "power_low", "power18_high", "power18_low";
			status = "okay";
		};
	};

	fragment@60 {
		target = <0xffffffff>;

		__overlay__ {
			status = "okay";
			vcama-supply = <0xffffffff>;
			vcamaf-supply = <0xffffffff>;
			vcamaf_main2-supply = <0xffffffff>;
			vcamaf_sub-supply = <0xffffffff>;
			vcamd_main2-supply = <0xffffffff>;
			vcamio-supply = <0xffffffff>;
			vcamio_main2-supply = <0xffffffff>;
			vcamio_sub-supply = <0xffffffff>;
		};
	};

	fragment@61 {
		target = <0xffffffff>;

		__overlay__ {
			status = "okay";
			vtouch-supply = <0xffffffff>;
		};
	};

	fragment@62 {
		target = <0xffffffff>;

		__overlay__ {
			mediatek,kpd-hw-dl-key0 = <0x11>;
			mediatek,kpd-hw-dl-key1 = <0x1>;
			mediatek,kpd-hw-dl-key2 = <0x8>;
			mediatek,kpd-hw-factory-key = <0x11>;
			mediatek,kpd-hw-init-map = <0x0 0x72 0x0 0x0 0x0 0x0 0x0 0x0 0x0 0x0 0x0 0x0 0x0 0x0 0x0 0x0 0x0 0x0 0x0 0x0 0x0 0x0 0x0 0x0 0x0 0x0 0x0 0x0 0x0 0x0 0x0 0x0 0x0 0x0 0x0 0x0 0x0 0x0 0x0 0x0 0x0 0x0 0x0 0x0 0x0 0x0 0x0 0x0 0x0 0x0 0x0 0x0 0x0 0x0 0x0 0x0 0x0 0x0 0x0 0x0 0x0 0x0 0x0 0x0 0x0 0x0 0x0 0x0 0x0 0x0 0x0 0x0>;
			mediatek,kpd-hw-map-num = <0x48>;
			mediatek,kpd-hw-pwrkey = <0x8>;
			mediatek,kpd-hw-recovery-key = <0x1>;
			mediatek,kpd-hw-rstkey = <0x11>;
			mediatek,kpd-key-debounce = <0x400>;
			mediatek,kpd-pwkey-gpio-din = <0x0>;
			mediatek,kpd-pwrkey-eint-gpio = <0x0>;
			mediatek,kpd-sw-pwrkey = <0x74>;
			mediatek,kpd-sw-rstkey = <0x73>;
			mediatek,kpd-use-extend-type = <0x0>;
			status = "okay";
		};
	};

	fragment@63 {
		target = <0xffffffff>;

		__overlay__ {

			camdefault {
				linux,phandle = <0x2a>;
				phandle = <0x2a>;
			};

			camera0_mclk_2ma@gpio99 {
				linux,phandle = <0x32>;
				phandle = <0x32>;

				pins_cmd_dat {
					drive-strength = <0x2>;
					pinmux = <0x6301>;
				};
			};

			camera0_mclk_gpio_mode@gpio99 {
				linux,phandle = <0x31>;
				phandle = <0x31>;

				pins_cmd_dat {
					drive-strength = <0x1>;
					pinmux = <0x6300>;
				};
			};

			camera0_rst_output_high@gpio101 {
				linux,phandle = <0x2c>;
				phandle = <0x2c>;

				pins_cmd_dat {
					output-high;
					pinmux = <0x6500>;
				};
			};

			camera0_rst_output_low@gpio101 {
				linux,phandle = <0x2b>;
				phandle = <0x2b>;

				pins_cmd_dat {
					output-low;
					pinmux = <0x6500>;
				};
			};

			camera0_vcama_off@gpio156 {
				linux,phandle = <0x37>;
				phandle = <0x37>;

				pins_cmd_dat {
					output-low;
					pinmux = <0x9c00>;
				};
			};

			camera0_vcama_on@gpio156 {
				linux,phandle = <0x38>;
				phandle = <0x38>;

				pins_cmd_dat {
					output-high;
					pinmux = <0x9c00>;
				};
			};

			camera1_mclk_2ma@gpio100 {
				linux,phandle = <0x34>;
				phandle = <0x34>;

				pins_cmd_dat {
					drive-strength = <0x2>;
					pinmux = <0x6401>;
				};
			};

			camera1_mclk_gpio_mode@gpio100 {
				linux,phandle = <0x33>;
				phandle = <0x33>;

				pins_cmd_dat {
					drive-strength = <0x1>;
					pinmux = <0x6400>;
				};
			};

			camera1_rst_output_high@gpio102 {
				linux,phandle = <0x2e>;
				phandle = <0x2e>;

				pins_cmd_dat {
					output-high;
					pinmux = <0x6600>;
				};
			};

			camera1_rst_output_low@gpio102 {
				linux,phandle = <0x2d>;
				phandle = <0x2d>;

				pins_cmd_dat {
					output-low;
					pinmux = <0x6600>;
				};
			};

			camera1_vcama_off@gpio155 {
				linux,phandle = <0x39>;
				phandle = <0x39>;

				pins_cmd_dat {
					output-low;
					pinmux = <0x9b00>;
				};
			};

			camera1_vcama_on@gpio155 {
				linux,phandle = <0x3a>;
				phandle = <0x3a>;

				pins_cmd_dat {
					output-high;
					pinmux = <0x9b00>;
				};
			};

			camera2_mclk_2ma@gpio108 {
				linux,phandle = <0x36>;
				phandle = <0x36>;

				pins_cmd_dat {
					drive-strength = <0x2>;
					pinmux = <0x6c01>;
				};
			};

			camera2_mclk_gpio_mode@gpio108 {
				linux,phandle = <0x35>;
				phandle = <0x35>;

				pins_cmd_dat {
					drive-strength = <0x1>;
					pinmux = <0x6c00>;
				};
			};

			camera2_pnd_output_high@gpio107 {
				linux,phandle = <0x30>;
				phandle = <0x30>;

				pins_cmd_dat {
					output-high;
					pinmux = <0x6b00>;
				};
			};

			camera2_pnd_output_low@gpio107 {
				linux,phandle = <0x2f>;
				phandle = <0x2f>;

				pins_cmd_dat {
					output-low;
					pinmux = <0x6b00>;
				};
			};

			camera3_mclk_2ma@gpio88 {
				linux,phandle = <0x40>;
				phandle = <0x40>;

				pins_cmd_dat {
					drive-strength = <0x2>;
					pinmux = <0x5801>;
				};
			};

			camera3_mclk_gpio_mode@gpio88 {
				linux,phandle = <0x3f>;
				phandle = <0x3f>;

				pins_cmd_dat {
					drive-strength = <0x1>;
					pinmux = <0x5800>;
				};
			};

			camera3_rst_output_high@gpio160 {
				linux,phandle = <0x3e>;
				phandle = <0x3e>;

				pins_cmd_dat {
					output-high;
					pinmux = <0xa000>;
				};
			};

			camera3_rst_output_low@gpio160 {
				linux,phandle = <0x3d>;
				phandle = <0x3d>;

				pins_cmd_dat {
					output-low;
					pinmux = <0xa000>;
				};
			};

			camera3_vcama_off@gpio156 {
				linux,phandle = <0x3b>;
				phandle = <0x3b>;

				pins_cmd_dat {
					output-low;
					pinmux = <0x9c00>;
				};
			};

			camera3_vcama_on@gpio156 {
				linux,phandle = <0x3c>;
				phandle = <0x3c>;

				pins_cmd_dat {
					output-high;
					pinmux = <0x9c00>;
				};
			};
		};
	};

	fragment@64 {
		target = <0xffffffff>;

		__overlay__ {
			cam0_enable_sensor = "hi846_mipi_raw ov13b10_mipi_raw gc8034_mipi_raw hi1336_mipi_raw s5k4h7_mipi_raw";
			cam0_vcama-supply = <0xffffffff>;
			cam0_vcamaf-supply = <0xffffffff>;
			cam0_vcamd-supply = <0xffffffff>;
			cam0_vcamio-supply = <0xffffffff>;
			cam1_enable_sensor = "hi556_mipi_raw gc5035_mipi_raw hi556_txd_mipi_raw";
			cam1_vcama-supply = <0xffffffff>;
			cam1_vcamd-supply = <0xffffffff>;
			cam1_vcamio-supply = <0xffffffff>;
			cam2_enable_sensor = "gc030a_mipi_raw gc02m1b_mipi_raw ov02b1b_mipi_raw gc02m1b_sw_mipi_raw";
			cam2_vcama-supply = <0xffffffff>;
			cam2_vcamd-supply = <0xffffffff>;
			cam2_vcamio-supply = <0xffffffff>;
			cam3_enable_sensor = "ov02b10_mipi_raw gc02m1_mipi_raw gc02m1_sw_mipi_raw";
			cam3_vcamio-supply = <0xffffffff>;
			pinctrl-0 = <0x2a>;
			pinctrl-1 = <0x2b>;
			pinctrl-10 = <0x34>;
			pinctrl-11 = <0x35>;
			pinctrl-12 = <0x36>;
			pinctrl-13 = <0x37>;
			pinctrl-14 = <0x38>;
			pinctrl-15 = <0x39>;
			pinctrl-16 = <0x3a>;
			pinctrl-17 = <0x3b>;
			pinctrl-18 = <0x3c>;
			pinctrl-19 = <0x3d>;
			pinctrl-2 = <0x2c>;
			pinctrl-20 = <0x3e>;
			pinctrl-21 = <0x3f>;
			pinctrl-22 = <0x40>;
			pinctrl-3 = <0x2d>;
			pinctrl-4 = <0x2e>;
			pinctrl-5 = <0x2f>;
			pinctrl-6 = <0x30>;
			pinctrl-7 = <0x31>;
			pinctrl-8 = <0x32>;
			pinctrl-9 = <0x33>;
			pinctrl-names = "default", "cam0_rst0", "cam0_rst1", "cam1_rst0", "cam1_rst1", "cam2_pnd0", "cam2_pnd1", "cam0_mclk_off", "cam0_mclk_on", "cam1_mclk_off", "cam1_mclk_on", "cam2_mclk_off", "cam2_mclk_on", "cam0_vcama_off", "cam0_vcama_on", "cam1_vcama_off", "cam1_vcama_on", "cam3_vcama_off", "cam3_vcama_on", "cam3_rst0", "cam3_rst1", "cam3_mclk_off", "cam3_mclk_on";
			status = "okay";
		};
	};

	fragment@65 {
		target = <0xffffffff>;

		__overlay__ {

			ilitek_spi@0 {
				black_gesture_support;
				black_gesture_test_support;
				charger_pump_support;
				chip-name_focal = "NF_FT8006S_AA";
				chip-name_ft = "NF_FT8722";
				chip-name_himax = "NF_HX83102D";
				chip-name_himax_nf = "NF_HX83112A";
				chip-name_ili = "NF_ILI9882N";
				chip-name_ilitek = "NF_ILI9882H";
				chip-name_nvt = "NF_NT36525B";
				compatible = "tchip,tp_oppo6765";
				drlimit_remove_support;
				fw_edge_limit_support;
				fw_update_app_support;
				fw_update_in_probe_with_headfile;
				game_switch_support;
				headset_pump_support;
				incell_screen;
				interrupt-parent = <0xffffffff>;
				interrupts = <0x0 0x2 0x0 0x0>;
				irq-gpio = <0xffffffff 0x0 0x2002>;
				lcd_trigger_load_tp_fw_support;
				noflash_support;
				pressure_report_support;
				reg = <0x0>;
				reset-gpio = <0xffffffff 0xb2 0x0>;
				smart_gesture_support;
				spi-max-frequency = <0xe4e1c0>;
				status = "ok";
				suspend_gesture_cfg;
				touchpanel,button-type = <0x4>;
				touchpanel,display-coords = <0x2d0 0x640>;
				touchpanel,max-num-support = <0xa>;
				touchpanel,panel-coords = <0x2d0 0x640>;
				touchpanel,touchmajor-limit = <0x0 0x36>;
				touchpanel,tx-rx-num = <0x12 0x20>;
				touchpanel_FT8722,tx-rx-num = <0x12 0x24>;
				touchpanel_HX83112A,tx-rx-num = <0x12 0x24>;
			};
		};
	};

	fragment@7 {
		target = <0xffffffff>;

		__overlay__ {

			gpio_id0_default {
				linux,phandle = <0xd>;
				phandle = <0xd>;

				pins_cmd_dat {
					bias-pull-up = <0x0>;
					pinmux = <0xaa00>;
					slew-rate = <0x0>;
				};
			};

			gpio_id0_pull_down {
				linux,phandle = <0xf>;
				phandle = <0xf>;

				pins_cmd_dat {
					bias-pull-down = <0x0>;
					pinmux = <0xaa00>;
					slew-rate = <0x0>;
				};
			};

			gpio_id0_pull_up {
				linux,phandle = <0xe>;
				phandle = <0xe>;

				pins_cmd_dat {
					bias-pull-up = <0x0>;
					pinmux = <0xaa00>;
					slew-rate = <0x0>;
				};
			};
		};
	};

	fragment@8 {
		target = <0xffffffff>;

		__overlay__ {
			oppo,fp-id0 = <0xffffffff 0xaa 0x0>;
			oppo,fp-id1 = <0xffffffff 0xad 0x0>;
			pinctrl-0 = <0xd>;
			pinctrl-1 = <0xe>;
			pinctrl-2 = <0xf>;
			pinctrl-names = "default", "gpio_id0_pull_up", "gpio_id0_pull_down";
		};
	};

	fragment@9 {
		target = <0xffffffff>;

		__overlay__ {

			lcd_bias_enn0_gpio {
				linux,phandle = <0x14>;
				phandle = <0x14>;

				pins_cmd_dat {
					output-low;
					pinmux = <0xa500>;
					slew-rate = <0x1>;
				};
			};

			lcd_bias_enn1_gpio {
				linux,phandle = <0x15>;
				phandle = <0x15>;

				pins_cmd_dat {
					output-high;
					pinmux = <0xa500>;
					slew-rate = <0x1>;
				};
			};

			lcd_bias_enp0_gpio {
				linux,phandle = <0x12>;
				phandle = <0x12>;

				pins_cmd_dat {
					output-low;
					pinmux = <0xa600>;
					slew-rate = <0x1>;
				};
			};

			lcd_bias_enp1_gpio {
				linux,phandle = <0x13>;
				phandle = <0x13>;

				pins_cmd_dat {
					output-high;
					pinmux = <0xa600>;
					slew-rate = <0x1>;
				};
			};

			lcm_rst_out0_gpio {
				linux,phandle = <0x10>;
				phandle = <0x10>;

				pins_cmd_dat {
					output-low;
					pinmux = <0x2d00>;
					slew-rate = <0x1>;
				};
			};

			lcm_rst_out1_gpio {
				linux,phandle = <0x11>;
				phandle = <0x11>;

				pins_cmd_dat {
					output-high;
					pinmux = <0x2d00>;
					slew-rate = <0x1>;
				};
			};
		};
	};
};
