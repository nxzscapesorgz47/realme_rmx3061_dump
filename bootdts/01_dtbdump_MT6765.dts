/dts-v1/;

/ {
	#address-cells = <0x2>;
	#size-cells = <0x2>;
	compatible = "mediatek,MT6765";
	interrupt-parent = <0x1>;
	model = "MT6765";

	__symbols__ {
		DPIDLE = "/cpus/idle-states/dpidle";
		MCDI_CLUSTER = "/cpus/idle-states/mcdi-cluster";
		MCDI_CPU = "/cpus/idle-states/mcdi-cpu";
		SODI = "/cpus/idle-states/sodi";
		SODI3 = "/cpus/idle-states/sodi3";
		STANDBY = "/cpus/idle-states/standby";
		SUSPEND = "/cpus/idle-states/suspend";
		accdet = "/accdet";
		alsps_mtk = "/alsps_mtk";
		apdma = "/dma-controller@11000580";
		apmixed = "/apmixed@1000c000";
		audgpio = "/mt_soc_dl1_pcm@11220000";
		audio = "/audio@11220000";
		auxadc = "/auxadc@11001000";
		bat_gm30 = "/battery";
		btcvsd_snd = "/mtk-btcvsd-snd@18050000";
		camsys = "/camsys@1a000000";
		charger = "/charger";
		chosen = "/chosen";
		chr_stat = "/chr_stat";
		clk26m = "/clocks/clk26m";
		clk32k = "/clocks/clk32k";
		consys = "/consys@18002000";
		cpu0 = "/cpus/cpu@000";
		cpu1 = "/cpus/cpu@001";
		cpu2 = "/cpus/cpu@002";
		cpu3 = "/cpus/cpu@003";
		cpu4 = "/cpus/cpu@100";
		cpu5 = "/cpus/cpu@101";
		cpu6 = "/cpus/cpu@102";
		cpu7 = "/cpus/cpu@103";
		cpu_dbgapb = "/cpu_dbgapb@0d410000";
		disp_color0 = "/disp_color0@1400f000";
		disp_mutex0 = "/disp_mutex0@14001000";
		dsi_te = "/dsi_te";
		dynamic_options = "/dynamic_options";
		flashlight_core = "/flashlight_core";
		flashlight_ntc_adc = "/flashlight_ntc";
		flashlight_pins_default = "/pinctrl@1000b000/flashlight_pins_default";
		flashlight_pins_srobe_off = "/pinctrl@1000b000/flashlight_pins_srobe_off";
		flashlight_pins_srobe_on = "/pinctrl@1000b000/flashlight_pins_srobe_on";
		flashlight_pins_torch_off = "/pinctrl@1000b000/flashlight_pins_torch_off";
		flashlight_pins_torch_on = "/pinctrl@1000b000/flashlight_pins_torch_on";
		flashlight_pins_torch_pwm = "/pinctrl@1000b000/flashlight_pins_torch_pwm";
		flashlights_gpio = "/flashlights_gpio";
		flashlights_mt6370 = "/flashlights_mt6370";
		fpc_interrupt = "/fpc_interrupt";
		gce = "/gce@10238000";
		gce_mbox = "/gce_mbox@10238000";
		gce_mbox_svp = "/gce_mbox_svp@10238000";
		gic = "/interrupt-controller@0c000000";
		goodix_fp = "/fingerprint";
		gpio = "/gpio@10005000";
		gpio_usage_mapping = "/gpio";
		gse_1 = "/gse_1";
		i2c0 = "/i2c0@11007000";
		i2c1 = "/i2c1@11008000";
		i2c2 = "/i2c2@11009000";
		i2c3 = "/i2c3@1100f000";
		i2c4 = "/i2c4@11011000";
		i2c5 = "/i2c5@11016000";
		i2c6 = "/i2c6@1100d000";
		i2c7 = "/i2c7";
		i2c8 = "/i2c8";
		i2c9 = "/i2c9";
		i2c_common = "/i2c_common";
		iddig_high = "/pinctrl@1000b000/iddig_high";
		iddig_low = "/pinctrl@1000b000/iddig_low";
		imgsys = "/imgsys@15020000";
		infracfg_ao = "/infracfg_ao@10001000";
		iommu = "/m4u@10205000";
		irq_nfc = "/irq_nfc";
		irtx_pwm = "/irtx_pwm";
		kd_camera_hw1 = "/kd_camera_hw1@1a040000";
		keypad = "/kp@10010000";
		lcd_bias = "/lcd_bias";
		lcd_bias_pins_default = "/pinctrl@1000b000/default";
		lcd_bias_pins_enn0 = "/pinctrl@1000b000/lcd_bias_gpio_enn0";
		lcd_bias_pins_enn1 = "/pinctrl@1000b000/lcd_bias_gpio_enn1";
		lcd_bias_pins_enp0 = "/pinctrl@1000b000/lcd_bias_gpio_enp0";
		lcd_bias_pins_enp1 = "/pinctrl@1000b000/lcd_bias_gpio_enp1";
		lcm = "/lcm";
		lk_charger = "/lk_charger";
		main_pmic = "/mt-pmic";
		md1_sim1_hot_plug_eint = "/md1_sim1_hot_plug_eint";
		md1_sim2_hot_plug_eint = "/md1_sim2_hot_plug_eint";
		mdcldma = "/mdcldma@10014000";
		mdp_ccorr = "/mdp_ccorr0@14005000";
		mdp_rdma0 = "/mdp_rdma0@14004000";
		mdp_rsz0 = "/mdp_rsz0@14006000";
		mdp_rsz1 = "/mdp_rsz1@14007000";
		mdp_tdshp0 = "/mdp_tdshp0@1400a000";
		mdp_wdma0 = "/mdp_wdma0@14008000";
		mdp_wrot0 = "/mdp_wrot0@14009000";
		memory_ssmr_features = "/memory-ssmr-features";
		mfg_cfg = "/mfg_cfg@13ffe000";
		mipi_rx_ana_csi0a = "/mipi_rx_ana_csi0a@11c10000";
		mipi_rx_ana_csi0b = "/mipi_rx_ana_csi0b@11c11000";
		mipi_rx_ana_csi1a = "/mipi_rx_ana_csi1a@11c12000";
		mipi_rx_ana_csi1b = "/mipi_rx_ana_csi1b@11c13000";
		mipi_rx_ana_csi2a = "/mipi_rx_ana_csi2a@11c14000";
		mipi_rx_ana_csi2b = "/mipi_rx_ana_csi2b@11c15000";
		mmsys_config = "/mmsys_config@14000000";
		mrdump_ext_rst = "/mrdump_ext_rst";
		msdc0 = "/msdc@11230000";
		msdc0_pins_default = "/pinctrl@1000b000/msdc0@default";
		msdc0_pins_hs200 = "/pinctrl@1000b000/msdc0@hs200";
		msdc0_pins_hs400 = "/pinctrl@1000b000/msdc0@hs400";
		msdc0_register_setting_default = "/pinctrl@1000b000/msdc0@register_default";
		msdc1 = "/msdc@11240000";
		msdc1_ins = "/msdc1_ins@0";
		msdc1_pins_ddr50 = "/pinctrl@1000b000/msdc1@ddr50";
		msdc1_pins_default = "/pinctrl@1000b000/msdc1@default";
		msdc1_pins_sdr104 = "/pinctrl@1000b000/msdc1@sdr104";
		msdc1_pins_sdr50 = "/pinctrl@1000b000/msdc1@sdr50";
		msdc1_register_setting_default = "/pinctrl@1000b000/msdc1@register_default";
		msdc2 = "/msdc@11250000";
		msdc3 = "/msdc@11260000";
		msdc3_pins_default = "/pinctrl@1000b000/msdc3@default";
		msdc3_register_setting_default = "/pinctrl@1000b000/msdc3@register_default";
		mt6370_pmu = "/mt6370_pmu_dts";
		mt6370_typec = "/type_c_port0";
		mt_charger = "/mt_charger";
		mt_pmic_vaud28_ldo_reg = "/mt-pmic/ldo_regulators/ldo_vaud28";
		mt_pmic_vaux18_ldo_reg = "/mt-pmic/ldo_regulators/ldo_vaux18";
		mt_pmic_vcama_ldo_reg = "/mt-pmic/ldo_regulators/ldo_vcama";
		mt_pmic_vcamd_ldo_reg = "/mt-pmic/ldo_regulators/ldo_vcamd";
		mt_pmic_vcamio_ldo_reg = "/mt-pmic/ldo_regulators/ldo_vcamio";
		mt_pmic_vcn18_ldo_reg = "/mt-pmic/ldo_regulators/ldo_vcn18";
		mt_pmic_vcn28_ldo_reg = "/mt-pmic/ldo_regulators/ldo_vcn28";
		mt_pmic_vcn33_bt_ldo_reg = "/mt-pmic/ldo_regulators/ldo_vcn33_bt";
		mt_pmic_vcn33_wifi_ldo_reg = "/mt-pmic/ldo_regulators/ldo_vcn33_wifi";
		mt_pmic_vcore_buck_reg = "/mt-pmic/buck_regulators/buck_vcore";
		mt_pmic_vdram_ldo_reg = "/mt-pmic/ldo_regulators/ldo_vdram";
		mt_pmic_vefuse_ldo_reg = "/mt-pmic/ldo_regulators/ldo_vefuse";
		mt_pmic_vemc_ldo_reg = "/mt-pmic/ldo_regulators/ldo_vemc";
		mt_pmic_vfe28_ldo_reg = "/mt-pmic/ldo_regulators/ldo_vfe28";
		mt_pmic_vibr_ldo_reg = "/mt-pmic/ldo_regulators/ldo_vibr";
		mt_pmic_vio18_ldo_reg = "/mt-pmic/ldo_regulators/ldo_vio18";
		mt_pmic_vio28_ldo_reg = "/mt-pmic/ldo_regulators/ldo_vio28";
		mt_pmic_vldo28_ldo_reg = "/mt-pmic/ldo_regulators/ldo_vldo28";
		mt_pmic_vmc_ldo_reg = "/mt-pmic/ldo_regulators/ldo_vmc";
		mt_pmic_vmch_ldo_reg = "/mt-pmic/ldo_regulators/ldo_vmch";
		mt_pmic_vmodem_buck_reg = "/mt-pmic/buck_regulators/buck_vmodem";
		mt_pmic_vpa_buck_reg = "/mt-pmic/buck_regulators/buck_vpa";
		mt_pmic_vproc_buck_reg = "/mt-pmic/buck_regulators/buck_vproc";
		mt_pmic_vrf12_ldo_reg = "/mt-pmic/ldo_regulators/ldo_vrf12";
		mt_pmic_vrf18_ldo_reg = "/mt-pmic/ldo_regulators/ldo_vrf18";
		mt_pmic_vs1_buck_reg = "/mt-pmic/buck_regulators/buck_vs1";
		mt_pmic_vsim1_ldo_reg = "/mt-pmic/ldo_regulators/ldo_vsim1";
		mt_pmic_vsim2_ldo_reg = "/mt-pmic/ldo_regulators/ldo_vsim2";
		mt_pmic_vsram_others_ldo_reg = "/mt-pmic/ldo_regulators/ldo_vsram_others";
		mt_pmic_vsram_proc_ldo_reg = "/mt-pmic/ldo_regulators/ldo_vsram_proc";
		mt_pmic_vusb33_ldo_reg = "/mt-pmic/ldo_regulators/ldo_vusb33";
		mt_pmic_vxo22_ldo_reg = "/mt-pmic/ldo_regulators/ldo_vxo22";
		mtkfb = "/mtkfb@0";
		nfc553 = "/nfc553";
		nfc_default = "/pinctrl@1000b000/nfc_default";
		nfc_dwn_high = "/pinctrl@1000b000/nfc_dwn_high";
		nfc_dwn_low = "/pinctrl@1000b000/nfc_dwn_low";
		nfc_eint_as_int = "/pinctrl@1000b000/nfc_eint_as_int";
		nfc_ven_high = "/pinctrl@1000b000/nfc_ven_high";
		nfc_ven_low = "/pinctrl@1000b000/nfc_ven_low";
		odm = "/odm";
		oppo_fp_common = "/oppo_fp_common";
		oppo_secure_common = "/oppo_secure_common";
		otg_iddig = "/otg_iddig";
		pericfg = "/pericfg@10003000";
		pio = "/pinctrl@1000b000";
		pmic_auxadc = "/mt-pmic/mt635x-auxadc";
		pmic_clock_buffer_ctrl = "/pmic_clock_buffer_ctrl";
		pwm = "/pwm@11006000";
		radio_md_cfg = "/radio_md_cfg";
		reserved_memory = "/reserved-memory";
		rt9465_slave_chr = "/rt9465_slave_chr";
		scpsys = "/scpsys@10001000";
		silead_fp = "/silead_fp";
		smart_pa = "/smart_pa";
		smi_larb0 = "/smi_larb0@14003000";
		smi_larb1 = "/smi_larb1@17010000";
		smi_larb2 = "/smi_larb2@15021000";
		smi_larb3 = "/smi_larb3@1a002000";
		spi0 = "/spi@1100a000";
		spi1 = "/spi@11010000";
		spi2 = "/spi@11012000";
		spi3 = "/spi@11013000";
		spi4 = "/spi@11014000";
		spi5 = "/spi@11015000";
		subpmic_pmu_eint = "/mt6370_pmu_eint";
		swtp = "/swtp";
		syscfg_pctl_0 = "/syscfg_pctl_0@10005000";
		syscfg_pctl_1 = "/syscfg_pctl_1@0x10002000";
		syscfg_pctl_2 = "/syscfg_pctl_2@0x10002200";
		syscfg_pctl_3 = "/syscfg_pctl_3@0x10002400";
		syscfg_pctl_4 = "/syscfg_pctl_4@0x10002600";
		syscfg_pctl_5 = "/syscfg_pctl_5@0x10002800";
		syscfg_pctl_6 = "/syscfg_pctl_6@0x10002a00";
		syscfg_pctl_7 = "/syscfg_pctl_7@0x10002c00";
		sysirq = "/intpol-controller@10200a80";
		tcpc_pd = "/mt6370_pd_eint";
		topckgen = "/topckgen@10000000";
		touch = "/touch";
		uart0 = "/serial@11020000";
		uart1 = "/serial@11030000";
		venc_gcon = "/venc_gcon@17000000";
	};

	accdet {
		compatible = "mediatek,pmic-accdet";
		linux,phandle = <0x8b>;
		phandle = <0x8b>;
	};

	aes_top0@10016000 {
		compatible = "mediatek,aes_top0";
		reg = <0x0 0x10016000 0x0 0x1000>;
	};

	alsps_mtk {
		linux,phandle = <0xc4>;
		phandle = <0xc4>;
	};

	amms_control {
		compatible = "mediatek,amms";
		interrupts = <0x0 0x86 0x1>;
	};

	ap_ccif0@10209000 {
		compatible = "mediatek,ap_ccif0";
		interrupts = <0x0 0x94 0x8>;
		reg = <0x0 0x10209000 0x0 0x1000>;
	};

	ap_ccif1@1020b000 {
		compatible = "mediatek,ap_ccif1";
		interrupts = <0x0 0x96 0x8>;
		reg = <0x0 0x1020b000 0x0 0x1000>;
	};

	ap_ccif2@1023c000 {
		compatible = "mediatek,ap_ccif2";
		interrupts = <0x0 0x8f 0x8>;
		reg = <0x0 0x1023c000 0x0 0x1000>;
	};

	ap_ccif3@1023e000 {
		compatible = "mediatek,ap_ccif3";
		interrupts = <0x0 0x92 0x8>;
		reg = <0x0 0x1023e000 0x0 0x1000>;
	};

	ap_dma@11000000 {
		compatible = "mediatek,ap_dma";
		interrupts = <0x0 0x61 0x8>;
		reg = <0x0 0x11000000 0x0 0x1000>;
	};

	apcldmain@1021b000 {
		compatible = "mediatek,apcldmain";
		reg = <0x0 0x1021b000 0x0 0x0>;
	};

	apcldmain_ao@10014000 {
		compatible = "mediatek,apcldmain_ao";
		reg = <0x0 0x10014000 0x0 0x400>;
	};

	apcldmamisc@1021b800 {
		compatible = "mediatek,apcldmamisc";
		interrupts = <0x0 0xa5 0x4>;
		reg = <0x0 0x1021b800 0x0 0x0>;
	};

	apcldmamisc_ao@10014800 {
		compatible = "mediatek,apcldmamisc_ao";
		reg = <0x0 0x10014800 0x0 0x400>;
	};

	apcldmaout@1021b400 {
		compatible = "mediatek,apcldmaout";
		reg = <0x0 0x1021b400 0x0 0x0>;
	};

	apcldmaout_ao@10014400 {
		compatible = "mediatek,apcldmaout_ao";
		reg = <0x0 0x10014400 0x0 0x400>;
	};

	apmixed@1000c000 {
		#clock-cells = <0x1>;
		compatible = "mediatek,apmixed", "syscon";
		linux,phandle = <0x44>;
		phandle = <0x44>;
		reg = <0x0 0x1000c000 0x0 0x1000>;
	};

	apxgpt@10008000 {
		clocks = <0x1d>;
		compatible = "mediatek,apxgpt";
		interrupts = <0x0 0xaa 0x8>;
		reg = <0x0 0x10008000 0x0 0x1000>;
	};

	atf_logger {
		compatible = "mediatek,atf_logger";
		interrupts = <0x0 0xf7 0x1>;
	};

	audio@11220000 {
		#clock-cells = <0x1>;
		compatible = "mediatek,audio", "syscon";
		linux,phandle = <0x43>;
		mediatek,btcvsd_snd = <0x42>;
		phandle = <0x43>;
		reg = <0x0 0x11220000 0x0 0x1000>;
	};

	audio_snd_card {
		compatible = "mediatek,audio_snd_card";
	};

	audio_sram@11221000 {
		compatible = "mediatek,audio_sram";
		reg = <0x0 0x11221000 0x0 0x9000>;
	};

	auxadc@11001000 {
		clock-names = "auxadc-main";
		clocks = <0x27 0x21>;
		compatible = "mediatek,auxadc";
		interrupts = <0x0 0x4c 0x2>;
		linux,phandle = <0x94>;
		phandle = <0x94>;
		reg = <0x0 0x11001000 0x0 0x10000>;
	};

	battery {
		CAR_TUNE_VALUE = <0x62>;
		DIFFERENCE_FULLOCV_ITH = <0xc8>;
		EMBEDDED_SEL = <0x1>;
		FG_METER_RESISTANCE = <0x4b>;
		KEEP_100_PERCENT = <0x1>;
		PMIC_MIN_VOL = <0x82dc>;
		PMIC_SHUTDOWN_CURRENT = <0x14>;
		POWERON_SYSTEM_IBOOT = <0x1f4>;
		Q_MAX_SYS_VOLTAGE_BAT0 = <0xd48>;
		Q_MAX_SYS_VOLTAGE_BAT1 = <0xd48>;
		Q_MAX_SYS_VOLTAGE_BAT2 = <0xd48>;
		Q_MAX_SYS_VOLTAGE_BAT3 = <0xd48>;
		R_FG_VALUE = <0xa>;
		SHUTDOWN_1_TIME = <0x1e>;
		SHUTDOWN_GAUGE0_VOLTAGE = <0x84d0>;
		TEMPERATURE_T0 = <0x32>;
		TEMPERATURE_T1 = <0x19>;
		TEMPERATURE_T2 = <0xa>;
		TEMPERATURE_T3 = <0x0>;
		TEMPERATURE_T4 = <0xfffffff6>;
		battery0_profile_t0 = <0x0 0xaba4 0x384 0x203 0xab23 0x384 0x407 0xaaa9 0x384 0x60a 0xaa37 0x392 0x80e 0xa9c7 0x3a8 0xa11 0xa955 0x3af 0xc15 0xa8de 0x3a1 0xe18 0xa86e 0x3b6 0x101c 0xa7f6 0x3b6 0x121f 0xa77e 0x3a4 0x1423 0xa705 0x39d 0x1626 0xa68d 0x3a8 0x1829 0xa615 0x3b6 0x1a2d 0xa59c 0x3c9 0x1c30 0xa521 0x429 0x1e34 0xa4a8 0x3d3 0x2037 0xa430 0x3c6 0x223b 0xa3b8 0x3cf 0x243e 0xa33f 0x3c6 0x2642 0xa2c7 0x3b6 0x2845 0xa250 0x3b8 0x2a49 0xa1e0 0x3cd 0x2c4c 0xa168 0x3bb 0x2e4f 0xa0f6 0x3c6 0x3053 0xa087 0x3cf 0x3256 0xa017 0x3cf 0x345a 0x9faa 0x3d4 0x365d 0x9f43 0x3e8 0x3861 0x9edb 0x3e8 0x3a64 0x9e74 0x3e8 0x3c68 0x9e0d 0x3e8 0x3e6b 0x9dab 0x3f5 0x406f 0x9d49 0x401 0x4272 0x9ce7 0x407 0x4475 0x9c90 0x41a 0x4679 0x9c30 0x41a 0x487c 0x9bd9 0x42f 0x4a80 0x9b83 0x455 0x4c83 0x9b28 0x465 0x4e87 0x9aca 0x46f 0x508a 0x9a66 0x477 0x528e 0x99f1 0x459 0x5491 0x995f 0x403 0x5695 0x98d5 0x3c2 0x5898 0x986f 0x3b6 0x5a9b 0x981c 0x3b6 0x5c9f 0x97ce 0x3ac 0x5ea2 0x9787 0x3a4 0x60a6 0x974a 0x3b6 0x62a9 0x970e 0x3b6 0x64ad 0x96d2 0x3b6 0x66b0 0x9696 0x3a4 0x68b4 0x9660 0x39d 0x6ab7 0x962c 0x3a8 0x6cbb 0x95fb 0x3b6 0x6ebe 0x95cf 0x3b6 0x70c1 0x959c 0x3b6 0x72c5 0x9571 0x3b6 0x74c8 0x954d 0x3c8 0x76cc 0x9525 0x3cf 0x78cf 0x94fe 0x3da 0x7ad3 0x94dc 0x3e8 0x7cd6 0x94b8 0x3e4 0x7eda 0x948d 0x3d0 0x80dd 0x9474 0x3fb 0x82e1 0x9452 0x401 0x84e4 0x9430 0x401 0x86e7 0x940e 0x40c 0x88eb 0x93e5 0x412 0x8aee 0x93aa 0x3f3 0x8cf2 0x9354 0x3b6 0x8ef5 0x930f 0x3b6 0x90f9 0x92da 0x3b6 0x92fc 0x92ac 0x3c6 0x9500 0x927d 0x3c3 0x9703 0x924d 0x3bf 0x9907 0x9222 0x3cf 0x9b0a 0x91f7 0x3cf 0x9d0d 0x91d5 0x3cf 0x9f11 0x91ab 0x3e3 0xa114 0x9179 0x3e8 0xa318 0x913c 0x3db 0xa51b 0x90fb 0x3cf 0xa71f 0x90bf 0x3d5 0xa922 0x9080 0x3e4 0xab26 0x902a 0x3b9 0xad29 0x8fec 0x3a2 0xaf2d 0x8fd7 0x3ad 0xb130 0x8fcf 0x3d0 0xb333 0x8fc2 0x3f1 0xb537 0x8faf 0x413 0xb73a 0x8f91 0x451 0xb93e 0x8f55 0x47c 0xbb41 0x8e3e 0x418 0xbd45 0x8c86 0x423 0xbf48 0x8a30 0x44e 0xc14c 0x86fa 0x4a9 0xc34f 0x81b1 0x909 0xc553 0x785a 0x1991 0xc756 0x74ae 0x12d9>;
		battery0_profile_t0_col = <0x3>;
		battery0_profile_t0_num = <0x64>;
		battery0_profile_t1 = <0x0 0xabea 0x4ce 0x203 0xab72 0x4ca 0x407 0xab08 0x4db 0x60a 0xaa9b 0x4e2 0x80e 0xaa2b 0x4d7 0xa11 0xa9bc 0x4c9 0xc15 0xa94c 0x4cd 0xe18 0xa8dc 0x4e2 0x101c 0xa86d 0x4f8 0x121f 0xa7f6 0x4e9 0x1423 0xa77d 0x4e2 0x1626 0xa701 0x4d7 0x1829 0xa683 0x4c9 0x1a2d 0xa60a 0x4e0 0x1c30 0xa58f 0x553 0x1e34 0xa516 0x4ff 0x2037 0xa49e 0x4e2 0x223b 0xa426 0x4e2 0x243e 0xa3ad 0x4e2 0x2642 0xa335 0x4e2 0x2845 0xa2be 0x4e4 0x2a49 0xa24e 0x4f9 0x2c4c 0xa1d6 0x4fb 0x2e4f 0xa164 0x4fb 0x3053 0xa0f5 0x508 0x3256 0xa085 0x514 0x345a 0xa015 0x514 0x365d 0x9fa7 0x516 0x3861 0x9f3f 0x52b 0x3a64 0x9ed8 0x52d 0x3c68 0x9e71 0x53d 0x3e6b 0x9e0a 0x553 0x406f 0x9da7 0x568 0x4272 0x9d48 0x57e 0x4475 0x9cea 0x593 0x4679 0x9c8a 0x5a9 0x487c 0x9c2b 0x5bf 0x4a80 0x9bcd 0x5d4 0x4c83 0x9b6e 0x5ea 0x4e87 0x9b0b 0x5eb 0x508a 0x9aa2 0x5d5 0x528e 0x9a31 0x5ba 0x5491 0x99b9 0x579 0x5695 0x992f 0x524 0x5898 0x98bb 0x4f1 0x5a9b 0x9857 0x4d4 0x5c9f 0x9800 0x4bf 0x5ea2 0x97b3 0x4a9 0x60a6 0x9768 0x497 0x62a9 0x972c 0x497 0x64ad 0x96f0 0x497 0x66b0 0x96b4 0x497 0x68b4 0x967e 0x497 0x6ab7 0x964a 0x497 0x6cbb 0x9619 0x49e 0x6ebe 0x95ed 0x4ac 0x70c1 0x95ba 0x497 0x72c5 0x9597 0x4c2 0x74c8 0x956e 0x4c9 0x76cc 0x9543 0x4c9 0x78cf 0x951c 0x4c9 0x7ad3 0x94fa 0x4d1 0x7cd6 0x94d7 0x4e2 0x7eda 0x94b5 0x4e2 0x80dd 0x9493 0x4e2 0x82e1 0x9470 0x4e2 0x84e4 0x9454 0x4f1 0x86e7 0x9436 0x4fb 0x88eb 0x9413 0x4f3 0x8aee 0x93f3 0x4e7 0x8cf2 0x93d7 0x4fa 0x8ef5 0x93ac 0x4e4 0x90f9 0x9381 0x4cf 0x92fc 0x9356 0x4b9 0x9500 0x932c 0x4b0 0x9703 0x92fd 0x4a7 0x9907 0x92ce 0x49c 0x9b0a 0x92ab 0x4ae 0x9d0d 0x9280 0x499 0x9f11 0x9264 0x4be 0xa114 0x9237 0x4a9 0xa318 0x9204 0x4a4 0xa51b 0x91c9 0x4b0 0xa71f 0x9187 0x4b0 0xa922 0x914a 0x4b0 0xab26 0x910e 0x4b0 0xad29 0x90ba 0x4b0 0xaf2d 0x907f 0x4b0 0xb130 0x9060 0x4b0 0xb333 0x904e 0x4b9 0xb537 0x9040 0x4d5 0xb73a 0x9035 0x500 0xb93e 0x901b 0x52b 0xbb41 0x8fd9 0x56a 0xbd45 0x8ee6 0x556 0xbf48 0x8d38 0x561 0xc14c 0x8ad7 0x59f 0xc34f 0x8787 0x627 0xc553 0x8237 0xa55 0xc756 0x779c 0x19af>;
		battery0_profile_t1_col = <0x3>;
		battery0_profile_t1_num = <0x64>;
		battery0_profile_t2 = <0x0 0xac12 0x820 0x83e 0x203 0xab91 0x81c 0x839 0x407 0xab1f 0x81b 0x839 0x60a 0xaab5 0x838 0x849 0x80e 0xaa49 0x84d 0x844 0xa11 0xa9dd 0x84d 0x751 0xc15 0xa974 0x84d 0x741 0xe18 0xa904 0x84d 0x714 0x101c 0xa88c 0x837 0x760 0x121f 0xa814 0x834 0x742 0x1423 0xa79b 0x834 0x704 0x1626 0xa723 0x834 0x69f 0x1829 0xa6ab 0x82c 0x66d 0x1a2d 0xa632 0x844 0x676 0x1c30 0xa5b7 0x918 0x643 0x1e34 0xa53e 0x86e 0x646 0x2037 0xa4c6 0x834 0x6ac 0x223b 0xa449 0x834 0x62a 0x243e 0xa3cf 0x834 0x637 0x2642 0xa35d 0x834 0x62b 0x2845 0xa2e5 0x834 0x62c 0x2a49 0xa26d 0x834 0x612 0x2c4c 0xa1f4 0x834 0x630 0x2e4f 0xa182 0x844 0x68e 0x3053 0xa113 0x85a 0x62d 0x3256 0xa0a3 0x866 0x67f 0x345a 0xa033 0x86b 0x67c 0x365d 0x9fc4 0x87f 0x645 0x3861 0x9f54 0x87f 0x694 0x3a64 0x9ef4 0x893 0x665 0x3c68 0x9e8f 0x8b9 0x6bb 0x3e6b 0x9e28 0x8ca 0x6ca 0x406f 0x9dbd 0x8dd 0x6d1 0x4272 0x9d4e 0x902 0x6ba 0x4475 0x9ce7 0x915 0x670 0x4679 0x9c80 0x915 0x705 0x487c 0x9c21 0x915 0x6c0 0x4a80 0x9bc9 0x915 0x6ec 0x4c83 0x9b69 0x915 0x6ef 0x4e87 0x9afd 0x901 0x714 0x508a 0x9a8b 0x8d6 0x6df 0x528e 0x9a12 0x8a5 0x7c0 0x5491 0x9991 0x84f 0x751 0x5695 0x9918 0x80e 0x7c0 0x5898 0x98a7 0x7ce 0x806 0x5a9b 0x9843 0x7a9 0x7e5 0x5c9f 0x97ec 0x789 0x8ad 0x5ea2 0x979f 0x76c 0x8ad 0x60a6 0x9754 0x76f 0x86b 0x62a9 0x9718 0x785 0x8df 0x64ad 0x96d4 0x770 0x92f 0x66b0 0x969d 0x77e 0x84d 0x68b4 0x9664 0x777 0x8a5 0x6ab7 0x962c 0x777 0x8ad 0x6cbb 0x95f9 0x785 0x8ed 0x6ebe 0x95c7 0x789 0x8b6 0x70c1 0x959c 0x79e 0x930 0x72c5 0x9571 0x79e 0x8f2 0x74c8 0x9546 0x7b0 0x856 0x76cc 0x951b 0x7b7 0x860 0x78cf 0x94f0 0x7b7 0x8df 0x7ad3 0x94c8 0x7bf 0x857 0x7cd6 0x94a5 0x7d4 0x97e 0x7eda 0x9483 0x7ea 0x97f 0x80dd 0x946a 0x7ff 0x9a7 0x82e1 0x9448 0x7ef 0x95e 0x84e4 0x9426 0x7f8 0x946 0x86e7 0x9408 0x80e 0x997 0x88eb 0x93ee 0x81b 0x957 0x8aee 0x93d4 0x81b 0x9cf 0x8cf2 0x93ba 0x81c 0x940 0x8ef5 0x93a1 0x832 0x9c0 0x90f9 0x9387 0x821 0x951 0x92fc 0x936d 0x81b 0x9d6 0x9500 0x934e 0x81b 0x942 0x9703 0x932c 0x824 0x942 0x9907 0x9308 0x839 0x9e2 0x9b0a 0x92dd 0x84d 0x9d1 0x9d0d 0x92b2 0x84d 0x970 0x9f11 0x928f 0x888 0x8f5 0xa114 0x9266 0x8b8 0x90c 0xa318 0x9231 0x8e3 0x906 0xa51b 0x91f1 0x917 0x8d6 0xa71f 0x91ac 0x952 0x8cf 0xa922 0x9168 0x981 0x8a4 0xab26 0x912c 0x9d7 0x881 0xad29 0x90d0 0xa19 0x87c 0xaf2d 0x9085 0xa8b 0x81a 0xb130 0x9055 0xb0c 0x838 0xb333 0x9037 0xb9f 0x859 0xb537 0x901b 0xc51 0x872 0xb73a 0x8ff8 0xd27 0x8bd 0xb93e 0x8fd6 0xeaa 0x866 0xbb41 0x8f93 0x107e 0x758 0xbd45 0x8edc 0x12cc 0x7a7 0xbf48 0x8d56 0x15a5 0x70f 0xc14c 0x8b03 0x1a62 0x5af 0xc34f 0x87c7 0x24ce 0x48e 0xc553 0x8326 0x3490 0x436 0xc756 0x7c92 0x262f 0x436>;
		battery0_profile_t2_col = <0x4>;
		battery0_profile_t2_num = <0x64>;
		battery0_profile_t3 = <0x0 0xac26 0xea6 0x4d8 0x203 0xab94 0xea6 0x4d3 0x407 0xab10 0xeee 0x92e 0x60a 0xaa9b 0xf18 0xaae 0x80e 0xaa2b 0xf23 0xa70 0xa11 0xa9b9 0xf1c 0xa43 0xc15 0xa942 0xf0e 0xa00 0xe18 0xa8d2 0xf22 0x9ce 0x101c 0xa85a 0xef7 0x9a3 0x121f 0xa7e2 0xedf 0x9c6 0x1423 0xa769 0xeba 0x98d 0x1626 0xa6f1 0xea6 0x941 0x1829 0xa679 0xea6 0x93a 0x1a2d 0xa600 0xee6 0x914 0x1c30 0xa585 0x102d 0x90c 0x1e34 0xa50c 0xf08 0x8d3 0x2037 0xa48e 0xe77 0x8bb 0x223b 0xa417 0xe67 0x8c5 0x243e 0xa3a3 0xe74 0x8b2 0x2642 0xa32b 0xe6a 0x8a2 0x2845 0xa2b4 0xe45 0x8af 0x2a49 0xa244 0xe70 0x8a9 0x2c4c 0xa1cc 0xe60 0x89c 0x2e4f 0xa15a 0xe5b 0x89b 0x3053 0xa0eb 0xe68 0x8a0 0x3256 0xa07b 0xe6b 0x898 0x345a 0xa00b 0xe60 0x89a 0x365d 0x9f9d 0xe78 0x8b7 0x3861 0x9f3f 0xea3 0x8ca 0x3a64 0x9ed0 0xeba 0x8c8 0x3c68 0x9e61 0xeaf 0x8ce 0x3e6b 0x9df1 0xeb3 0x8f7 0x406f 0x9d7e 0xebf 0x90a 0x4272 0x9d08 0xebf 0x939 0x4475 0x9c98 0xeb6 0x962 0x4679 0x9c26 0xe5e 0x985 0x487c 0x9bbf 0xe5b 0x9ab 0x4a80 0x9b5f 0xe39 0x9c6 0x4c83 0x9af5 0xe37 0x9ef 0x4e87 0x9a85 0xe0f 0xa08 0x508a 0x9a13 0xdc5 0xa30 0x528e 0x999b 0xdb6 0xa85 0x5491 0x9923 0xd4a 0xab9 0x5695 0x98bb 0xd33 0xb1d 0x5898 0x985b 0xd1e 0xb61 0x5a9b 0x9802 0xcfa 0xb97 0x5c9f 0x97b0 0xcee 0xbac 0x5ea2 0x9763 0xcfd 0xc03 0x60a6 0x9717 0xd00 0xbf9 0x62a9 0x96d2 0xd16 0xc1a 0x64ad 0x9696 0xd01 0xc39 0x66b0 0x965a 0xd21 0xc58 0x68b4 0x9624 0xd2f 0xc59 0x6ab7 0x95f0 0xd45 0xc84 0x6cbb 0x95ba 0xd5a 0xc8a 0x6ebe 0x9581 0xd50 0xc7e 0x70c1 0x9556 0xd7a 0xca9 0x72c5 0x952b 0xda5 0xcc9 0x74c8 0x9500 0xdac 0xcd0 0x76cc 0x94d5 0xdac 0xce4 0x78cf 0x94ae 0xdb7 0xcfb 0x7ad3 0x948c 0xde3 0xd0e 0x7cd6 0x9469 0xe29 0xd48 0x7eda 0x9447 0xe2a 0xd2a 0x80dd 0x9425 0xe55 0xd6e 0x82e1 0x940a 0xe6e 0xd61 0x84e4 0x93f6 0xe74 0xd67 0x86e7 0x93e5 0xe96 0xd91 0x88eb 0x93d4 0xed7 0xd82 0x8aee 0x93c2 0xf13 0xd98 0x8cf2 0x93b1 0xf41 0xd76 0x8ef5 0x93a0 0xf97 0xd8a 0x90f9 0x9387 0x1000 0xd67 0x92fc 0x936d 0x104c 0xd5d 0x9500 0x9353 0x10ca 0xd67 0x9703 0x9333 0x115c 0xd38 0x9907 0x930a 0x11d1 0xd4b 0x9b0a 0x92e6 0x1266 0xcd6 0x9d0d 0x92b2 0x12e7 0xcc5 0x9f11 0x9287 0x13dd 0xc80 0xa114 0x924f 0x14cf 0xc4a 0xa318 0x920e 0x15a2 0xc35 0xa51b 0x91c9 0x1691 0xc3b 0xa71f 0x9184 0x17c8 0xc05 0xa922 0x913f 0x1918 0xbe0 0xab26 0x90f1 0x1a1a 0xb95 0xad29 0x909c 0x1bbb 0xb5c 0xaf2d 0x904d 0x1d37 0xb4e 0xb130 0x900f 0x1f4d 0xb5c 0xb333 0x8fe3 0x21d1 0xb88 0xb537 0x8fc1 0x24bf 0xbda 0xb73a 0x8f9d 0x28ee 0xbf2 0xb93e 0x8f72 0x2e62 0xb60 0xbb41 0x8f1f 0x352f 0xac5 0xbd45 0x8e72 0x3ca7 0xa09 0xbf48 0x8d10 0x4758 0x8e2 0xc14c 0x8b02 0x4a52 0x7f3 0xc34f 0x884a 0x4443 0x768 0xc553 0x884a 0x4443 0x768 0xc756 0x884a 0x4443 0x768>;
		battery0_profile_t3_col = <0x4>;
		battery0_profile_t3_num = <0x64>;
		battery0_profile_t4 = <0x0 0xac44 0x1e64 0x203 0xab90 0x1e60 0x407 0xaaf1 0x1ecb 0x60a 0xaa62 0x1f20 0x80e 0xa9d8 0x1f35 0xa11 0xa952 0x1f2e 0xc15 0xa8cf 0x1f2d 0xe18 0xa846 0x1ec3 0x101c 0xa7c5 0x1ead 0x121f 0xa744 0x1e61 0x1423 0xa6c3 0x1e46 0x1626 0xa643 0x1e24 0x1829 0xa5c5 0x1df3 0x1a2d 0xa54a 0x1e5a 0x1c30 0xa4c8 0x20c2 0x1e34 0xa447 0x1e74 0x2037 0xa3d2 0x1d91 0x223b 0xa35e 0x1d7e 0x243e 0xa2e5 0x1d75 0x2642 0xa26d 0x1d5b 0x2845 0xa1f6 0x1d33 0x2a49 0xa186 0x1d33 0x2c4c 0xa10e 0x1d47 0x2e4f 0xa09c 0x1d2c 0x3053 0xa032 0x1cf4 0x3256 0x9fcb 0x1cf3 0x345a 0x9f5f 0x1d33 0x365d 0x9ee7 0x1d31 0x3861 0x9e6f 0x1d1c 0x3a64 0x9dee 0x1d06 0x3c68 0x9d74 0x1ce0 0x3e6b 0x9cf7 0x1c41 0x406f 0x9c7a 0x1bd8 0x4272 0x9c01 0x1c0d 0x4475 0x9b8c 0x1c1b 0x4679 0x9b2c 0x1bf0 0x487c 0x9acd 0x1c17 0x4a80 0x9a61 0x1bfe 0x4c83 0x99f7 0x1bd3 0x4e87 0x998f 0x1bbc 0x508a 0x9928 0x1b9b 0x528e 0x98c3 0x1b45 0x5491 0x9864 0x1b70 0x5695 0x980e 0x1b1d 0x5898 0x97b8 0x1b30 0x5a9b 0x9768 0x1b23 0x5c9f 0x971f 0x1b37 0x5ea2 0x96da 0x1b78 0x60a6 0x9695 0x1b8a 0x62a9 0x9650 0x1b8a 0x64ad 0x9614 0x1bdf 0x66b0 0x95df 0x1bee 0x68b4 0x95ac 0x1c36 0x6ab7 0x9578 0x1c6b 0x6cbb 0x9545 0x1c8f 0x6ebe 0x9513 0x1cec 0x70c1 0x94e8 0x1d02 0x72c5 0x94c5 0x1d58 0x74c8 0x94a3 0x1d89 0x76cc 0x9486 0x1dd2 0x78cf 0x946d 0x1e28 0x7ad3 0x9456 0x1e8d 0x7cd6 0x9443 0x1f01 0x7eda 0x942a 0x1f45 0x80dd 0x9418 0x1ff0 0x82e1 0x9407 0x208a 0x84e4 0x93f6 0x212f 0x86e7 0x93e0 0x21c4 0x88eb 0x93ca 0x226d 0x8aee 0x93b7 0x2363 0x8cf2 0x939c 0x247e 0x8ef5 0x9383 0x2595 0x90f9 0x9361 0x264c 0x92fc 0x933f 0x2776 0x9500 0x931c 0x290b 0x9703 0x92fa 0x2abd 0x9907 0x92d6 0x2c4a 0x9b0a 0x92ab 0x2dc3 0x9d0d 0x9280 0x2fc6 0x9f11 0x924d 0x317b 0xa114 0x9219 0x3329 0xa318 0x91e1 0x3498 0xa51b 0x91a1 0x35e3 0xa71f 0x915f 0x3746 0xa922 0x9122 0x38b4 0xab26 0x90dd 0x3960 0xad29 0x9090 0x3aab 0xaf2d 0x9049 0x3b80 0xb130 0x900f 0x3ce0 0xb333 0x8fe3 0x3e93 0xb537 0x8fc3 0x4068 0xb73a 0x8fa8 0x437e 0xb93e 0x8f86 0x49df 0xbb41 0x8f55 0x5449 0xbd45 0x8ed9 0x53c8 0xbf48 0x8d90 0x50e2 0xc14c 0x8d90 0x510e 0xc34f 0x8d90 0x510e 0xc553 0x8d90 0x510e 0xc756 0x8d90 0x510e>;
		battery0_profile_t4_col = <0x3>;
		battery0_profile_t4_num = <0x64>;
		battery1_profile_t0 = <0x0 0xabb8 0x384 0x1f3 0xab54 0x384 0x3e6 0xaaf7 0x3a5 0x5da 0xaa96 0x3b6 0x7cd 0xaa33 0x3b6 0x9c0 0xa9cd 0x3b6 0xbb3 0xa961 0x3b6 0xda6 0xa8f5 0x3b6 0xf9a 0xa882 0x3b6 0x118d 0xa80e 0x3b6 0x1380 0xa799 0x3b6 0x1573 0xa723 0x3b6 0x1766 0xa6a6 0x3b6 0x1959 0xa632 0x3b6 0x1b4d 0xa5bf 0x3c6 0x1d40 0xa547 0x3c3 0x1f33 0xa4cd 0x3bd 0x2126 0xa457 0x3cc 0x2319 0xa3da 0x3b7 0x250d 0xa365 0x3ca 0x2700 0xa2f1 0x3cf 0x28f3 0xa27c 0x3cf 0x2ae6 0xa208 0x3cf 0x2cd9 0xa195 0x3d2 0x2ecd 0xa128 0x3e7 0x30c0 0xa0b4 0x3e8 0x32b3 0xa046 0x3f7 0x34a6 0x9fda 0x401 0x3699 0x9f6e 0x401 0x388d 0x9f02 0x401 0x3a80 0x9e95 0x401 0x3c73 0x9e31 0x401 0x3e66 0x9dcd 0x410 0x4059 0x9d69 0x41a 0x424d 0x9d08 0x428 0x4440 0x9cad 0x44f 0x4633 0x9c51 0x463 0x4826 0x9bee 0x478 0x4a19 0x9b84 0x48d 0x4c0c 0x9b0b 0x481 0x4e00 0x9a7b 0x444 0x4ff3 0x99da 0x3e3 0x51e6 0x995f 0x3ba 0x53d9 0x9900 0x3b6 0x55cc 0x98ab 0x3b6 0x57c0 0x985b 0x3b6 0x59b3 0x9813 0x3b6 0x5ba6 0x97d0 0x3b6 0x5d99 0x978e 0x3b6 0x5f8c 0x974b 0x3b6 0x6180 0x970e 0x3b6 0x6373 0x96d4 0x3b6 0x6566 0x969a 0x3b6 0x6759 0x9660 0x3b6 0x694c 0x962e 0x3b6 0x6b40 0x95fc 0x3b6 0x6d33 0x95cb 0x3b6 0x6f26 0x959d 0x3c0 0x7119 0x9573 0x3cf 0x730c 0x9549 0x3d0 0x7500 0x9520 0x3e5 0x76f3 0x94f6 0x3e8 0x78e6 0x94d2 0x3e8 0x7ad9 0x94ad 0x3e8 0x7ccc 0x9485 0x3ed 0x7ebf 0x9464 0x402 0x80b3 0x9443 0x417 0x82a6 0x9413 0x408 0x8499 0x93d7 0x3f3 0x868c 0x938d 0x3d6 0x887f 0x933f 0x3b6 0x8a73 0x92fd 0x3b7 0x8c66 0x92d3 0x3cb 0x8e59 0x929c 0x3be 0x904c 0x926c 0x3c3 0x923f 0x923f 0x3c6 0x9433 0x920f 0x3bb 0x9626 0x91e5 0x3cf 0x9819 0x91bc 0x3cf 0x9a0c 0x9192 0x3e0 0x9bff 0x915e 0x3db 0x9df3 0x9121 0x3c6 0x9fe6 0x90e0 0x3ba 0xa1d9 0x90a6 0x3cf 0xa3cc 0x906b 0x3e4 0xa5bf 0x901d 0x3c7 0xa7b3 0x8fe8 0x3b6 0xa9a6 0x8fd1 0x3be 0xab99 0x8fc7 0x3cf 0xad8c 0x8fb6 0x3cf 0xaf7f 0x8fae 0x40d 0xb172 0x8f98 0x45c 0xb366 0x8f49 0x472 0xb559 0x8e70 0x445 0xb74c 0x8cdd 0x409 0xb93f 0x8ad1 0x432 0xbb32 0x87e7 0x471 0xbd26 0x837d 0x52f 0xbf19 0x7b70 0x1549 0xc10c 0x736e 0x1036>;
		battery1_profile_t0_col = <0x3>;
		battery1_profile_t0_num = <0x64>;
		battery1_profile_t1 = <0x0 0xac08 0x500 0x1f3 0xaba4 0x4fc 0x3e6 0xab47 0x50c 0x5da 0xaae6 0x514 0x7cd 0xaa83 0x514 0x9c0 0xaa1f 0x514 0xbb3 0xa9bb 0x514 0xda6 0xa94f 0x514 0xf9a 0xa8dc 0x514 0x118d 0xa86d 0x520 0x1380 0xa7fa 0x525 0x1573 0xa77f 0x518 0x1766 0xa70a 0x52d 0x1959 0xa68e 0x519 0x1b4d 0xa619 0x524 0x1d40 0xa5a1 0x521 0x1f33 0xa527 0x51b 0x2126 0xa4b1 0x52d 0x2319 0xa434 0x52d 0x250d 0xa3bf 0x52d 0x2700 0xa345 0x52d 0x28f3 0xa2cc 0x538 0x2ae6 0xa25b 0x54d 0x2cd9 0xa1ed 0x55f 0x2ecd 0xa179 0x55f 0x30c0 0xa104 0x55f 0x32b3 0xa096 0x56e 0x34a6 0xa02a 0x583 0x3699 0x9fbb 0x58a 0x388d 0x9f49 0x57e 0x3a80 0x9ee5 0x5a7 0x3c73 0x9e81 0x5bd 0x3e66 0x9e17 0x5d2 0x4059 0x9daf 0x5e7 0x424d 0x9d4b 0x5fc 0x4440 0x9ce8 0x611 0x4633 0x9c84 0x625 0x4826 0x9c20 0x63a 0x4a19 0x9bb0 0x631 0x4c0c 0x9b33 0x611 0x4e00 0x9aa6 0x5ce 0x4ff3 0x9a0b 0x558 0x51e6 0x9988 0x51b 0x53d9 0x9921 0x501 0x55cc 0x98c3 0x4ed 0x57c0 0x986f 0x4e2 0x59b3 0x9825 0x4e2 0x5ba6 0x97da 0x4e0 0x5d99 0x9798 0x4cb 0x5f8c 0x975d 0x4db 0x6180 0x9722 0x4e2 0x6373 0x96e8 0x4e2 0x6566 0x96ae 0x4e2 0x6759 0x9674 0x4e2 0x694c 0x9642 0x4e2 0x6b40 0x9610 0x4e2 0x6d33 0x95e4 0x4f0 0x6f26 0x95b7 0x4fb 0x7119 0x9587 0x4fb 0x730c 0x955d 0x4fb 0x7500 0x9534 0x4fb 0x76f3 0x9511 0x51f 0x78e6 0x94eb 0x51f 0x7ad9 0x94c5 0x51e 0x7ccc 0x94a1 0x528 0x7ebf 0x9478 0x515 0x80b3 0x9457 0x52a 0x82a6 0x9436 0x52d 0x8499 0x940f 0x52d 0x868c 0x93e6 0x524 0x887f 0x93bd 0x514 0x8a73 0x9393 0x513 0x8c66 0x9361 0x4e9 0x8e59 0x932f 0x4e2 0x904c 0x92fd 0x4d5 0x923f 0x92cf 0x4c9 0x9433 0x92a5 0x4c9 0x9626 0x927b 0x4c9 0x9819 0x925a 0x4c9 0x9a0c 0x9232 0x4c9 0x9bff 0x9203 0x4d6 0x9df3 0x91cb 0x4d9 0x9fe6 0x918a 0x4c9 0xa1d9 0x9150 0x4c9 0xa3cc 0x911e 0x4f3 0xa5bf 0x90d1 0x4ea 0xa7b3 0x9088 0x4d5 0xa9a6 0x9059 0x4d1 0xab99 0x904a 0x4e6 0xad8c 0x9042 0x4fb 0xaf7f 0x9031 0x510 0xb172 0x9021 0x535 0xb366 0x9001 0x577 0xb559 0x8f8d 0x592 0xb74c 0x8e78 0x55f 0xb93f 0x8ca6 0x55f 0xbb32 0x8a20 0x59d 0xbd26 0x868b 0x62a 0xbf19 0x7f76 0x11e1 0xc10c 0x7508 0x13a1>;
		battery1_profile_t1_col = <0x3>;
		battery1_profile_t1_num = <0x64>;
		battery1_profile_t2 = <0x0 0xac1c 0x8e8 0x1f3 0xaba8 0x8e4 0x3e6 0xab40 0x904 0x5da 0xaadc 0x915 0x7cd 0xaa79 0x91d 0x9c0 0xaa13 0x92e 0xbb3 0xa9a7 0x92e 0xda6 0xa93b 0x92e 0xf9a 0xa8c8 0x92e 0x118d 0xa854 0x92e 0x1380 0xa7df 0x926 0x1573 0xa769 0x915 0x1766 0xa6ec 0x915 0x1959 0xa678 0x915 0x1b4d 0xa5fe 0x905 0x1d40 0xa583 0x8f0 0x1f33 0xa509 0x8ea 0x2126 0xa493 0x8f9 0x2319 0xa416 0x8e4 0x250d 0xa3a1 0x8e3 0x2700 0xa32d 0x8e3 0x28f3 0xa2b8 0x8ee 0x2ae6 0xa244 0x8fc 0x2cd9 0xa1cf 0x8fc 0x2ecd 0xa15b 0x8fc 0x30c0 0xa0e6 0x8fc 0x32b3 0xa078 0x91b 0x34a6 0xa00c 0x92e 0x3699 0x9fa0 0x92e 0x388d 0x9f35 0x934 0x3a80 0x9ed1 0x95d 0x3c73 0x9e65 0x973 0x3e66 0x9df9 0x997 0x4059 0x9d8d 0x9ab 0x424d 0x9d21 0x9ab 0x4440 0x9cb5 0x9a8 0x4633 0x9c48 0x994 0x4826 0x9bdc 0x96c 0x4a19 0x9b6a 0x951 0x4c0c 0x9ae9 0x91c 0x4e00 0x9a5e 0x8c9 0x4ff3 0x99da 0x876 0x51e6 0x995f 0x824 0x53d9 0x98f9 0x808 0x55cc 0x989b 0x7f4 0x57c0 0x9847 0x7df 0x59b3 0x97fd 0x7d0 0x5ba6 0x97b2 0x7d0 0x5d99 0x9770 0x7d0 0x5f8c 0x972d 0x7d0 0x6180 0x96f0 0x7d0 0x6373 0x96b6 0x7d0 0x6566 0x967e 0x7d6 0x6759 0x964c 0x7e7 0x694c 0x9611 0x7d3 0x6b40 0x95de 0x7e2 0x6d33 0x95ad 0x7e9 0x6f26 0x957f 0x7f3 0x7119 0x9555 0x802 0x730c 0x952b 0x803 0x7500 0x9502 0x818 0x76f3 0x94d8 0x81b 0x78e6 0x94b4 0x829 0x7ad9 0x948f 0x82a 0x7ccc 0x946a 0x826 0x7ebf 0x9450 0x84d 0x80b3 0x9426 0x84d 0x82a6 0x940b 0x84d 0x8499 0x93ec 0x85b 0x868c 0x93cb 0x85d 0x887f 0x93ac 0x84d 0x8a73 0x9393 0x84d 0x8c66 0x9372 0x84d 0x8e59 0x9351 0x85e 0x904c 0x932a 0x859 0x923f 0x9301 0x856 0x9433 0x92d7 0x866 0x9626 0x92ad 0x867 0x9819 0x928c 0x890 0x9a0c 0x9264 0x8a9 0x9bff 0x9230 0x8ca 0x9df3 0x91f3 0x8ec 0x9fe6 0x91b2 0x909 0xa1d9 0x9178 0x947 0xa3cc 0x9135 0x971 0xa5bf 0x90e5 0x9ab 0xa7b3 0x909c 0x9ea 0xa9a6 0x9067 0xa30 0xab99 0x9047 0xa83 0xad8c 0x902e 0xad7 0xaf7f 0x901d 0xb68 0xb172 0x9000 0xc0a 0xb366 0x8fd0 0xcfa 0xb559 0x8f5e 0xe1e 0xb74c 0x8e67 0xf3d 0xb93f 0x8ca6 0x104b 0xbb32 0x89ff 0x128d 0xbd26 0x8630 0x16ce 0xbf19 0x7f99 0x21e1 0xc10c 0x754e 0x1518>;
		battery1_profile_t2_col = <0x3>;
		battery1_profile_t2_num = <0x64>;
		battery1_profile_t3 = <0x0 0xac30 0x10fe 0x1f3 0xaba3 0x10fe 0x3e6 0xab22 0x1130 0x5da 0xaab0 0x1155 0x7cd 0xaa43 0x1152 0x9c0 0xa9d6 0x1128 0xbb3 0xa961 0x10fe 0xda6 0xa8f5 0x10d5 0xf9a 0xa882 0x10cc 0x118d 0xa809 0x10c0 0x1380 0xa78f 0x10ab 0x1573 0xa71b 0x1092 0x1766 0xa6a6 0x1069 0x1959 0xa62a 0x107c 0x1b4d 0xa5b5 0x1071 0x1d40 0xa53d 0x1051 0x1f33 0xa4c0 0x1036 0x2126 0xa444 0x1036 0x2319 0xa3d0 0x1036 0x250d 0xa35b 0x1036 0x2700 0xa2e1 0x1026 0x28f3 0xa26d 0x101d 0x2ae6 0xa1fe 0x1024 0x2cd9 0xa189 0x1036 0x2ecd 0xa115 0x1036 0x30c0 0xa0a0 0x1036 0x32b3 0xa032 0x1036 0x34a6 0x9fc6 0x1041 0x3699 0x9f5d 0x1056 0x388d 0x9ef6 0x106b 0x3a80 0x9e82 0x1080 0x3c73 0x9e0e 0x1081 0x3e66 0x9d99 0x1081 0x4059 0x9d25 0x1081 0x424d 0x9cad 0x1066 0x4440 0x9c32 0x1015 0x4633 0x9bbd 0xfd7 0x4826 0x9b50 0xfac 0x4a19 0x9ad8 0xf64 0x4c0c 0x9a60 0xf26 0x4e00 0x99e9 0xef6 0x4ff3 0x996e 0xeb8 0x51e6 0x9903 0xe7b 0x53d9 0x989f 0xe4f 0x55cc 0x9847 0xe50 0x57c0 0x97f7 0xe5b 0x59b3 0x97ad 0xe5b 0x5ba6 0x9762 0xe5b 0x5d99 0x9717 0xe5b 0x5f8c 0x96db 0xe6d 0x6180 0x96a0 0xe74 0x6373 0x9662 0xe7e 0x6566 0x9624 0xe93 0x6759 0x95f2 0xea8 0x694c 0x95c0 0xebc 0x6b40 0x958e 0xed1 0x6d33 0x955d 0xed8 0x6f26 0x952f 0xeeb 0x7119 0x9505 0xf10 0x730c 0x94db 0xf24 0x7500 0x94b2 0xf39 0x76f3 0x9488 0xf3c 0x78e6 0x9464 0xf57 0x7ad9 0x9443 0xf78 0x7ccc 0x9421 0xf8c 0x7ebf 0x9401 0xfa1 0x80b3 0x93e8 0xfb6 0x82a6 0x93d6 0xfcb 0x8499 0x93c5 0x1008 0x868c 0x93b5 0x1064 0x887f 0x93a2 0x10bc 0x8a73 0x9389 0x10e8 0x8c66 0x9370 0x1150 0x8e59 0x9351 0x1195 0x904c 0x932f 0x11e1 0x923f 0x930b 0x1257 0x9433 0x92df 0x12f9 0x9626 0x92ad 0x138b 0x9819 0x9284 0x1446 0x9a0c 0x924d 0x1512 0x9bff 0x9212 0x15e2 0x9df3 0x91d5 0x16bb 0x9fe6 0x9190 0x17a0 0xa1d9 0x9146 0x1884 0xa3cc 0x90fb 0x197e 0xa5bf 0x90b0 0x1a88 0xa7b3 0x906a 0x1bb0 0xa9a6 0x902e 0x1ce8 0xab99 0x9001 0x1e3d 0xad8c 0x8fe8 0x2006 0xaf7f 0x8fc7 0x220e 0xb172 0x8f98 0x24ab 0xb366 0x8f53 0x280e 0xb559 0x8ecc 0x2c39 0xb74c 0x8dcf 0x310f 0xb93f 0x8c38 0x366b 0xbb32 0x89ba 0x3cbe 0xbd26 0x8665 0x3ea7 0xbf19 0x8083 0x3048 0xc10c 0x7aa8 0x214d>;
		battery1_profile_t3_col = <0x3>;
		battery1_profile_t3_num = <0x64>;
		battery1_profile_t4 = <0x0 0xac44 0x251c 0x1f3 0xab95 0x251c 0x3e6 0xaaf4 0x255e 0x5da 0xaa5b 0x2574 0x7cd 0xa9c8 0x2525 0x9c0 0xa93b 0x2487 0xbb3 0xa8ad 0x240a 0xda6 0xa828 0x2409 0xf9a 0xa79c 0x23f9 0x118d 0xa714 0x23f0 0x1380 0xa68f 0x23d8 0x1573 0xa60a 0x239a 0x1766 0xa585 0x235b 0x1959 0xa508 0x22f4 0x1b4d 0xa48c 0x229d 0x1d40 0xa415 0x2262 0x1f33 0xa3a1 0x2240 0x2126 0xa32b 0x221e 0x2319 0xa2ae 0x21b6 0x250d 0xa239 0x2162 0x2700 0xa1c5 0x211e 0x28f3 0xa150 0x20eb 0x2ae6 0xa0dc 0x20ba 0x2cd9 0xa06a 0x2088 0x2ecd 0xa006 0x209d 0x30c0 0x9f9a 0x20b2 0x32b3 0x9f28 0x20b7 0x34a6 0x9eaa 0x20a1 0x3699 0x9e25 0x2077 0x388d 0x9da0 0x204b 0x3a80 0x9d1b 0x200c 0x3c73 0x9c9e 0x1fce 0x3e66 0x9c27 0x1f80 0x4059 0x9bb7 0x1f43 0x424d 0x9b4d 0x1f20 0x4440 0x9aeb 0x1f09 0x4633 0x9a8f 0x1edf 0x4826 0x9a24 0x1eb6 0x4a19 0x99b8 0x1e7d 0x4c0c 0x9950 0x1e49 0x4e00 0x98ec 0x1e20 0x4ff3 0x988a 0x1df9 0x51e6 0x9830 0x1de4 0x53d9 0x97dc 0x1dcf 0x55cc 0x978e 0x1dbb 0x57c0 0x9743 0x1dba 0x59b3 0x96f9 0x1dbd 0x5ba6 0x96af 0x1d99 0x5d99 0x9675 0x1dae 0x5f8c 0x963b 0x1dd5 0x6180 0x9600 0x1dfe 0x6373 0x95c6 0x1e1e 0x6566 0x958e 0x1e44 0x6759 0x955c 0x1e96 0x694c 0x952a 0x1ed4 0x6b40 0x9500 0x1f25 0x6d33 0x94d6 0x1f78 0x6f26 0x94b0 0x1fb7 0x7119 0x9491 0x1fec 0x730c 0x9478 0x203f 0x7500 0x945f 0x2093 0x76f3 0x9446 0x20f8 0x78e6 0x9433 0x217b 0x7ad9 0x941f 0x220d 0x7ccc 0x9408 0x22a4 0x7ebf 0x93f7 0x234b 0x80b3 0x93de 0x2407 0x82a6 0x93c5 0x24e5 0x8499 0x93ac 0x25ca 0x868c 0x9393 0x26c9 0x887f 0x9378 0x27e8 0x8a73 0x9357 0x290c 0x8c66 0x9336 0x2a44 0x8e59 0x9315 0x2baf 0x904c 0x92f3 0x2d26 0x923f 0x92cf 0x2ea5 0x9433 0x92a3 0x302b 0x9626 0x9271 0x31a2 0x9819 0x923f 0x332d 0x9a0c 0x920d 0x3497 0x9bff 0x91db 0x35d2 0x9df3 0x91a6 0x36ed 0x9fe6 0x916a 0x37ee 0xa1d9 0x9128 0x38be 0xa3cc 0x90e5 0x3979 0xa5bf 0x90a2 0x3a34 0xa7b3 0x9065 0x3af0 0xa9a6 0x9031 0x3bbc 0xab99 0x9008 0x3ca9 0xad8c 0x8fde 0x3db7 0xaf7f 0x8fbd 0x3eef 0xb172 0x8f9c 0x409a 0xb366 0x8f67 0x42ec 0xb559 0x8f00 0x4603 0xb74c 0x8e3d 0x4a08 0xb93f 0x8cce 0x4e95 0xbb32 0x8a82 0x48e9 0xbd26 0x8719 0x407d 0xbf19 0x858e 0x3c8c 0xc10c 0x858e 0x3c8c>;
		battery1_profile_t4_col = <0x3>;
		battery1_profile_t4_num = <0x64>;
		compatible = "mediatek,bat_gm30";
		g_FG_PSEUDO100_T0 = <0x64>;
		g_FG_PSEUDO100_T1 = <0x5f>;
		g_FG_PSEUDO100_T2 = <0x60>;
		g_FG_PSEUDO100_T3 = <0x5f>;
		g_FG_PSEUDO100_T4 = <0x5f>;
		linux,phandle = <0x91>;
		phandle = <0x91>;
	};

	bpi_bsi_slv0@1021e000 {
		compatible = "mediatek,bpi_bsi_slv0";
		reg = <0x0 0x1021e000 0x0 0x1000>;
	};

	bpi_bsi_slv1@1021f000 {
		compatible = "mediatek,bpi_bsi_slv1";
		reg = <0x0 0x1021f000 0x0 0x6000>;
	};

	bpi_bsi_slv2@10225000 {
		compatible = "mediatek,bpi_bsi_slv2";
		reg = <0x0 0x10225000 0x0 0x1000>;
	};

	btif@1100c000 {
		clock-names = "btifc", "apdmac";
		clocks = <0x27 0x1a 0x27 0x26>;
		compatible = "mediatek,btif";
		interrupts = <0x0 0x70 0x8 0x0 0x84 0x8 0x0 0x85 0x8>;
		reg = <0x0 0x1100c000 0x0 0x1000 0x0 0x11000880 0x0 0x80 0x0 0x11000900 0x0 0x80>;
	};

	bus_dbg@10208000 {
		compatible = "mediatek,bus_dbg-v2";
		interrupts = <0x0 0x8d 0x8>;
		mediatek,bus_dbg_con_offset = <0x2fc>;
		reg = <0x0 0x10208000 0x0 0x1000 0x0 0x10001000 0x0 0x1000>;
	};

	cam1@1a003000 {
		compatible = "mediatek,cam1";
		interrupts = <0x0 0xeb 0x8>;
		reg = <0x0 0x1a003000 0x0 0x1000>;
	};

	cam2@1a004000 {
		compatible = "mediatek,cam2";
		interrupts = <0x0 0xec 0x8>;
		reg = <0x0 0x1a004000 0x0 0x1000>;
	};

	cam3@1a005000 {
		compatible = "mediatek,cam3";
		interrupts = <0x0 0xed 0x8>;
		reg = <0x0 0x1a005000 0x0 0x1000>;
	};

	cam_clear@1a01b000 {
		compatible = "mediatek,cam_clear";
		reg = <0x0 0x1a01b000 0x0 0x1000>;
	};

	cam_inner@1a013000 {
		compatible = "mediatek,cam_inner";
		reg = <0x0 0x1a013000 0x0 0x1000>;
	};

	cam_set@1a00b000 {
		compatible = "mediatek,cam_set";
		reg = <0x0 0x1a00b000 0x0 0x1000>;
	};

	cama_clear@1a01c000 {
		compatible = "mediatek,cama_clear";
		reg = <0x0 0x1a01c000 0x0 0x1000>;
	};

	cama_ext@1a024000 {
		compatible = "mediatek,cama_ext";
		reg = <0x0 0x1a024000 0x0 0x1000>;
	};

	cama_inner@1a014000 {
		compatible = "mediatek,cama_inner";
		reg = <0x0 0x1a014000 0x0 0x1000>;
	};

	cama_set@1a00c000 {
		compatible = "mediatek,cama_set";
		reg = <0x0 0x1a00c000 0x0 0x1000>;
	};

	camb_clear@1a01d000 {
		compatible = "mediatek,camb_clear";
		reg = <0x0 0x1a01d000 0x0 0x1000>;
	};

	camb_ext@1a025000 {
		compatible = "mediatek,camb_ext";
		reg = <0x0 0x1a025000 0x0 0x1000>;
	};

	camb_inner@1a015000 {
		compatible = "mediatek,camb_inner";
		reg = <0x0 0x1a015000 0x0 0x1000>;
	};

	camb_set@1a00d000 {
		compatible = "mediatek,camb_set";
		reg = <0x0 0x1a00d000 0x0 0x1000>;
	};

	camsv1@1a050000 {
		compatible = "mediatek,camsv1";
		interrupts = <0x0 0xf3 0x8>;
		reg = <0x0 0x1a050000 0x0 0x1000>;
	};

	camsv2@1a051000 {
		compatible = "mediatek,camsv2";
		interrupts = <0x0 0xf4 0x8>;
		reg = <0x0 0x1a051000 0x0 0x1000>;
	};

	camsv3@1a052000 {
		compatible = "mediatek,camsv3";
		interrupts = <0x0 0xf1 0x8>;
		reg = <0x0 0x1a052000 0x0 0x1000>;
	};

	camsv4@1a053000 {
		compatible = "mediatek,camsv4";
		interrupts = <0x0 0xf2 0x8>;
		reg = <0x0 0x1a053000 0x0 0x1000>;
	};

	camsys@1a000000 {
		#clock-cells = <0x1>;
		compatible = "mediatek,camsys", "syscon";
		linux,phandle = <0x4c>;
		phandle = <0x4c>;
		reg = <0x0 0x1a000000 0x0 0x1000>;
	};

	ccu@1a0b0000 {
		clock-names = "CCU_CLK_CAM_CCU";
		clocks = <0x4c 0x8>;
		compatible = "mediatek,ccu";
		interrupts = <0x0 0xf6 0x8>;
		reg = <0x0 0x1a0b1000 0x0 0x1000>;
	};

	charger {
		ac_charger_current = <0x225510>;
		ac_charger_input_current = <0x2191c0>;
		algorithm_name = "SwitchCharging";
		apple_1_0a_charger_current = <0x1e8480>;
		apple_2_1a_charger_current = <0x1e8480>;
		battery_cv = <0x42ae50>;
		bif_cv_under_threshold2 = <0x43e6d0>;
		bif_threshold1 = <0x40d990>;
		bif_threshold2 = <0x419ce0>;
		cable_imp_threshold = <0x2bb>;
		charging_host_charger_current = <0x18b820>;
		chg1_ta_ac_charger_current = <0x16e360>;
		chg2_ta_ac_charger_current = <0x16e360>;
		compatible = "mediatek,charger";
		dual_polling_ieoc = <0x6ddd0>;
		enable_min_charge_temp;
		enable_sw_jeita;
		enable_sw_safety_timer;
		high_temp_to_enter_pe40 = <0x27>;
		high_temp_to_leave_pe40 = <0x2e>;
		ibus_err = <0xe>;
		jeita_temp_above_t7_cv = <0x3f04d0>;
		jeita_temp_below_t0_cv = <0x3c6cc0>;
		jeita_temp_t0_to_t1_cc = <0x57e40>;
		jeita_temp_t0_to_t1_cv = <0x3c6cc0>;
		jeita_temp_t1_to_t2_cc = <0x75300>;
		jeita_temp_t1_to_t2_cv = <0x3c6cc0>;
		jeita_temp_t2_to_t3_cc = <0x2191c0>;
		jeita_temp_t2_to_t3_cv = <0x432380>;
		jeita_temp_t3_to_t4_cc = <0x2191c0>;
		jeita_temp_t3_to_t4_cv = <0x43a080>;
		jeita_temp_t4_to_t5_cc = <0x2191c0>;
		jeita_temp_t4_to_t5_cv = <0x43a080>;
		jeita_temp_t5_to_t6_cc = <0x169540>;
		jeita_temp_t5_to_t6_cv = <0x43a080>;
		jeita_temp_t6_to_t7_cc = <0xa1220>;
		jeita_temp_t6_to_t7_cv = <0x3f04d0>;
		jeita_temp_t7_to_t8_cc = <0x155cc0>;
		linux,phandle = <0xb8>;
		low_temp_to_enter_pe40 = <0x10>;
		low_temp_to_leave_pe40 = <0xa>;
		max_charge_temp = <0x35>;
		max_charge_temp_minus_x_degree = <0x33>;
		max_charger_voltage = <0x588040>;
		min_charge_temp = <0x0>;
		min_charge_temp_plus_x_degree = <0x7>;
		min_charger_voltage = <0x4630c0>;
		non_std_ac_charger_current = <0x2191c0>;
		pd_ichg_level_threshold = <0xf4240>;
		pd_stop_battery_soc = <0x50>;
		pd_vbus_low_bound = <0x4c4b40>;
		pd_vbus_upper_bound = <0x4c4b40>;
		pe20_ichg_level_threshold = <0xf4240>;
		pe40_dual_charger_chg1_current = <0x1e8480>;
		pe40_dual_charger_chg2_current = <0x1e8480>;
		pe40_dual_charger_input_current = <0x2dc6c0>;
		pe40_r_cable_1a_lower = <0x229>;
		pe40_r_cable_2a_lower = <0x19f>;
		pe40_r_cable_3a_lower = <0x113>;
		pe40_single_charger_current = <0x2dc6c0>;
		pe40_single_charger_input_current = <0x2dc6c0>;
		pe40_stop_battery_soc = <0x50>;
		pe_ichg_level_threshold = <0xf4240>;
		phandle = <0xb8>;
		power_path_support;
		slave_mivr_diff = <0x186a0>;
		ta_12v_support;
		ta_9v_support;
		ta_ac_12v_input_current = <0x30d400>;
		ta_ac_7v_input_current = <0x30d400>;
		ta_ac_9v_input_current = <0x30d400>;
		ta_ac_charger_current = <0x2dc6c0>;
		ta_start_battery_soc = <0x0>;
		ta_stop_battery_soc = <0x55>;
		temp_neg_10_thres = <0x0>;
		temp_t0_thres = <0x0>;
		temp_t0_thres_plus_x_degree = <0x1>;
		temp_t1_thres = <0x5>;
		temp_t1_thres_plus_x_degree = <0x6>;
		temp_t2_thres = <0xc>;
		temp_t2_thres_plus_x_degree = <0xd>;
		temp_t3_thres = <0x10>;
		temp_t3_thres_minus_x_degree = <0xf>;
		temp_t4_thres = <0x2d>;
		temp_t4_thres_minus_x_degree = <0x2c>;
		temp_t5_thres = <0x35>;
		temp_t5_thres_minus_x_degree = <0x35>;
		usb_charger_current = <0x7a120>;
		usb_charger_current_configured = <0x7a120>;
		usb_charger_current_suspend = <0x0>;
		usb_charger_current_unconfigured = <0x11170>;
		vbat_cable_imp_threshold = <0x3b8260>;
		vsys_watt = <0x4c4b40>;
	};

	chipid@08000000 {
		compatible = "mediatek,chipid";
		reg = <0x0 0x8000000 0x0 0x4 0x0 0x8000004 0x0 0x4 0x0 0x8000008 0x0 0x4 0x0 0x800000c 0x0 0x4>;
	};

	chosen {
		bootargs = "console=tty0 console=ttyS0,921600n1 vmalloc=400M slub_debug=OFZPU page_owner=on swiotlb=noforce androidboot.hardware=mt6765 maxcpus=8 loop.max_part=7 firmware_class.path=/vendor/firmware";
		kaslr-seed = <0x0 0x0>;
		linux,phandle = <0x60>;
		phandle = <0x60>;
	};

	chr_stat {
		linux,phandle = <0xc5>;
		phandle = <0xc5>;
	};

	clocks {

		clk26m {
			#clock-cells = <0x0>;
			clock-frequency = <0x18cba80>;
			compatible = "fixed-clock";
			linux,phandle = <0x1f>;
			phandle = <0x1f>;
		};

		clk32k {
			#clock-cells = <0x0>;
			clock-frequency = <0x7d00>;
			compatible = "fixed-clock";
			linux,phandle = <0x1d>;
			phandle = <0x1d>;
		};
	};

	consys@18002000 {
		#address-cells = <0x2>;
		#size-cells = <0x2>;
		clock-names = "conn";
		clocks = <0x28 0x1>;
		compatible = "mediatek,mt6765-consys";
		interrupts = <0x0 0x10b 0x8 0x0 0x10d 0x8 0x0 0x10e 0x1>;
		linux,phandle = <0x1b>;
		phandle = <0x1b>;
		reg = <0x0 0x18002000 0x0 0x1000 0x0 0x10007000 0x0 0x100 0x0 0x10001000 0x0 0x1000 0x0 0x10006000 0x0 0x1000 0x0 0x18007000 0x0 0x1000 0x0 0x180b1000 0x0 0x1000 0x0 0x180a3000 0x0 0x1000 0x0 0x180a5000 0x0 0x800 0x0 0x180c1000 0x0 0x1000 0x0 0x18004000 0x0 0x1000 0x0 0x0 0x0 0x0 0x0 0x0 0x0 0x0 0x0 0x1020e000 0x0 0x1000>;
	};

	cpu_dbgapb@0d410000 {
		compatible = "mediatek,hw_dbg";
		linux,phandle = <0x62>;
		num = <0x8>;
		phandle = <0x62>;
		reg = <0x0 0xd410000 0x0 0x1000 0x0 0xd510000 0x0 0x1000 0x0 0xd610000 0x0 0x1000 0x0 0xd710000 0x0 0x1000 0x0 0xd810000 0x0 0x1000 0x0 0xd910000 0x0 0x1000 0x0 0xda10000 0x0 0x1000 0x0 0xdb10000 0x0 0x1000>;
	};

	cpus {
		#address-cells = <0x1>;
		#size-cells = <0x0>;

		cpu-map {

			cluster0 {

				core0 {
					cpu = <0x9>;
				};

				core1 {
					cpu = <0xa>;
				};

				core2 {
					cpu = <0xb>;
				};

				core3 {
					cpu = <0xc>;
				};
			};

			cluster1 {

				core0 {
					cpu = <0xd>;
				};

				core1 {
					cpu = <0xe>;
				};

				core2 {
					cpu = <0xf>;
				};

				core3 {
					cpu = <0x10>;
				};
			};
		};

		cpu@000 {
			clock-frequency = <0x89267940>;
			compatible = "arm,cortex-a53";
			cpu-idle-states = <0x2 0x3 0x4 0x5 0x6 0x7 0x8>;
			device_type = "cpu";
			enable-method = "psci";
			linux,phandle = <0x9>;
			phandle = <0x9>;
			reg = <0x0>;
		};

		cpu@001 {
			clock-frequency = <0x89267940>;
			compatible = "arm,cortex-a53";
			cpu-idle-states = <0x2 0x3 0x4 0x5 0x6 0x7 0x8>;
			device_type = "cpu";
			enable-method = "psci";
			linux,phandle = <0xa>;
			phandle = <0xa>;
			reg = <0x1>;
		};

		cpu@002 {
			clock-frequency = <0x89267940>;
			compatible = "arm,cortex-a53";
			cpu-idle-states = <0x2 0x3 0x4 0x5 0x6 0x7 0x8>;
			device_type = "cpu";
			enable-method = "psci";
			linux,phandle = <0xb>;
			phandle = <0xb>;
			reg = <0x2>;
		};

		cpu@003 {
			clock-frequency = <0x89267940>;
			compatible = "arm,cortex-a53";
			cpu-idle-states = <0x2 0x3 0x4 0x5 0x6 0x7 0x8>;
			device_type = "cpu";
			enable-method = "psci";
			linux,phandle = <0xc>;
			phandle = <0xc>;
			reg = <0x3>;
		};

		cpu@100 {
			clock-frequency = <0x6b49d200>;
			compatible = "arm,cortex-a53";
			cpu-idle-states = <0x2 0x3 0x4 0x5 0x6 0x7 0x8>;
			device_type = "cpu";
			enable-method = "psci";
			linux,phandle = <0xd>;
			phandle = <0xd>;
			reg = <0x100>;
		};

		cpu@101 {
			clock-frequency = <0x6b49d200>;
			compatible = "arm,cortex-a53";
			cpu-idle-states = <0x2 0x3 0x4 0x5 0x6 0x7 0x8>;
			device_type = "cpu";
			enable-method = "psci";
			linux,phandle = <0xe>;
			phandle = <0xe>;
			reg = <0x101>;
		};

		cpu@102 {
			clock-frequency = <0x6b49d200>;
			compatible = "arm,cortex-a53";
			cpu-idle-states = <0x2 0x3 0x4 0x5 0x6 0x7 0x8>;
			device_type = "cpu";
			enable-method = "psci";
			linux,phandle = <0xf>;
			phandle = <0xf>;
			reg = <0x102>;
		};

		cpu@103 {
			clock-frequency = <0x6b49d200>;
			compatible = "arm,cortex-a53";
			cpu-idle-states = <0x2 0x3 0x4 0x5 0x6 0x7 0x8>;
			device_type = "cpu";
			enable-method = "psci";
			linux,phandle = <0x10>;
			phandle = <0x10>;
			reg = <0x103>;
		};

		idle-states {
			entry-method = "arm,psci";

			dpidle {
				arm,psci-suspend-param = <0x1010004>;
				compatible = "arm,idle-state";
				entry-latency-us = <0x320>;
				exit-latency-us = <0x3e8>;
				linux,phandle = <0x7>;
				min-residency-us = <0x7d0>;
				phandle = <0x7>;
			};

			mcdi-cluster {
				arm,psci-suspend-param = <0x1010001>;
				compatible = "arm,idle-state";
				entry-latency-us = <0x258>;
				exit-latency-us = <0x258>;
				linux,phandle = <0x4>;
				min-residency-us = <0x4b0>;
				phandle = <0x4>;
			};

			mcdi-cpu {
				arm,psci-suspend-param = <0x10001>;
				compatible = "arm,idle-state";
				entry-latency-us = <0x258>;
				exit-latency-us = <0x258>;
				linux,phandle = <0x3>;
				min-residency-us = <0x4b0>;
				phandle = <0x3>;
			};

			sodi {
				arm,psci-suspend-param = <0x1010002>;
				compatible = "arm,idle-state";
				entry-latency-us = <0x320>;
				exit-latency-us = <0x3e8>;
				linux,phandle = <0x5>;
				min-residency-us = <0x7d0>;
				phandle = <0x5>;
			};

			sodi3 {
				arm,psci-suspend-param = <0x1010003>;
				compatible = "arm,idle-state";
				entry-latency-us = <0x320>;
				exit-latency-us = <0x3e8>;
				linux,phandle = <0x6>;
				min-residency-us = <0x7d0>;
				phandle = <0x6>;
			};

			standby {
				arm,psci-suspend-param = <0x1>;
				compatible = "arm,idle-state";
				entry-latency-us = <0x258>;
				exit-latency-us = <0x258>;
				linux,phandle = <0x2>;
				min-residency-us = <0x4b0>;
				phandle = <0x2>;
			};

			suspend {
				arm,psci-suspend-param = <0x1010005>;
				compatible = "arm,idle-state";
				entry-latency-us = <0x320>;
				exit-latency-us = <0x3e8>;
				linux,phandle = <0x8>;
				min-residency-us = <0x7d0>;
				phandle = <0x8>;
			};
		};
	};

	cq_dma@10212000 {
		clock-names = "cqdma";
		clocks = <0x27 0x43>;
		compatible = "mediatek,mt-cqdma-v1";
		interrupts = <0x0 0x71 0x8 0x0 0x72 0x8>;
		keep_clock_ao = "yes";
		nr_channel = <0x2>;
		reg = <0x0 0x10212000 0x0 0x80 0x0 0x10212080 0x0 0x80>;
	};

	dbg_apmcu_mp0@0d400000 {
		compatible = "mediatek,dbg_apmcu_mp0";
		reg = <0x0 0xd400000 0x0 0x1000>;
	};

	dbg_apmcu_mp0@0d410000 {
		compatible = "mediatek,dbg_apmcu_mp0";
		reg = <0x0 0xd410000 0x0 0x1000>;
	};

	dbg_apmcu_mp0@0d420000 {
		compatible = "mediatek,dbg_apmcu_mp0";
		reg = <0x0 0xd420000 0x0 0x1000>;
	};

	dbg_apmcu_mp0@0d430000 {
		compatible = "mediatek,dbg_apmcu_mp0";
		reg = <0x0 0xd430000 0x0 0x1000>;
	};

	dbg_apmcu_mp0@0d440000 {
		compatible = "mediatek,dbg_apmcu_mp0";
		reg = <0x0 0xd440000 0x0 0x1000>;
	};

	dbg_apmcu_mp0@0d510000 {
		compatible = "mediatek,dbg_apmcu_mp0";
		reg = <0x0 0xd510000 0x0 0x1000>;
	};

	dbg_apmcu_mp0@0d520000 {
		compatible = "mediatek,dbg_apmcu_mp0";
		reg = <0x0 0xd520000 0x0 0x1000>;
	};

	dbg_apmcu_mp0@0d530000 {
		compatible = "mediatek,dbg_apmcu_mp0";
		reg = <0x0 0xd530000 0x0 0x1000>;
	};

	dbg_apmcu_mp0@0d540000 {
		compatible = "mediatek,dbg_apmcu_mp0";
		reg = <0x0 0xd540000 0x0 0x1000>;
	};

	dbg_apmcu_mp0@0d610000 {
		compatible = "mediatek,dbg_apmcu_mp0";
		reg = <0x0 0xd610000 0x0 0x1000>;
	};

	dbg_apmcu_mp0@0d620000 {
		compatible = "mediatek,dbg_apmcu_mp0";
		reg = <0x0 0xd620000 0x0 0x1000>;
	};

	dbg_apmcu_mp0@0d630000 {
		compatible = "mediatek,dbg_apmcu_mp0";
		reg = <0x0 0xd630000 0x0 0x1000>;
	};

	dbg_apmcu_mp0@0d640000 {
		compatible = "mediatek,dbg_apmcu_mp0";
		reg = <0x0 0xd640000 0x0 0x1000>;
	};

	dbg_apmcu_mp0@0d710000 {
		compatible = "mediatek,dbg_apmcu_mp0";
		reg = <0x0 0xd710000 0x0 0x1000>;
	};

	dbg_apmcu_mp0@0d720000 {
		compatible = "mediatek,dbg_apmcu_mp0";
		reg = <0x0 0xd720000 0x0 0x1000>;
	};

	dbg_apmcu_mp0@0d730000 {
		compatible = "mediatek,dbg_apmcu_mp0";
		reg = <0x0 0xd730000 0x0 0x1000>;
	};

	dbg_apmcu_mp0@0d740000 {
		compatible = "mediatek,dbg_apmcu_mp0";
		reg = <0x0 0xd740000 0x0 0x1000>;
	};

	dbg_apmcu_mp1@0d800000 {
		compatible = "mediatek,dbg_apmcu_mp1";
		reg = <0x0 0xd800000 0x0 0x1000>;
	};

	dbg_apmcu_mp1@0d810000 {
		compatible = "mediatek,dbg_apmcu_mp1";
		reg = <0x0 0xd810000 0x0 0x1000>;
	};

	dbg_apmcu_mp1@0d820000 {
		compatible = "mediatek,dbg_apmcu_mp1";
		reg = <0x0 0xd820000 0x0 0x1000>;
	};

	dbg_apmcu_mp1@0d830000 {
		compatible = "mediatek,dbg_apmcu_mp1";
		reg = <0x0 0xd830000 0x0 0x1000>;
	};

	dbg_apmcu_mp1@0d840000 {
		compatible = "mediatek,dbg_apmcu_mp1";
		reg = <0x0 0xd840000 0x0 0x1000>;
	};

	dbg_apmcu_mp1@0d910000 {
		compatible = "mediatek,dbg_apmcu_mp1";
		reg = <0x0 0xd910000 0x0 0x1000>;
	};

	dbg_apmcu_mp1@0d920000 {
		compatible = "mediatek,dbg_apmcu_mp1";
		reg = <0x0 0xd920000 0x0 0x1000>;
	};

	dbg_apmcu_mp1@0d930000 {
		compatible = "mediatek,dbg_apmcu_mp1";
		reg = <0x0 0xd930000 0x0 0x1000>;
	};

	dbg_apmcu_mp1@0d940000 {
		compatible = "mediatek,dbg_apmcu_mp1";
		reg = <0x0 0xd940000 0x0 0x1000>;
	};

	dbg_apmcu_mp1@0da10000 {
		compatible = "mediatek,dbg_apmcu_mp1";
		reg = <0x0 0xda10000 0x0 0x1000>;
	};

	dbg_apmcu_mp1@0da20000 {
		compatible = "mediatek,dbg_apmcu_mp1";
		reg = <0x0 0xda20000 0x0 0x1000>;
	};

	dbg_apmcu_mp1@0da30000 {
		compatible = "mediatek,dbg_apmcu_mp1";
		reg = <0x0 0xda30000 0x0 0x1000>;
	};

	dbg_apmcu_mp1@0da40000 {
		compatible = "mediatek,dbg_apmcu_mp1";
		reg = <0x0 0xda40000 0x0 0x1000>;
	};

	dbg_apmcu_mp1@0db10000 {
		compatible = "mediatek,dbg_apmcu_mp1";
		reg = <0x0 0xdb10000 0x0 0x1000>;
	};

	dbg_apmcu_mp1@0db20000 {
		compatible = "mediatek,dbg_apmcu_mp1";
		reg = <0x0 0xdb20000 0x0 0x1000>;
	};

	dbg_apmcu_mp1@0db30000 {
		compatible = "mediatek,dbg_apmcu_mp1";
		reg = <0x0 0xdb30000 0x0 0x1000>;
	};

	dbg_apmcu_mp1@0db40000 {
		compatible = "mediatek,dbg_apmcu_mp1";
		reg = <0x0 0xdb40000 0x0 0x1000>;
	};

	dbg_cti@0d020000 {
		compatible = "mediatek,dbg_cti";
		reg = <0x0 0xd020000 0x0 0x10000>;
	};

	dbg_dem@0d0a0000 {
		compatible = "mediatek,dbg_dem";
		interrupts = <0x0 0x8c 0x8>;
		reg = <0x0 0xd0a0000 0x0 0x10000>;
	};

	dbg_etr@0d030000 {
		compatible = "mediatek,dbg_etr";
		reg = <0x0 0xd030000 0x0 0x10000>;
	};

	dbg_funnel@0d040000 {
		compatible = "mediatek,dbg_funnel";
		reg = <0x0 0xd040000 0x0 0x10000>;
	};

	dbg_mdsys1@0d0c0000 {
		compatible = "mediatek,dbg_mdsys1";
		reg = <0x0 0xd0c0000 0x0 0x40000>;
	};

	ddrphy@10015000 {
		compatible = "mediatek,ddrphy";
		reg = <0x0 0x10015000 0x0 0x1000>;
	};

	ddrphy@1001e000 {
		compatible = "mediatek,ddrphy";
		reg = <0x0 0x1001e000 0x0 0x1000>;
	};

	devapc@10207000 {
		clock-names = "devapc-infra-clock";
		clocks = <0x27 0x28>;
		compatible = "mediatek,devapc";
		interrupts = <0x0 0x8e 0x8>;
		reg = <0x0 0x10207000 0x0 0x1000 0x0 0x1000e000 0x0 0x1000>;
	};

	dfd@10200b00 {
		compatible = "mediatek,dfd";
		mediatek,chain_length = <0xc350>;
		mediatek,enabled = <0x1>;
		mediatek,rg_dfd_timeout = <0xa0>;
		reg = <0x0 0x10200b00 0x0 0x10000>;
	};

	dip1@15022000 {
		compatible = "mediatek,dip1";
		interrupts = <0x0 0xff 0x8>;
		reg = <0x0 0x15022000 0x0 0x3000>;
	};

	disp_aal0@14011000 {
		compatible = "mediatek,disp_aal0";
		interrupts = <0x0 0xde 0x8>;
		reg = <0x0 0x14011000 0x0 0x1000>;
	};

	disp_ccorr0@14010000 {
		compatible = "mediatek,disp_ccorr0";
		interrupts = <0x0 0xdd 0x8>;
		reg = <0x0 0x14010000 0x0 0x1000>;
	};

	disp_color0@1400f000 {
		clock-names = "MDP_COLOR";
		clocks = <0x29 0xc>;
		compatible = "mediatek,disp_color0";
		interrupts = <0x0 0xdc 0x8>;
		linux,phandle = <0x30>;
		phandle = <0x30>;
		reg = <0x0 0x1400f000 0x0 0x1000>;
	};

	disp_dither0@14013000 {
		compatible = "mediatek,disp_dither0";
		interrupts = <0x0 0xe0 0x8>;
		reg = <0x0 0x14013000 0x0 0x1000>;
	};

	disp_gamma0@14012000 {
		compatible = "mediatek,disp_gamma0";
		interrupts = <0x0 0xdf 0x8>;
		reg = <0x0 0x14012000 0x0 0x1000>;
	};

	disp_mutex0@14001000 {
		compatible = "mediatek,disp_mutex0";
		interrupts = <0x0 0xd2 0x8>;
		linux,phandle = <0x32>;
		phandle = <0x32>;
		reg = <0x0 0x14001000 0x0 0x1000>;
	};

	disp_ovl0@1400b000 {
		compatible = "mediatek,disp_ovl0";
		interrupts = <0x0 0xd9 0x8>;
		reg = <0x0 0x1400b000 0x0 0x1000>;
	};

	disp_ovl0_2l@1400c000 {
		compatible = "mediatek,disp_ovl0_2l";
		interrupts = <0x0 0xe5 0x8>;
		reg = <0x0 0x1400c000 0x0 0x1000>;
	};

	disp_pwm@1100e000 {
		compatible = "mediatek,disp_pwm";
		reg = <0x0 0x1100e000 0x0 0x1000>;
	};

	disp_rdma0@1400d000 {
		compatible = "mediatek,disp_rdma0";
		interrupts = <0x0 0xda 0x8>;
		reg = <0x0 0x1400d000 0x0 0x1000>;
	};

	disp_rsz0@14015000 {
		compatible = "mediatek,disp_rsz0";
		interrupts = <0x0 0x114 0x8>;
		reg = <0x0 0x14015000 0x0 0x1000>;
	};

	disp_wdma0@1400e000 {
		compatible = "mediatek,disp_wdma0";
		interrupts = <0x0 0xdb 0x8>;
		reg = <0x0 0x1400e000 0x0 0x1000>;
	};

	dispsys {
		clock-names = "MMSYS_MTCMOS", "MMSYS_SMI_COMMON", "MMSYS_SMI_LARB0", "MMSYS_GALS_COMM0", "MMSYS_GALS_COMM1", "MMSYS_DISP_OVL0", "MMSYS_DISP_OVL0_2L", "MMSYS_DISP_RDMA0", "MMSYS_DISP_WDMA0", "MMSYS_DISP_COLOR0", "MMSYS_DISP_CCORR0", "MMSYS_DISP_AAL0", "MMSYS_DISP_GAMMA0", "MMSYS_DISP_DITHER0", "MMSYS_DSI0_MM_CK", "MMSYS_DSI0_IF_CK", "MMSYS_26M", "MMSYS_DISP_RSZ0", "APMIXED_MIPI_26M", "TOP_MUX_DISP_PWM", "DISP_PWM", "TOP_26M", "TOP_UNIVPLL2_D4", "TOP_ULPOSC1_D2", "TOP_ULPOSC1_D8";
		clocks = <0x28 0x3 0x29 0x13 0x29 0x14 0x29 0x15 0x29 0x16 0x29 0x7 0x29 0x8 0x29 0xa 0x29 0xb 0x29 0xc 0x29 0xd 0x29 0xe 0x29 0xf 0x29 0x10 0x29 0x11 0x29 0x1c 0x29 0x1d 0x29 0x9 0x44 0x15 0x1e 0x73 0x27 0x31 0x1f 0x1e 0x1b 0x1e 0x2e 0x1e 0x30>;
		compatible = "mediatek,dispsys";
		mediatek,larb = <0x23>;
	};

	dma-controller@11000580 {
		#dma-cells = <0x1>;
		clock-names = "apdma";
		clocks = <0x27 0x26>;
		compatible = "mediatek,mt6577-uart-dma";
		interrupts = <0x0 0x6d 0x8 0x0 0x6e 0x8 0x0 0x6f 0x8 0x0 0x74 0x8>;
		linux,phandle = <0x34>;
		phandle = <0x34>;
		reg = <0x0 0x11000680 0x0 0x80 0x0 0x11000700 0x0 0x80 0x0 0x11000780 0x0 0x80 0x0 0x11000800 0x0 0x80>;
	};

	dpe@15028000 {
		clock-names = "DPE_CG_IMG_DPE";
		clocks = <0x4b 0x3>;
		compatible = "mediatek,dpe";
		interrupts = <0x0 0x100 0x8>;
		reg = <0x0 0x15028000 0x0 0x1000>;
	};

	dramc0@1001d000 {
		compatible = "mediatek,dramc0";
		reg = <0x0 0x1001d000 0x0 0x1000>;
	};

	dramc@1022a000 {
		compatible = "mediatek,dramc";
		reg = <0x0 0x1022a000 0x0 0x2000 0x0 0x10232000 0x0 0x2000 0x0 0x1022c000 0x0 0x1000 0x0 0x10234000 0x0 0x1000 0x0 0x10228000 0x0 0x2000 0x0 0x10230000 0x0 0x2000 0x0 0x1022e000 0x0 0x1000 0x0 0x10236000 0x0 0x1000>;
	};

	dramc_nao@1021d000 {
		compatible = "mediatek,dramc_nao";
		reg = <0x0 0x1021d000 0x0 0x1000>;
	};

	dsi0@14014000 {
		compatible = "mediatek,dsi0";
		interrupts = <0x0 0xe1 0x8>;
		reg = <0x0 0x14014000 0x0 0x1000>;
	};

	dsi_te {
		compatible = "mediatek, DSI_TE-eint";
		linux,phandle = <0xb1>;
		phandle = <0xb1>;
		status = "disabled";
	};

	dvfsp@00110800 {
		compatible = "mediatek,mt6765-dvfsp";
		reg = <0x0 0x110800 0x0 0x1400 0x0 0x110800 0x0 0x1400>;
	};

	dvfsp@10227000 {
		compatible = "mediatek,dvfsp";
		reg = <0x0 0x10227000 0x0 0x1000>;
	};

	dvfsrc@10012000 {
		compatible = "mediatek,dvfsrc";
		reg = <0x0 0x10012000 0x0 0x1000 0x0 0x110780 0x0 0x80>;
	};

	dxcc_sec@10210000 {
		compatible = "mediatek,dxcc_sec";
		interrupts = <0x0 0xa2 0x4>;
		reg = <0x0 0x10210000 0x0 0x1000>;
	};

	dynamic_options {
		compatible = "mediatek,dynamic_options";
		linux,phandle = <0xca>;
		phandle = <0xca>;
	};

	eas {
		eff_turn_point = <0x1d3>;
		tiny = <0x32>;
	};

	eem_fsm@1100b000 {
		compatible = "mediatek,eem_fsm";
		interrupts = <0x0 0x7d 0x8>;
		reg = <0x0 0x1100b000 0x0 0x1000>;
	};

	efuse_dbg@10004000 {
		compatible = "mediatek,efuse_dbg";
		reg = <0x0 0x10004000 0x0 0x1000>;
	};

	efusec@11c50000 {
		compatible = "mediatek,efusec";
		reg = <0x0 0x11c50000 0x0 0x10000>;
	};

	emi@10219000 {
		compatible = "mediatek,emi";
		interrupts = <0x0 0x90 0x8>;
		reg = <0x0 0x10219000 0x0 0x1000 0x0 0x10226000 0x0 0x1000 0x0 0x1022d000 0x0 0x1000 0x0 0x10235000 0x0 0x1000>;
	};

	fdvt@1502b000 {
		clock-names = "FD_CLK_IMG_FDVT";
		clocks = <0x4b 0x2>;
		compatible = "mediatek,fdvt";
		interrupts = <0x0 0x102 0x8>;
		reg = <0x0 0x1502b000 0x0 0x1000>;
	};

	fhctl@1000ce00 {
		compatible = "mediatek,fhctl";
		reg = <0x0 0x1000ce00 0x0 0x200>;
	};

	fingerprint {
		compatible = "goodix,goodix-fp";
		linux,phandle = <0x8c>;
		phandle = <0x8c>;
		status = "okay";
	};

	flashlight_core {
		compatible = "mediatek,flashlight_core";
		linux,phandle = <0xb3>;
		phandle = <0xb3>;
	};

	flashlight_ntc {
		compatible = "mediatek,flashlight_ntc";
		io-channel-names = "thermistor-ch3";
		io-channels = <0x35 0x3>;
		linux,phandle = <0xa1>;
		phandle = <0xa1>;
	};

	flashlights_gpio {
		compatible = "mediatek,flashlights_dummy_gpio";
		linux,phandle = <0xb5>;
		phandle = <0xb5>;
		pinctrl-0 = <0x54>;
		pinctrl-1 = <0x55>;
		pinctrl-2 = <0x56>;
		pinctrl-3 = <0x57>;
		pinctrl-4 = <0x58>;
		pinctrl-5 = <0x59>;
		pinctrl-names = "default", "strobe_on_gpio", "strobe_off_gpio", "torch_on_gpio", "torch_off_gpio", "torch_pwm_gpio";
		status = "okay";

		channel@1 {
			ct = <0x0>;
			part = <0x0>;
			type = <0x0>;
		};
	};

	flashlights_mt6370 {
		compatible = "mediatek,flashlights_mt6370";
		decouple = <0x0>;
		linux,phandle = <0xb4>;
		phandle = <0xb4>;

		channel@1 {
			ct = <0x0>;
			part = <0x0>;
			type = <0x0>;
		};

		channel@2 {
			ct = <0x1>;
			part = <0x0>;
			type = <0x0>;
		};
	};

	fpc_interrupt {
		compatible = "fpc,fpc_irq";
		linux,phandle = <0x8e>;
		phandle = <0x8e>;
	};

	gauge_timer {
		compatible = "mediatek,gauge_timer_service";
	};

	gce@10238000 {
		#clock-cells = <0x1>;
		ap_dma_base = <0x18010000 0x17 0xffff0000>;
		audio_base = <0x17000000 0x12 0xffff0000>;
		buf_underrun_event_0 = <0x8c>;
		camsys1_base = <0x180a0000 0x1c 0xffff0000>;
		camsys2_base = <0x180b0000 0x1d 0xffff0000>;
		camsys_base = <0x18080000 0x1b 0xffff0000>;
		clock-names = "GCE", "GCE_TIMER";
		clocks = <0x27 0x9 0x27 0x18>;
		compatible = "mediatek,gce", "syscon";
		conn_peri_base = <0x18820000 0x7 0xffff0000>;
		dip_cq_thread0_frame_done = <0x101>;
		dip_cq_thread10_frame_done = <0x10b>;
		dip_cq_thread11_frame_done = <0x10c>;
		dip_cq_thread12_frame_done = <0x10d>;
		dip_cq_thread13_frame_done = <0x10e>;
		dip_cq_thread14_frame_done = <0x10f>;
		dip_cq_thread15_frame_done = <0x110>;
		dip_cq_thread16_frame_done = <0x111>;
		dip_cq_thread17_frame_done = <0x112>;
		dip_cq_thread18_frame_done = <0x113>;
		dip_cq_thread1_frame_done = <0x102>;
		dip_cq_thread2_frame_done = <0x103>;
		dip_cq_thread3_frame_done = <0x104>;
		dip_cq_thread4_frame_done = <0x105>;
		dip_cq_thread5_frame_done = <0x106>;
		dip_cq_thread6_frame_done = <0x107>;
		dip_cq_thread7_frame_done = <0x108>;
		dip_cq_thread8_frame_done = <0x109>;
		dip_cq_thread9_frame_done = <0x10a>;
		disp_2l_ovl0_frame_done = <0x1c>;
		disp_2l_ovl0_sof = <0x8>;
		disp_aal0_frame_done = <0x22>;
		disp_aal0_sof = <0xd>;
		disp_ccorr0_frame_done = <0x21>;
		disp_ccorr0_sof = <0xc>;
		disp_color0_frame_done = <0x20>;
		disp_color0_sof = <0xb>;
		disp_dither0_frame_done = <0x24>;
		disp_dither0_sof = <0xf>;
		disp_dither_base = <0x14010000 0x2 0xffff0000>;
		disp_dsi0_frame_done = <0x25>;
		disp_dsi0_sof = <0x10>;
		disp_gamma0_frame_done = <0x23>;
		disp_gamma0_sof = <0xe>;
		disp_ovl0_frame_done = <0x1b>;
		disp_ovl0_frame_rst_done_pusle = <0x98>;
		disp_ovl0_sof = <0x7>;
		disp_pwm0_sof = <0x13>;
		disp_rdma0_frame_done = <0x1e>;
		disp_rdma0_sof = <0x9>;
		disp_rsz0_frame_done = <0x1d>;
		disp_rsz0_sof = <0x11>;
		disp_wdma0_frame_done = <0x1f>;
		disp_wdma0_rst_done = <0x93>;
		disp_wdma0_sof = <0xa>;
		dsi0_done_event = <0x8f>;
		dsi0_irq_event = <0x8e>;
		dsi0_te_event = <0x8d>;
		dve_frame_done = <0x114>;
		g3d_config_base = <0x13000000 0x0 0xffff0000>;
		gce_base = <0x18020000 0x18 0xffff0000>;
		gcpu_base = <0x10050000 0xf 0xffff0000>;
		img_dl_relay_sof = <0x12>;
		imgsys_base = <0x15020000 0x4 0xffff0000>;
		infra_na3_base = <0x10010000 0xb 0xffff0000>;
		infra_na4_base = <0x10020000 0xc 0xffff0000>;
		interrupts = <0x0 0x9a 0x8 0x0 0x9b 0x8>;
		jpgdec_done = <0x123>;
		jpgenc_done = <0x122>;
		kp_base = <0x18840000 0x9 0xffff0000>;
		linux,phandle = <0x92>;
		max_prefetch_cnt = <0x1>;
		mboxes = <0x33 0x0 0x0 0x4 0x33 0x1 0x0 0x4 0x33 0x2 0x0 0x5 0x33 0x3 0x0 0x4 0x33 0x4 0x0 0x4 0x33 0x5 0x0 0x4 0x33 0x6 0x0 0x3 0x33 0x7 0xffffffff 0x2 0x33 0x8 0x0 0x1 0x33 0x9 0x0 0x1 0x33 0xa 0x0 0x1 0x33 0xb 0x0 0x1 0x33 0xc 0x0 0x1 0x33 0xd 0x0 0x1 0x33 0xe 0x0 0x1 0x33 0xf 0x0 0x1>;
		mcucfg_base = <0x10040000 0xe 0xffff0000>;
		mdp_ccorr0 = <0x31>;
		mdp_ccorr0_frame_done = <0x15>;
		mdp_ccorr0_sof = <0x1>;
		mdp_color0 = <0x30>;
		mdp_rdma0 = <0x2a>;
		mdp_rdma0_frame_done = <0x14>;
		mdp_rdma0_rst_done = <0x97>;
		mdp_rdma0_sof = <0x0>;
		mdp_rsz0 = <0x2b>;
		mdp_rsz0_frame_done = <0x16>;
		mdp_rsz0_sof = <0x2>;
		mdp_rsz1 = <0x2c>;
		mdp_rsz1_frame_done = <0x17>;
		mdp_rsz1_sof = <0x3>;
		mdp_tdshp0 = <0x2f>;
		mdp_tdshp0_frame_done = <0x1a>;
		mdp_tdshp0_sof = <0x6>;
		mdp_wdma0 = <0x2d>;
		mdp_wdma_frame_done = <0x19>;
		mdp_wdma_rst_done = <0x94>;
		mdp_wdma_sof = <0x4>;
		mdp_wrot0 = <0x2e>;
		mdp_wrot0_rst_done = <0x95>;
		mdp_wrot0_sof = <0x5>;
		mdp_wrot0_write_frame_done = <0x18>;
		mediatek,mailbox-gce = <0x33>;
		mipitx0_base = <0x11c80000 0x63 0xffff0000>;
		mm_mutex = <0x32>;
		mm_na_base = <0x14020000 0x3 0xffff0000>;
		mmsys_config = <0x29>;
		mmsys_config_base = <0x14000000 0x1 0xffff0000>;
		msdc2_base = <0x17020000 0x14 0xffff0000>;
		msdc3_base = <0x18000000 0x16 0xffff0000>;
		phandle = <0x92>;
		prefetch_size = <0x60>;
		pwm_sw_base = <0x1100e000 0x63 0xffff0000>;
		reg = <0x0 0x10238000 0x0 0x4000>;
		rsc_frame_done = <0x116>;
		scp_base = <0x10030000 0xd 0xffff0000>;
		scp_sram_base = <0x10000000 0xa 0xffff0000>;
		secure_thread = <0x8 0xa>;
		sram_share_cnt = <0x1>;
		sram_share_engine = <0xa>;
		sram_share_event = <0x2c6>;
		sram_size_cpr_64 = <0x40>;
		stream_done_0 = <0x82>;
		stream_done_1 = <0x83>;
		stream_done_2 = <0x84>;
		stream_done_3 = <0x85>;
		stream_done_4 = <0x86>;
		stream_done_5 = <0x87>;
		stream_done_6 = <0x88>;
		stream_done_7 = <0x89>;
		stream_done_8 = <0x8a>;
		stream_done_9 = <0x8b>;
		thread_count = <0x10>;
		topckgen_base = <0x18830000 0x8 0xffff0000>;
		usb0_base = <0x10200000 0x10 0xffff0000>;
		usb_sif_base = <0x10280000 0x11 0xffff0000>;
		vdec1_base = <0x17030000 0x15 0xffff0000>;
		vdec2_base = <0x18040000 0x19 0xffff0000>;
		vdec3_base = <0x18050000 0x1a 0xffff0000>;
		vdec_base = <0x17010000 0x13 0xffff0000>;
		vdec_gcon_base = <0x18800000 0x5 0xffff0000>;
		venc_128byte_cnt_done = <0x125>;
		venc_done = <0x121>;
		venc_gcon_base = <0x18810000 0x6 0xffff0000>;
		venc_mb_done = <0x124>;
		wmf_frame_done = <0x115>;
	};

	gce_mbox@10238000 {
		#gce-event-cells = <0x1>;
		#gce-subsys-cells = <0x2>;
		#mbox-cells = <0x3>;
		clock-names = "gce", "GCE_TIMER";
		clocks = <0x27 0x9 0x27 0x18>;
		compatible = "mediatek,mailbox-gce";
		interrupts = <0x0 0x9a 0x8 0x0 0x9b 0x8>;
		linux,phandle = <0x33>;
		phandle = <0x33>;
		reg = <0x0 0x10238000 0x0 0x4000>;
	};

	gce_mbox_svp@10238000 {
		#mbox-cells = <0x3>;
		clock-names = "gce", "GCE_TIMER";
		clocks = <0x27 0x9 0x27 0x18>;
		compatible = "mediatek,mailbox-gce-svp";
		interrupts = <0x0 0x9a 0x8 0x0 0x9b 0x8>;
		linux,phandle = <0x93>;
		phandle = <0x93>;
		reg = <0x0 0x10238000 0x0 0x4000>;
	};

	gic500@0c000000 {
		compatible = "mediatek,gic500";
		reg = <0x0 0xc000000 0x0 0x1000>;
	};

	gic_cpu@0c400000 {
		compatible = "mediatek,gic_cpu";
		reg = <0x0 0xc400000 0x0 0x40000>;
	};

	gpio {
		compatible = "mediatek,gpio_usage_mapping";
		linux,phandle = <0x64>;
		phandle = <0x64>;
	};

	gpio@10005000 {
		compatible = "mediatek,gpio";
		linux,phandle = <0x65>;
		phandle = <0x65>;
		reg = <0x0 0x10005000 0x0 0x1000>;
	};

	gps {
		compatible = "mediatek,gps";
	};

	gpufreq {
		clock-names = "clk_mux", "clk_main_parent", "clk_sub_parent", "mtcmos_mfg_async", "mtcmos_mfg", "mtcmos_mfg_core0";
		clocks = <0x1e 0x64 0x1e 0x26 0x1f 0x28 0x8 0x28 0x4 0x28 0x7>;
		compatible = "mediatek,mt6765-gpufreq";
	};

	gse_1 {
		linux,phandle = <0xc6>;
		phandle = <0xc6>;
	};

	hacc@1000a000 {
		compatible = "mediatek,hacc";
		interrupts = <0x0 0xbd 0x8>;
		reg = <0x0 0x1000a000 0x0 0x1000>;
	};

	i2c0@11007000 {
		aed = <0x1a>;
		clock-div = <0x5>;
		clock-names = "main", "dma";
		clocks = <0x27 0xb 0x27 0x26>;
		compatible = "mediatek,i2c";
		eh_cfg = <0x20>;
		gpio_start = <0x10002a00>;
		id = <0x0>;
		interrupts = <0x0 0x54 0x8>;
		linux,phandle = <0x98>;
		mediatek,hs_only;
		mem_len = <0x200>;
		phandle = <0x98>;
		pu_cfg = <0x50>;
		reg = <0x0 0x11007000 0x0 0x1000 0x0 0x11000080 0x0 0x80>;
		rsel_cfg = <0x70>;
		scl-gpio-id = <0x53>;
		sda-gpio-id = <0x52>;
	};

	i2c1@11008000 {
		aed = <0x1a>;
		clock-div = <0x5>;
		clock-names = "main", "dma";
		clocks = <0x27 0xb 0x27 0x26>;
		compatible = "mediatek,i2c";
		eh_cfg = <0x20>;
		gpio_start = <0x10002a00>;
		id = <0x1>;
		interrupts = <0x0 0x55 0x8>;
		linux,phandle = <0x99>;
		mediatek,hs_only;
		mem_len = <0x200>;
		phandle = <0x99>;
		pu_cfg = <0x50>;
		reg = <0x0 0x11008000 0x0 0x1000 0x0 0x11000100 0x0 0x80>;
		rsel_cfg = <0x70>;
		scl-gpio-id = <0x54>;
		sda-gpio-id = <0x51>;
	};

	i2c2@11009000 {
		aed = <0x1a>;
		ch_offset_ccu = <0x200>;
		ch_offset_default = <0x100>;
		clock-div = <0x5>;
		clock-names = "main", "dma";
		clocks = <0x27 0xb 0x27 0x26>;
		compatible = "mediatek,i2c";
		eh_cfg = <0x20>;
		gpio_start = <0x10002800>;
		id = <0x2>;
		interrupts = <0x0 0x56 0x8>;
		linux,phandle = <0x9a>;
		mediatek,hs_only;
		mem_len = <0x200>;
		phandle = <0x9a>;
		pu_cfg = <0x60>;
		reg = <0x0 0x11009000 0x0 0x1000 0x0 0x11000180 0x0 0x180>;
		rsel_cfg = <0xa0>;
		scl-gpio-id = <0x67>;
		sda-gpio-id = <0x68>;
	};

	i2c3@1100f000 {
		#address-cells = <0x1>;
		#size-cells = <0x0>;
		aed = <0x1a>;
		ch_offset_default = <0x100>;
		clock-div = <0x5>;
		clock-names = "main", "dma";
		clocks = <0x27 0xb 0x27 0x26>;
		compatible = "mediatek,i2c";
		eh_cfg = <0x20>;
		gpio_start = <0x10002600>;
		id = <0x3>;
		interrupts = <0x0 0x57 0x8>;
		linux,phandle = <0x9b>;
		mediatek,hs_only;
		mem_len = <0x200>;
		phandle = <0x9b>;
		pu_cfg = <0x90>;
		reg = <0x0 0x1100f000 0x0 0x1000 0x0 0x11000300 0x0 0x100>;
		rsel_cfg = <0xb0>;
		scl-gpio-id = <0x32>;
		sda-gpio-id = <0x33>;

		i2c_lcd_bias@3e {
			compatible = "mediatek,i2c_lcd_bias";
			reg = <0x3e>;
		};

		pn553@28 {
			compatible = "mediatek,pn553nfc";
			reg = <0x28>;
			status = "okay";
		};
	};

	i2c4@11011000 {
		aed = <0x1a>;
		ch_offset_ccu = <0x200>;
		ch_offset_default = <0x100>;
		clock-div = <0x5>;
		clock-names = "main", "dma";
		clocks = <0x27 0xb 0x27 0x26>;
		compatible = "mediatek,i2c";
		eh_cfg = <0x20>;
		gpio_start = <0x10002800>;
		id = <0x4>;
		interrupts = <0x0 0x58 0x8>;
		linux,phandle = <0x9c>;
		mediatek,hs_only;
		mem_len = <0x200>;
		phandle = <0x9c>;
		pu_cfg = <0x60>;
		reg = <0x0 0x11011000 0x0 0x1000 0x0 0x11000400 0x0 0x180>;
		rsel_cfg = <0xa0>;
		scl-gpio-id = <0x69>;
		sda-gpio-id = <0x6a>;
	};

	i2c5@11016000 {
		aed = <0x1a>;
		clock-div = <0x5>;
		clock-names = "main", "dma";
		clocks = <0x27 0xb 0x27 0x26>;
		compatible = "mediatek,i2c";
		eh_cfg = <0x20>;
		gpio_start = <0x10002600>;
		id = <0x5>;
		interrupts = <0x0 0x82 0x8>;
		linux,phandle = <0x9d>;
		mediatek,hs_only;
		mem_len = <0x200>;
		phandle = <0x9d>;
		pu_cfg = <0x90>;
		reg = <0x0 0x11016000 0x0 0x1000 0x0 0x11000580 0x0 0x80>;
		rsel_cfg = <0xb0>;
		scl-gpio-id = <0x30>;
		sda-gpio-id = <0x31>;

		rt-swchg@53 {
			compatible = "richtek,swchg";
			reg = <0x53>;
			rt,intr_gpio = <0x20 0x2a 0x0>;
			rt,intr_gpio_num = <0x2a>;
			status = "okay";

			rt9471 {
				aicr = <0x7a120>;
				charger_name = "primary_chg";
				chg_alias_name = "rt9471_chg";
				cv = <0x426030>;
				en-qon-rst;
				en-safe-tmr;
				en-te;
				ichg = <0xf4240>;
				ieoc = <0x30d40>;
				interrupt-names = "wdt", "chg_mivr", "vbus_gd", "chg_rdy", "bc12_done", "detach", "vac_ov", "otg_fault";
				mivr = <0x432380>;
				mivr-track = <0x0>;
				rm-name = "rt9471";
				rm-slave-addr = [53];
				safe-tmr = <0xa>;
				wdt = <0x28>;
			};
		};
	};

	i2c6@1100d000 {
		aed = <0x1a>;
		ch_offset_ccu = <0x200>;
		ch_offset_default = <0x100>;
		clock-div = <0x5>;
		clock-names = "main", "dma";
		clocks = <0x27 0xb 0x27 0x26>;
		compatible = "mediatek,i2c";
		eh_cfg = <0x20>;
		gpio_start = <0x10002c00>;
		id = <0x6>;
		interrupts = <0x0 0x83 0x8>;
		linux,phandle = <0x9e>;
		mediatek,hs_only;
		mem_len = <0x200>;
		phandle = <0x9e>;
		pu_cfg = <0x50>;
		reg = <0x0 0x1100d000 0x0 0x1000 0x0 0x11000600 0x0 0x80>;
		rsel_cfg = <0x70>;
		scl-gpio-id = <0xa1>;
		sda-gpio-id = <0xa2>;
	};

	i2c7 {
		linux,phandle = <0xc0>;
		phandle = <0xc0>;
	};

	i2c8 {
		linux,phandle = <0xc1>;
		phandle = <0xc1>;
	};

	i2c9 {
		linux,phandle = <0xc2>;
		phandle = <0xc2>;
	};

	i2c_common {
		check_max_freq = [01];
		cnt_constraint = [01];
		compatible = "mediatek,i2c_common";
		dma_support = [02];
		ext_time_config = [18 01];
		idvfs = [01];
		linux,phandle = <0x97>;
		phandle = <0x97>;
		set_dt_div = [01];
		set_ltiming = [01];
		ver = [02];
	};

	imgsys@15020000 {
		#clock-cells = <0x1>;
		clock-names = "ISP_SCP_SYS_DIS", "ISP_SCP_SYS_ISP", "ISP_SCP_SYS_CAM", "ISP_CLK_IMG_DIP", "ISP_CLK_CAM", "ISP_CLK_CAMTG", "ISP_CLK_CAM_SENINF", "ISP_CLK_CAMSV0", "ISP_CLK_CAMSV1", "ISP_CLK_CAMSV2";
		clocks = <0x28 0x3 0x28 0x5 0x28 0x9 0x4b 0x1 0x4c 0x2 0x4c 0x3 0x4c 0x4 0x4c 0x5 0x4c 0x6 0x4c 0x7>;
		compatible = "mediatek,imgsys", "syscon";
		linux,phandle = <0x4b>;
		phandle = <0x4b>;
		reg = <0x0 0x15020000 0x0 0x1000>;
	};

	imp_iic@11017000 {
		compatible = "mediatek,imp_iic";
		reg = <0x0 0x11017000 0x0 0x1000>;
	};

	infra_mbist@1020d000 {
		compatible = "mediatek,infra_mbist";
		reg = <0x0 0x1020d000 0x0 0x1000>;
	};

	infracfg@1020e000 {
		compatible = "mediatek,infracfg";
		reg = <0x0 0x1020e000 0x0 0x1000>;
	};

	infracfg_ao@10001000 {
		#clock-cells = <0x1>;
		compatible = "mediatek,infracfg_ao", "syscon";
		interrupts = <0x0 0x93 0x1>;
		linux,phandle = <0x27>;
		phandle = <0x27>;
		reg = <0x0 0x10001000 0x0 0x1000>;
	};

	interrupt-controller@0c000000 {
		#address-cells = <0x2>;
		#interrupt-cells = <0x3>;
		#redistributor-regions = <0x1>;
		#size-cells = <0x2>;
		compatible = "arm,gic-v3";
		interrupt-controller;
		interrupt-parent = <0x11>;
		interrupts = <0x1 0x9 0x4>;
		linux,phandle = <0x11>;
		phandle = <0x11>;
		reg = <0x0 0xc000000 0x0 0x40000 0x0 0xc100000 0x0 0x200000 0x0 0x10200a80 0x0 0x50>;
	};

	intpol-controller@10200a80 {
		#interrupt-cells = <0x3>;
		compatible = "mediatek,mt6577-sysirq";
		interrupt-controller;
		interrupt-parent = <0x11>;
		linux,phandle = <0x1>;
		phandle = <0x1>;
		reg = <0x0 0x10200a80 0x0 0x50>;
	};

	io_cfg_bl@10002600 {
		compatible = "mediatek,io_cfg_bl";
		reg = <0x0 0x10002600 0x0 0x200>;
	};

	io_cfg_lb@10002400 {
		compatible = "mediatek,io_cfg_lb";
		reg = <0x0 0x10002400 0x0 0x200>;
	};

	io_cfg_lm@10002200 {
		compatible = "mediatek,io_cfg_lm";
		reg = <0x0 0x10002200 0x0 0x200>;
	};

	io_cfg_lt@10002000 {
		compatible = "mediatek,io_cfg_lt";
		reg = <0x0 0x10002000 0x0 0x200>;
	};

	io_cfg_rb@10002a00 {
		compatible = "mediatek,io_cfg_rb";
		reg = <0x0 0x10002a00 0x0 0x200>;
	};

	io_cfg_rr@10002800 {
		compatible = "mediatek,io_cfg_rr";
		reg = <0x0 0x10002800 0x0 0x200>;
	};

	io_cfg_rt@10002c00 {
		compatible = "mediatek,io_cfg_rt";
		reg = <0x0 0x10002c00 0x0 0x200>;
	};

	iocfg_0@10002000 {
		compatible = "mediatek,iocfg_0";
		reg = <0x0 0x10002000 0x0 0x200>;
	};

	iocfg_1@10002200 {
		compatible = "mediatek,iocfg_1";
		reg = <0x0 0x10002200 0x0 0x200>;
	};

	iocfg_2@10002400 {
		compatible = "mediatek,iocfg_2";
		reg = <0x0 0x10002400 0x0 0x200>;
	};

	iocfg_3@10002600 {
		compatible = "mediatek,iocfg_3";
		reg = <0x0 0x10002600 0x0 0x200>;
	};

	iocfg_4@10002800 {
		compatible = "mediatek,iocfg_4";
		reg = <0x0 0x10002800 0x0 0x200>;
	};

	iocfg_5@10002a00 {
		compatible = "mediatek,iocfg_5";
		reg = <0x0 0x10002a00 0x0 0x200>;
	};

	irq_nfc {
		compatible = "mediatek,irq_nfc-eint";
		linux,phandle = <0xaf>;
		phandle = <0xaf>;
	};

	irtx_pwm {
		compatible = "mediatek,irtx-pwm";
		linux,phandle = <0xbc>;
		phandle = <0xbc>;
		pwm_ch = <0x0>;
		pwm_data_invert = <0x0>;
	};

	kd_camera_hw1@1a040000 {
		clock-names = "CLK_TOP_CAMTG_SEL", "CLK_TOP_CAMTG1_SEL", "CLK_TOP_CAMTG2_SEL", "CLK_TOP_CAMTG3_SEL", "CLK_MCLK_6M", "CLK_MCLK_12M", "CLK_MCLK_13M", "CLK_MCLK_48M", "CLK_MCLK_52M", "CLK_MCLK_24M", "CLK_MCLK_26M", "CLK_CAM_SENINF_CG", "CLK_MIPI_C0_26M_CG", "CLK_MIPI_C1_26M_CG", "CLK_MIPI_ANA_0A_CG", "CLK_MIPI_ANA_0B_CG", "CLK_MIPI_ANA_1A_CG", "CLK_MIPI_ANA_1B_CG", "CLK_MIPI_ANA_2A_CG", "CLK_MIPI_ANA_2B_CG", "CLK_TOP_CAMTM_SEL_CG", "CLK_TOP_CAMTM_208_CG", "CLK_SCP_SYS_CAM";
		clocks = <0x1e 0x66 0x1e 0x67 0x1e 0x68 0x1e 0x69 0x1e 0x14 0x1e 0x13 0x1e 0x1d 0x1e 0x11 0x1e 0x1c 0x1e 0x12 0x1f 0x4c 0x4 0x44 0xe 0x44 0x12 0x4e 0x0 0x4f 0x0 0x50 0x0 0x51 0x0 0x52 0x0 0x53 0x0 0x1e 0x7d 0x1e 0x1a 0x28 0x9>;
		compatible = "mediatek,camera_hw";
		linux,phandle = <0xb2>;
		phandle = <0xb2>;
		reg = <0x0 0x1a040000 0x0 0x1000>;
	};

	kp@10010000 {
		compatible = "mediatek,kp";
		interrupts = <0x0 0xb4 0x2>;
		linux,phandle = <0x1a>;
		phandle = <0x1a>;
		reg = <0x0 0x10010000 0x0 0x1000>;
	};

	l2c_parity {
		compatible = "mediatek,l2c_parity-v1";
		interrupts = <0x0 0x18 0x4 0x0 0x19 0x4>;
	};

	lcd_bias {
		compatible = "mediatek,gpio_lcd_bias";
		linux,phandle = <0xcb>;
		phandle = <0xcb>;
		pinctrl-0 = <0x5b>;
		pinctrl-1 = <0x5c>;
		pinctrl-2 = <0x5d>;
		pinctrl-3 = <0x5e>;
		pinctrl-4 = <0x5f>;
		pinctrl-names = "default", "lcd_bias_gpio_enp0", "lcd_bias_gpio_enp1", "lcd_bias_gpio_enn0", "lcd_bias_gpio_enn1";
		status = "okay";
	};

	lcm {
		compatible = "mediatek,lcm_mode";
		linux,phandle = <0x8a>;
		phandle = <0x8a>;
	};

	lk_charger {
		ac_charger_current = <0x668a0>;
		ac_charger_input_current = <0x1e8480>;
		charging_host_charger_current = <0x668a0>;
		compatible = "mediatek,lk_charger";
		enable_anime;
		fast_charge_voltage = <0x2f4d60>;
		linux,phandle = <0xb7>;
		max_charger_voltage = <0x588040>;
		non_std_ac_charger_current = <0x61a80>;
		pd_charger_current = <0x7a120>;
		phandle = <0xb7>;
		power_path_support;
		ta_ac_charger_current = <0x2dc6c0>;
		temp_t1_threshold = <0x0>;
		temp_t3_threshold = <0x2d>;
		temp_t4_threshold = <0x32>;
		usb_charger_current = <0x668a0>;
	};

	m4u@10205000 {
		#iommu-cells = <0x1>;
		cell-index = <0x0>;
		compatible = "mediatek,iommu_v0";
		interrupts = <0x0 0x9e 0x8>;
		linux,phandle = <0x5a>;
		mediatek,larbs = <0x23 0x24 0x25 0x26>;
		phandle = <0x5a>;
		reg = <0x0 0x10205000 0x0 0x1000>;
	};

	mbist@17050000 {
		compatible = "mediatek,mbist";
		reg = <0x0 0x17050000 0x0 0x10000>;
	};

	mbist_ao@10013000 {
		compatible = "mediatek,mbist_ao";
		reg = <0x0 0x10013000 0x0 0x1000>;
	};

	mcdi@0010fc00 {
		compatible = "mediatek,mt6765-mcdi";
		reg = <0x0 0x10fc00 0x0 0x800>;
	};

	mcucfg@10200000 {
		compatible = "mediatek,mcucfg";
		interrupts = <0x0 0x0 0x8>;
		reg = <0x0 0x10200000 0x0 0x1000>;
	};

	mcucfg_mp0_counter@10200000 {
		compatible = "mediatek,mcucfg_mp0_counter";
		reg = <0x0 0x10200000 0x0 0x4000>;
	};

	mcupm_reg@10216000 {
		compatible = "mediatek,mcupm_reg";
		reg = <0x0 0x10216000 0x0 0x1000>;
	};

	mcupm_sram0@10217000 {
		compatible = "mediatek,mcupm_sram0";
		reg = <0x0 0x10217000 0x0 0x1000>;
	};

	mcupm_sram1@10218000 {
		compatible = "mediatek,mcupm_sram1";
		reg = <0x0 0x10218000 0x0 0x1000>;
	};

	mcupm_sram2@10211000 {
		compatible = "mediatek,mcupm_sram2";
		reg = <0x0 0x10211000 0x0 0x1000>;
	};

	mcupm_sram3@10213000 {
		compatible = "mediatek,mcupm_sram3";
		reg = <0x0 0x10213000 0x0 0x1000>;
	};

	md1_sim1_hot_plug_eint {
		linux,phandle = <0xc7>;
		phandle = <0xc7>;
	};

	md1_sim2_hot_plug_eint {
		linux,phandle = <0xc8>;
		phandle = <0xc8>;
	};

	md_ccif0@1020a000 {
		compatible = "mediatek,md_ccif0";
		reg = <0x0 0x1020a000 0x0 0x1000>;
	};

	md_ccif1@1020c000 {
		compatible = "mediatek,md_ccif1";
		reg = <0x0 0x1020c000 0x0 0x1000>;
	};

	md_ccif2@1023d000 {
		compatible = "mediatek,md_ccif2";
		reg = <0x0 0x1023d000 0x0 0x1000>;
	};

	md_ccif3@1023f000 {
		compatible = "mediatek,md_ccif3";
		reg = <0x0 0x1023f000 0x0 0x1000>;
	};

	mdcldma@10014000 {
		clock-names = "scp-sys-md1-main", "infra-cldma-bclk", "infra-ccif-ap", "infra-ccif-md", "infra-ccif1-ap", "infra-ccif1-md", "infra-ccif2-ap", "infra-ccif2-md";
		clocks = <0x28 0x0 0x27 0x32 0x27 0x29 0x27 0x2c 0x27 0x23 0x27 0x24 0x27 0x51 0x27 0x52>;
		compatible = "mediatek,mdcldma";
		interrupts = <0x0 0xa5 0x4 0x0 0x94 0x8 0x0 0x95 0x8 0x0 0x105 0x2>;
		linux,phandle = <0x1c>;
		mediatek,cldma_capability = <0x6>;
		mediatek,md_id = <0x0>;
		phandle = <0x1c>;
		reg = <0x0 0x10014000 0x0 0x1000 0x0 0x1021b000 0x0 0x1000 0x0 0x10209000 0x0 0x1000 0x0 0x1020a000 0x0 0x1000>;
	};

	mdcldmain@1021c000 {
		compatible = "mediatek,mdcldmain";
		reg = <0x0 0x1021c000 0x0 0x400>;
	};

	mdcldmain_ao@10015000 {
		compatible = "mediatek,mdcldmain_ao";
		reg = <0x0 0x10015000 0x0 0x400>;
	};

	mdcldmamisc@1021c800 {
		compatible = "mediatek,mdcldmamisc";
		reg = <0x0 0x1021c800 0x0 0x1000>;
	};

	mdcldmamisc_ao@10015800 {
		compatible = "mediatek,mdcldmamisc_ao";
		reg = <0x0 0x10015800 0x0 0x400>;
	};

	mdcldmaout@1021c400 {
		compatible = "mediatek,mdcldmaout";
		reg = <0x0 0x1021c400 0x0 0x400>;
	};

	mdcldmaout_ao@10015400 {
		compatible = "mediatek,mdcldmaout_ao";
		reg = <0x0 0x10015400 0x0 0x400>;
	};

	mdp_ccorr0@14005000 {
		clock-names = "MDP_CCORR";
		clocks = <0x29 0x1>;
		compatible = "mediatek,mdp_ccorr0";
		interrupts = <0x0 0xe2 0x8>;
		linux,phandle = <0x31>;
		phandle = <0x31>;
		reg = <0x0 0x14005000 0x0 0x1000>;
	};

	mdp_rdma0@14004000 {
		clock-names = "MDP_RDMA0";
		clocks = <0x29 0x0>;
		compatible = "mediatek,mdp_rdma0";
		interrupts = <0x0 0xd3 0x8>;
		linux,phandle = <0x2a>;
		phandle = <0x2a>;
		reg = <0x0 0x14004000 0x0 0x1000>;
	};

	mdp_rsz0@14006000 {
		clock-names = "MDP_RSZ0";
		clocks = <0x29 0x2>;
		compatible = "mediatek,mdp_rsz0";
		interrupts = <0x0 0xd4 0x8>;
		linux,phandle = <0x2b>;
		phandle = <0x2b>;
		reg = <0x0 0x14006000 0x0 0x1000>;
	};

	mdp_rsz1@14007000 {
		clock-names = "MDP_RSZ1";
		clocks = <0x29 0x3>;
		compatible = "mediatek,mdp_rsz1";
		interrupts = <0x0 0xd5 0x8>;
		linux,phandle = <0x2c>;
		phandle = <0x2c>;
		reg = <0x0 0x14007000 0x0 0x1000>;
	};

	mdp_tdshp0@1400a000 {
		clock-names = "MDP_TDSHP";
		clocks = <0x29 0x4>;
		compatible = "mediatek,mdp_tdshp0";
		linux,phandle = <0x2f>;
		phandle = <0x2f>;
		reg = <0x0 0x1400a000 0x0 0x1000>;
	};

	mdp_wdma0@14008000 {
		clock-names = "MDP_WDMA";
		clocks = <0x29 0x6>;
		compatible = "mediatek,mdp_wdma0";
		interrupts = <0x0 0xd8 0x8>;
		linux,phandle = <0x2d>;
		phandle = <0x2d>;
		reg = <0x0 0x14008000 0x0 0x1000>;
	};

	mdp_wrot0@14009000 {
		clock-names = "MDP_WROT0";
		clocks = <0x29 0x5>;
		compatible = "mediatek,mdp_wrot0";
		interrupts = <0x0 0xd7 0x8>;
		linux,phandle = <0x2e>;
		phandle = <0x2e>;
		reg = <0x0 0x14009000 0x0 0x1000>;
	};

	memory {
		device_type = "memory";
		reg = <0x0 0x40000000 0x0 0x20000000>;
	};

	memory-ssmr-features {
		2d_fr-size = <0x0 0x8000000>;
		compatible = "mediatek,memory-ssmr-features";
		iris-recognition-size = <0x0 0x10000000>;
		linux,phandle = <0xbe>;
		phandle = <0xbe>;
		prot-sharedmem-size = <0x0 0x8000000>;
		sdsp-firmware-size = <0x0 0x1000000>;
		sdsp-tee-sharedmem-size = <0x0 0x1000000>;
		svp-size = <0x0 0x10000000>;
		ta-elf-size = <0x0 0x1000000>;
		ta-stack-heap-size = <0x0 0x6000000>;
		tui-size = <0x0 0x4000000>;
		wfd-size = <0x0 0x4000000>;
	};

	mfg_cfg@13ffe000 {
		#clock-cells = <0x1>;
		compatible = "mediatek,mfgcfg", "syscon";
		linux,phandle = <0xad>;
		phandle = <0xad>;
		reg = <0x0 0x13ffe000 0x0 0x1000>;
	};

	mfg_doma@13000000 {
		clock-frequency = <0x21f98280>;
		compatible = "mediatek,doma";
		interrupt-names = "RGX";
		interrupts = <0x0 0x103 0x8>;
		reg = <0x0 0x13000000 0x0 0x80000>;
	};

	mipi_rx_ana_csi0a@11c10000 {
		#clock-cells = <0x1>;
		compatible = "mediatek,mipi_rx_ana_csi0a", "syscon";
		linux,phandle = <0x4e>;
		phandle = <0x4e>;
		reg = <0x0 0x11c10000 0x0 0x1000>;
	};

	mipi_rx_ana_csi0b@11c11000 {
		#clock-cells = <0x1>;
		compatible = "mediatek,mipi_rx_ana_csi0b", "syscon";
		linux,phandle = <0x4f>;
		phandle = <0x4f>;
		reg = <0x0 0x11c11000 0x0 0x1000>;
	};

	mipi_rx_ana_csi1a@11c12000 {
		#clock-cells = <0x1>;
		compatible = "mediatek,mipi_rx_ana_csi1a", "syscon";
		linux,phandle = <0x50>;
		phandle = <0x50>;
		reg = <0x0 0x11c12000 0x0 0x1000>;
	};

	mipi_rx_ana_csi1b@11c13000 {
		#clock-cells = <0x1>;
		compatible = "mediatek,mipi_rx_ana_csi1b", "syscon";
		linux,phandle = <0x51>;
		phandle = <0x51>;
		reg = <0x0 0x11c13000 0x0 0x1000>;
	};

	mipi_rx_ana_csi2a@11c14000 {
		#clock-cells = <0x1>;
		compatible = "mediatek,mipi_rx_ana_csi2a", "syscon";
		linux,phandle = <0x52>;
		phandle = <0x52>;
		reg = <0x0 0x11c14000 0x0 0x1000>;
	};

	mipi_rx_ana_csi2b@11c15000 {
		#clock-cells = <0x1>;
		compatible = "mediatek,mipi_rx_ana_csi2b", "syscon";
		linux,phandle = <0x53>;
		phandle = <0x53>;
		reg = <0x0 0x11c15000 0x0 0x1000>;
	};

	mipi_tx0@11c80000 {
		compatible = "mediatek,mipi_tx0";
		reg = <0x0 0x11c80000 0x0 0x10000>;
	};

	mmdvfs_pmqos {
		cam_freq = "mm_step0", "mm_step1", "mm_step2";
		clock-names = "mmdvfs_clk_mm_sel_ck", "mmdvfs_clk_mmpll_ck", "mmdvfs_clk_univpll1_d2_ck", "mmdvfs_clk_mmpll_d2_ck";
		clocks = <0x1e 0x62 0x1e 0x21 0x1e 0x17 0x1e 0x22>;
		compatible = "mediatek,mmdvfs_pmqos";
		disp_freq = "mm_step0", "mm_step1", "mm_step2";
		img_freq = "mm_step0", "mm_step1", "mm_step2";
		mdp_freq = "mm_step0", "mm_step1", "mm_step2";
		mm_step0 = <0x1c9 0x1 0x0 0x1>;
		mm_step1 = <0x138 0x1 0x0 0x2>;
		mm_step2 = <0xe4 0x1 0x0 0x3>;
		vdec_freq = "mm_step0", "mm_step1", "mm_step2";
		venc_freq = "mm_step0", "mm_step1", "mm_step2";
		vopp_steps = <0x0 0x1 0x3>;
	};

	mmsys_config@14000000 {
		#clock-cells = <0x1>;
		clock-names = "CAM_MDP", "IMG_DL_RELAY", "IMG_DL_ASYNC_TOP";
		clocks = <0x29 0x17 0x29 0x1a 0x29 0x1b>;
		compatible = "mediatek,mmsys_config", "syscon";
		interrupts = <0x0 0xe3 0x8>;
		linux,phandle = <0x29>;
		phandle = <0x29>;
		reg = <0x0 0x14000000 0x0 0x1000>;
	};

	mobicore {
		compatible = "trustonic,mobicore";
		interrupts = <0x0 0x10f 0x1>;
	};

	modem_temp_share@10018000 {
		compatible = "mediatek,modem_temp_share";
		reg = <0x0 0x10018000 0x0 0x1000>;
	};

	mrdump_ext_rst {
		compatible = "mediatek, mrdump_ext_rst-eint";
		force_mode = "EINT";
		linux,phandle = <0x87>;
		mode = "IRQ";
		phandle = <0x87>;
		status = "okay";
	};

	msdc0_pad_macro@11cd0000 {
		compatible = "mediatek,msdc0_pad_macro";
		reg = <0x0 0x11cd0000 0x0 0x10000>;
	};

	msdc0_top@11cd0000 {
		compatible = "mediatek,msdc0_top";
		reg = <0x0 0x11cd0000 0x0 0x1000>;
	};

	msdc1_ins@0 {
		compatible = "mediatek,mt6765-sdcard-ins";
		linux,phandle = <0xab>;
		phandle = <0xab>;
	};

	msdc1_pad_macro@11c90000 {
		compatible = "mediatek,msdc1_pad_macro";
		reg = <0x0 0x11c90000 0x0 0x10000>;
	};

	msdc1_top@11c90000 {
		compatible = "mediatek,msdc1_top";
		reg = <0x0 0x11c90000 0x0 0x1000>;
	};

	msdc@11230000 {
		bootable;
		bus-width = <0x8>;
		cap-mmc-highspeed;
		clk_src = [01];
		clock-names = "msdc0-clock", "msdc0-hclock", "msdc0-aes-clock";
		clocks = <0x27 0x4c 0x27 0x1c 0x27 0x44>;
		compatible = "mediatek,msdc";
		host_function = [00];
		index = [00];
		interrupts = <0x0 0x4f 0x8>;
		linux,phandle = <0xa7>;
		max-frequency = <0xbebc200>;
		mmc-ddr-1_8v;
		mmc-hs200-1_8v;
		mmc-hs400-1_8v;
		no-sd;
		no-sdio;
		non-removable;
		phandle = <0xa7>;
		pinctl = <0x36>;
		pinctl_hs200 = <0x38>;
		pinctl_hs400 = <0x37>;
		reg = <0x0 0x11230000 0x0 0x10000>;
		register_setting = <0x39>;
		status = "okay";
		vmmc-supply = <0x3a>;
	};

	msdc@11240000 {
		bus-width = <0x4>;
		cap-sd-highspeed;
		cd-gpios = <0x20 0x1 0x0>;
		cd_level = [01];
		clk_src = [02];
		clock-names = "msdc1-clock", "msdc1-hclock";
		clocks = <0x27 0x4d 0x27 0x1d>;
		compatible = "mediatek,msdc";
		host_function = [01];
		index = [01];
		interrupts = <0x0 0x50 0x8>;
		linux,phandle = <0xa8>;
		max-frequency = <0xbebc200>;
		no-mmc;
		no-sdio;
		phandle = <0xa8>;
		pinctl = <0x3b>;
		pinctl_ddr50 = <0x3e>;
		pinctl_sdr104 = <0x3c>;
		pinctl_sdr50 = <0x3d>;
		reg = <0x0 0x11240000 0x0 0x10000>;
		register_setting = <0x3f>;
		sd-uhs-ddr50;
		sd-uhs-sdr104;
		sd-uhs-sdr12;
		sd-uhs-sdr25;
		sd-uhs-sdr50;
		status = "okay";
		vmmc-supply = <0x40>;
		vqmmc-supply = <0x41>;
	};

	msdc@11250000 {
		compatible = "mediatek,msdc2";
		linux,phandle = <0xa9>;
		phandle = <0xa9>;
		reg = <0x0 0x11250000 0x0 0x10000>;
		status = "disable";
	};

	msdc@11260000 {
		compatible = "mediatek,msdc3";
		linux,phandle = <0xaa>;
		phandle = <0xaa>;
		reg = <0x0 0x11250000 0x0 0x10000>;
		status = "disable";
	};

	mt-pmic {
		compatible = "mediatek,mt_pmic";
		interrupt-controller;
		linux,phandle = <0x68>;
		phandle = <0x68>;

		buck_regulators {

			buck_vcore {
				linux,phandle = <0x6b>;
				phandle = <0x6b>;
				regulator-enable-ramp-delay = <0xdc>;
				regulator-max-microvolt = <0x1406f4>;
				regulator-min-microvolt = <0x7ea5e>;
				regulator-name = "vcore";
				regulator-ramp-delay = <0x186a>;
			};

			buck_vmodem {
				linux,phandle = <0x6a>;
				phandle = <0x6a>;
				regulator-enable-ramp-delay = <0xdc>;
				regulator-max-microvolt = <0x123716>;
				regulator-min-microvolt = <0x7a120>;
				regulator-name = "vmodem";
				regulator-ramp-delay = <0x186a>;
			};

			buck_vpa {
				linux,phandle = <0x6d>;
				phandle = <0x6d>;
				regulator-enable-ramp-delay = <0xdc>;
				regulator-max-microvolt = <0x37b1d0>;
				regulator-min-microvolt = <0x7a120>;
				regulator-name = "vpa";
				regulator-ramp-delay = <0xc350>;
			};

			buck_vproc {
				linux,phandle = <0x6c>;
				phandle = <0x6c>;
				regulator-enable-ramp-delay = <0xdc>;
				regulator-max-microvolt = <0x1406f4>;
				regulator-min-microvolt = <0x7ea5e>;
				regulator-name = "vproc";
				regulator-ramp-delay = <0x186a>;
			};

			buck_vs1 {
				linux,phandle = <0x69>;
				phandle = <0x69>;
				regulator-enable-ramp-delay = <0xdc>;
				regulator-max-microvolt = <0x2191c0>;
				regulator-min-microvolt = <0x124f80>;
				regulator-name = "vs1";
				regulator-ramp-delay = <0x30d4>;
			};
		};

		ldo_regulators {

			ldo_vaud28 {
				compatible = "regulator-fixed";
				linux,phandle = <0x7e>;
				phandle = <0x7e>;
				regulator-enable-ramp-delay = <0x108>;
				regulator-max-microvolt = <0x2ab980>;
				regulator-min-microvolt = <0x2ab980>;
				regulator-name = "vaud28";
			};

			ldo_vaux18 {
				compatible = "regulator-fixed";
				linux,phandle = <0x7d>;
				phandle = <0x7d>;
				regulator-enable-ramp-delay = <0x108>;
				regulator-max-microvolt = <0x1b7740>;
				regulator-min-microvolt = <0x1b7740>;
				regulator-name = "vaux18";
			};

			ldo_vcama {
				linux,phandle = <0x77>;
				phandle = <0x77>;
				regulator-enable-ramp-delay = <0x108>;
				regulator-max-microvolt = <0x2ab980>;
				regulator-min-microvolt = <0x2625a0>;
				regulator-name = "vcama";
			};

			ldo_vcamd {
				linux,phandle = <0x78>;
				phandle = <0x78>;
				regulator-enable-ramp-delay = <0x108>;
				regulator-max-microvolt = <0x1b7740>;
				regulator-min-microvolt = <0xf4240>;
				regulator-name = "vcamd";
			};

			ldo_vcamio {
				compatible = "regulator-fixed";
				linux,phandle = <0x79>;
				phandle = <0x79>;
				regulator-enable-ramp-delay = <0x108>;
				regulator-max-microvolt = <0x1b7740>;
				regulator-min-microvolt = <0x1b7740>;
				regulator-name = "vcamio";
			};

			ldo_vcn18 {
				compatible = "regulator-fixed";
				linux,phandle = <0x76>;
				phandle = <0x76>;
				regulator-enable-ramp-delay = <0x108>;
				regulator-max-microvolt = <0x1b7740>;
				regulator-min-microvolt = <0x1b7740>;
				regulator-name = "vcn18";
			};

			ldo_vcn28 {
				compatible = "regulator-fixed";
				linux,phandle = <0x75>;
				phandle = <0x75>;
				regulator-enable-ramp-delay = <0x108>;
				regulator-max-microvolt = <0x2ab980>;
				regulator-min-microvolt = <0x2ab980>;
				regulator-name = "vcn28";
			};

			ldo_vcn33_bt {
				linux,phandle = <0x73>;
				phandle = <0x73>;
				regulator-enable-ramp-delay = <0x108>;
				regulator-max-microvolt = <0x3567e0>;
				regulator-min-microvolt = <0x325aa0>;
				regulator-name = "vcn33_bt";
			};

			ldo_vcn33_wifi {
				linux,phandle = <0x74>;
				phandle = <0x74>;
				regulator-enable-ramp-delay = <0x108>;
				regulator-max-microvolt = <0x3567e0>;
				regulator-min-microvolt = <0x325aa0>;
				regulator-name = "vcn33_wifi";
			};

			ldo_vdram {
				linux,phandle = <0x81>;
				phandle = <0x81>;
				regulator-enable-ramp-delay = <0xce4>;
				regulator-max-microvolt = <0x124f80>;
				regulator-min-microvolt = <0x10c8e0>;
				regulator-name = "vdram";
			};

			ldo_vefuse {
				linux,phandle = <0x72>;
				phandle = <0x72>;
				regulator-enable-ramp-delay = <0x108>;
				regulator-max-microvolt = <0x325aa0>;
				regulator-min-microvolt = <0x124f80>;
				regulator-name = "vefuse";
			};

			ldo_vemc {
				linux,phandle = <0x3a>;
				phandle = <0x3a>;
				regulator-enable-ramp-delay = <0x2c>;
				regulator-max-microvolt = <0x325aa0>;
				regulator-min-microvolt = <0x2c4020>;
				regulator-name = "vemc";
			};

			ldo_vfe28 {
				compatible = "regulator-fixed";
				linux,phandle = <0x6e>;
				phandle = <0x6e>;
				regulator-enable-ramp-delay = <0x108>;
				regulator-max-microvolt = <0x2ab980>;
				regulator-min-microvolt = <0x2ab980>;
				regulator-name = "vfe28";
			};

			ldo_vibr {
				linux,phandle = <0x84>;
				phandle = <0x84>;
				regulator-enable-ramp-delay = <0x2c>;
				regulator-max-microvolt = <0x325aa0>;
				regulator-min-microvolt = <0x124f80>;
				regulator-name = "vibr";
			};

			ldo_vio18 {
				compatible = "regulator-fixed";
				linux,phandle = <0x80>;
				phandle = <0x80>;
				regulator-enable-ramp-delay = <0x108>;
				regulator-max-microvolt = <0x1b7740>;
				regulator-min-microvolt = <0x1b7740>;
				regulator-name = "vio18";
			};

			ldo_vio28 {
				compatible = "regulator-fixed";
				linux,phandle = <0x7f>;
				phandle = <0x7f>;
				regulator-enable-ramp-delay = <0x108>;
				regulator-max-microvolt = <0x2ab980>;
				regulator-min-microvolt = <0x2ab980>;
				regulator-name = "vio28";
			};

			ldo_vldo28 {
				linux,phandle = <0x7a>;
				phandle = <0x7a>;
				regulator-enable-ramp-delay = <0x108>;
				regulator-max-microvolt = <0x2dc6c0>;
				regulator-min-microvolt = <0x2ab980>;
				regulator-name = "vldo28";
			};

			ldo_vmc {
				linux,phandle = <0x41>;
				phandle = <0x41>;
				regulator-enable-ramp-delay = <0x2c>;
				regulator-max-microvolt = <0x325aa0>;
				regulator-min-microvolt = <0x1b7740>;
				regulator-name = "vmc";
			};

			ldo_vmch {
				linux,phandle = <0x40>;
				phandle = <0x40>;
				regulator-enable-ramp-delay = <0x2c>;
				regulator-max-microvolt = <0x325aa0>;
				regulator-min-microvolt = <0x2c4020>;
				regulator-name = "vmch";
			};

			ldo_vrf12 {
				compatible = "regulator-fixed";
				linux,phandle = <0x71>;
				phandle = <0x71>;
				regulator-enable-ramp-delay = <0x6e>;
				regulator-max-microvolt = <0x124f80>;
				regulator-min-microvolt = <0x124f80>;
				regulator-name = "vrf12";
			};

			ldo_vrf18 {
				compatible = "regulator-fixed";
				linux,phandle = <0x70>;
				phandle = <0x70>;
				regulator-enable-ramp-delay = <0x6e>;
				regulator-max-microvolt = <0x1b7740>;
				regulator-min-microvolt = <0x1b7740>;
				regulator-name = "vrf18";
			};

			ldo_vsim1 {
				linux,phandle = <0x82>;
				phandle = <0x82>;
				regulator-enable-ramp-delay = <0x108>;
				regulator-max-microvolt = <0x2f4d60>;
				regulator-min-microvolt = <0x19f0a0>;
				regulator-name = "vsim1";
			};

			ldo_vsim2 {
				linux,phandle = <0x83>;
				phandle = <0x83>;
				regulator-enable-ramp-delay = <0x108>;
				regulator-max-microvolt = <0x2f4d60>;
				regulator-min-microvolt = <0x19f0a0>;
				regulator-name = "vsim2";
			};

			ldo_vsram_others {
				linux,phandle = <0x7b>;
				phandle = <0x7b>;
				regulator-enable-ramp-delay = <0x6e>;
				regulator-max-microvolt = <0x1406f4>;
				regulator-min-microvolt = <0x7ea5e>;
				regulator-name = "vsram_others";
				regulator-ramp-delay = <0x186a>;
			};

			ldo_vsram_proc {
				linux,phandle = <0x7c>;
				phandle = <0x7c>;
				regulator-enable-ramp-delay = <0x6e>;
				regulator-max-microvolt = <0x1406f4>;
				regulator-min-microvolt = <0x7ea5e>;
				regulator-name = "vsram_proc";
				regulator-ramp-delay = <0x186a>;
			};

			ldo_vusb33 {
				linux,phandle = <0x85>;
				phandle = <0x85>;
				regulator-enable-ramp-delay = <0x108>;
				regulator-max-microvolt = <0x2f4d60>;
				regulator-min-microvolt = <0x2dc6c0>;
				regulator-name = "vusb33";
			};

			ldo_vxo22 {
				linux,phandle = <0x6f>;
				phandle = <0x6f>;
				regulator-enable-ramp-delay = <0x6e>;
				regulator-max-microvolt = <0x249f00>;
				regulator-min-microvolt = <0x2191c0>;
				regulator-name = "vxo22";
			};
		};

		mt635x-auxadc {
			#io-channel-cells = <0x1>;
			compatible = "mediatek,mt635x-auxadc";
			linux,phandle = <0x35>;
			phandle = <0x35>;

			accdet {
				channel = <0x9>;
			};

			bat_temp {
				channel = <0x3>;
				resistance-ratio = <0x1 0x1>;
			};

			batadc {
				avg-num = <0x80>;
				channel = <0x0>;
				resistance-ratio = <0x3 0x1>;
			};

			chip_temp {
				channel = <0x5>;
			};

			dcxo_temp {
				avg-num = <0x10>;
				channel = <0xd>;
			};

			hpofs_cal {
				avg-num = <0x100>;
				channel = <0xc>;
			};

			isense {
				avg-num = <0x80>;
				channel = <0x1>;
				resistance-ratio = <0x3 0x1>;
			};

			tsx_temp {
				avg-num = <0x80>;
				channel = <0xb>;
			};

			vbif {
				channel = <0xe>;
				resistance-ratio = <0x1 0x1>;
			};

			vcdt {
				channel = <0x2>;
			};

			vcore_temp {
				channel = <0x6>;
			};

			vproc_temp {
				channel = <0x7>;
			};
		};
	};

	mt6357_gauge {
		alias_name = "mt6357";
		compatible = "mediatek,mt6357_gauge";
		gauge_name = "gauge";
	};

	mt6370_pd_eint {
		linux,phandle = <0xbb>;
		phandle = <0xbb>;
	};

	mt6370_pmu_dts {
		#interrupt-cells = <0x1>;
		interrupt-controller;
		linux,phandle = <0xcc>;
		mt6370,intr_gpio = <0x20 0x3 0x0>;
		mt6370,intr_gpio_num = <0x3>;
		phandle = <0xcc>;

		bled {
			compatible = "mediatek,mt6370_pmu_bled";
			interrupt-names = "bled_ocp";
			mt,bl_ocp_level = <0x2>;
			mt,bl_ovp_level = <0x3>;
			mt,bled_flash_ramp = <0x1>;
			mt,bled_name = "mt6370_pmu_bled";
			mt,bled_ramptime = <0x3>;
			mt,chan_en = <0xf>;
			mt,map_linear;
			mt,max_bled_brightness = <0x200>;
			mt,pwm_avg_cycle = <0x0>;
			mt,pwm_deglitch = <0x1>;
			mt,pwm_fsample = <0x2>;
			mt,pwm_hys = <0x0>;
			mt,pwm_hys_en = <0x1>;
			mt,use_pwm;
		};

		charger {
			aicr = <0x7a120>;
			charger_name = "primary_chg";
			compatible = "mediatek,mt6370_pmu_charger";
			cv = <0x426030>;
			dc_wdt = <0x3d0900>;
			enable_te;
			enable_wdt;
			ichg = <0x1e8480>;
			ieoc = <0x249f0>;
			interrupt-names = "chg_mivr", "chg_aiclmeasi", "attachi", "ovpctrl_uvp_d_evt", "chg_wdtmri", "chg_vbusov", "chg_tmri", "chg_treg";
			ircmp_resistor = <0x61a8>;
			ircmp_vclamp = <0x7d00>;
			load_switch_name = "primary_load_switch";
			mivr = <0x432380>;
			safety_timer = <0xc>;
		};

		core {
			compatible = "mediatek,mt6370_pmu_core";
			i2cstmr_rst_tmr = <0x0>;
			int_deg = <0x0>;
			int_wdt = <0x0>;
			interrupt-names = "otp", "vdda_ovp", "vdda_uv";
			mrstb_en;
			mrstb_tmr = <0x3>;
		};

		dsv {
			compatible = "mediatek,mt6370_pmu_dsv";
			db_delay = <0x3>;
			db_ext_en = <0x0>;
			db_freq_pm = <0x0>;
			db_periodic_fix = <0x0>;
			db_periodic_mode = <0x0>;
			db_single_pin = <0x0>;
			db_startup = <0x0>;
			db_vbst = <0x1644>;
			db_vneg_20ms = <0x1>;
			db_vneg_disc = <0x0>;
			db_vneg_slew = <0x1>;
			db_vpos_20ms = <0x1>;
			db_vpos_disc = <0x1>;
			db_vpos_slew = <0x1>;
			interrupt-names = "dsv_vneg_ocp", "dsv_vpos_ocp", "dsv_bst_ocp", "dsv_vneg_scp", "dsv_vpos_scp";

			mt6370_dsvn {
				regulator-max-microvolt = <0x5b8d80>;
				regulator-min-microvolt = <0x3d0900>;
				regulator-name = "dsv_neg";
			};

			mt6370_dsvp {
				regulator-max-microvolt = <0x5b8d80>;
				regulator-min-microvolt = <0x3d0900>;
				regulator-name = "dsv_pos";
			};
		};

		ldo {
			compatible = "mediatek,mt6370_pmu_ldo";
			interrupt-names = "ldo_oc";
			ldo_oms = <0x1>;
			ldo_vrc_lt = <0x1>;

			mt6370_ldo {
				regulator-max-microvolt = <0x3d0900>;
				regulator-min-microvolt = <0x186a00>;
				regulator-name = "irtx_ldo";
			};
		};

		mt6370_pmu_fled1 {
			compatible = "mediatek,mt6370_pmu_fled1";
			fled_enable = <0x1>;
			interrupt-names = "fled_lvf", "fled2_short", "fled1_short";
			strobe_cur = <0x124f80>;
			strobe_timeout = <0x960>;
			torch_cur = <0x493e0>;
		};

		mt6370_pmu_fled2 {
			compatible = "mediatek,mt6370_pmu_fled2";
			fled_enable = <0x1>;
			strobe_cur = <0xf4240>;
			strobe_timeout = <0x4b0>;
			torch_cur = <0x30d40>;
		};

		rgbled {
			compatible = "mediatek,mt6370_pmu_rgbled";
			interrupt-names = "isink4_short", "isink3_short", "isink2_short", "isink1_short", "isink4_open", "isink3_open", "isink2_open", "isink1_open";
			mt,led_default_trigger = "cc_mode", "cc_mode", "cc_mode", "none";
			mt,led_name = "mt6370_pmu_led1", "mt6370_pmu_led2", "mt6370_pmu_led3", "mt6370_pmu_led4";
		};
	};

	mt6370_pmu_eint {
		linux,phandle = <0xba>;
		phandle = <0xba>;
	};

	mt_charger {
		compatible = "mediatek,mt-charger";
		linux,phandle = <0xb6>;
		phandle = <0xb6>;
	};

	mt_soc_anc_pcm {
		compatible = "mediatek,mt_soc_pcm_anc";
	};

	mt_soc_codec_dummy_name {
		compatible = "mediatek,mt_soc_codec_dummy";
	};

	mt_soc_codec_name {
		accdec_hp_impedance_get = <0x0>;
		compatible = "mediatek,mt_soc_codec_63xx";
		use_hp_depop_flow = <0x0>;
		use_ul_260k = <0x0>;
	};

	mt_soc_dai_name {
		compatible = "mediatek,mt_soc_dai_stub";
	};

	mt_soc_deep_buffer_dl_pcm {
		compatible = "mediatek,mt_soc_pcm_deep_buffer_dl";
	};

	mt_soc_dl1_awb_pcm {
		compatible = "mediatek,mt_soc_pcm_dl1_awb";
	};

	mt_soc_dl1_pcm@11220000 {
		clock-names = "aud_afe_clk", "aud_dac_clk", "aud_dac_predis_clk", "aud_adc_clk", "aud_apll22m_clk", "aud_apll1_tuner_clk", "aud_tml_clk", "aud_infra_clk", "mtkaif_26m_clk", "top_mux_audio", "top_mux_audio_int", "top_sys_pll1_d4", "top_mux_aud_1", "top_apll1_ck", "top_mux_aud_eng1", "top_apll1_d8", "apmixed_apll1", "top_clk26m_clk";
		clocks = <0x43 0x0 0x43 0x4 0x43 0x5 0x43 0x3 0x43 0x1 0x43 0x2 0x43 0x6 0x27 0x2b 0x27 0x33 0x1e 0x6f 0x1e 0x70 0x1e 0x3 0x1e 0x71 0x1e 0x29 0x1e 0x72 0x1e 0x2c 0x44 0x8 0x1f>;
		compatible = "mediatek,mt_soc_pcm_dl1";
		interrupts = <0x0 0x99 0x8>;
		linux,phandle = <0xac>;
		phandle = <0xac>;
		reg = <0x0 0x11220000 0x0 0x1000>;
	};

	mt_soc_dl2_pcm {
		compatible = "mediatek,mt_soc_pcm_dl2";
	};

	mt_soc_dummy_pcm {
		compatible = "mediatek,mt_soc_pcm_dummy";
	};

	mt_soc_fm_i2s_awb_pcm {
		compatible = "mediatek,mt_soc_pcm_fm_i2s_awb";
	};

	mt_soc_fm_i2s_pcm {
		compatible = "mediatek,mt_soc_pcm_fm_i2s";
	};

	mt_soc_fm_mrgtx_pcm {
		compatible = "mediatek,mt_soc_pcm_fmtx";
	};

	mt_soc_hp_impedance_pcm {
		compatible = "mediatek,mt_soc_pcm_hp_impedance";
	};

	mt_soc_i2s0_awb_pcm {
		compatible = "mediatek,mt_soc_pcm_i2s0_awb";
	};

	mt_soc_i2s0_pcm {
		compatible = "mediatek,mt_soc_pcm_dl1_i2s0";
	};

	mt_soc_i2s0dl1_pcm {
		compatible = "mediatek,mt_soc_pcm_dl1_i2s0dl1";
	};

	mt_soc_mrgrx_awb_pcm {
		compatible = "mediatek,mt_soc_pcm_mrgrx_awb";
	};

	mt_soc_mrgrx_pcm {
		compatible = "mediatek,mt_soc_pcm_mrgrx";
	};

	mt_soc_pcm_dl1_scp_spk {
		compatible = "mediatek,mt_soc_pcm_dl1_scp_spk";
	};

	mt_soc_pcm_voice_scp {
		compatible = "mediatek,mt_soc_pcm_voice_scp";
	};

	mt_soc_pcm_voice_ultra {
		compatible = "mediatek,mt_soc_pcm_voice_ultra";
	};

	mt_soc_pcm_voice_usb {
		compatible = "mediatek,mt_soc_pcm_voice_usb";
	};

	mt_soc_pcm_voice_usb_echoref {
		compatible = "mediatek,mt_soc_pcm_voice_usb_echoref";
	};

	mt_soc_routing_dai_name {
		compatible = "mediatek,mt_soc_dai_routing";
	};

	mt_soc_routing_pcm {
		compatible = "mediatek,mt_soc_pcm_routing";
	};

	mt_soc_tdmrx_pcm {
		compatible = "mediatek,mt_soc_tdm_capture";
	};

	mt_soc_ul1_pcm {
		compatible = "mediatek,mt_soc_pcm_capture";
	};

	mt_soc_ul2_pcm {
		compatible = "mediatek,mt_soc_pcm_capture2";
	};

	mt_soc_uldlloopback_pcm {
		compatible = "mediatek,mt_soc_pcm_uldlloopback";
	};

	mt_soc_voice_md1 {
		compatible = "mediatek,mt_soc_pcm_voice_md1";
	};

	mt_soc_voice_md1_bt {
		compatible = "mediatek,mt_soc_pcm_voice_md1_bt";
	};

	mt_soc_voice_md2 {
		compatible = "mediatek,mt_soc_pcm_voice_md2";
	};

	mt_soc_voice_md2_bt {
		compatible = "mediatek,mt_soc_pcm_voice_md2_bt";
	};

	mt_soc_voip_bt_in {
		compatible = "mediatek,mt_soc_pcm_bt_dai";
	};

	mt_soc_voip_bt_out {
		compatible = "mediatek,mt_soc_pcm_dl1_bt";
	};

	mtk-btcvsd-snd@18050000 {
		compatible = "mediatek,mtk-btcvsd-snd";
		interrupts = <0x0 0x10a 0x8>;
		linux,phandle = <0x42>;
		mediatek,infracfg = <0x27>;
		mediatek,offset = <0xf00 0x800 0x140 0x144 0x148>;
		phandle = <0x42>;
		reg = <0x0 0x18050000 0x0 0x1000 0x0 0x18080000 0x0 0x10000>;
	};

	mtkfb@0 {
		compatible = "mediatek,mtkfb";
		linux,phandle = <0xb0>;
		phandle = <0xb0>;
	};

	nfc553 {
		compatible = "mediatek,nfc-gpios";
		gpio-eint = <0x4>;
		gpio-irq = <0x4>;
		gpio-ven = <0x9f>;
		linux,phandle = <0xae>;
		phandle = <0xae>;
		pinctrl-0 = <0x45>;
		pinctrl-1 = <0x46>;
		pinctrl-2 = <0x47>;
		pinctrl-3 = <0x48>;
		pinctrl-4 = <0x49>;
		pinctrl-5 = <0x4a>;
		pinctrl-names = "nfcdefault", "ven_high", "ven_low", "dwn_high", "dwn_low", "eint_as_int";
		status = "okay";
	};

	nfi@11018000 {
		compatible = "mediatek,nfi";
		reg = <0x0 0x11018000 0x0 0x1000>;
	};

	nfiecc@11019000 {
		compatible = "mediatek,nfiecc";
		reg = <0x0 0x11019000 0x0 0x1000>;
	};

	odm {
		compatible = "simple-bus";
		linux,phandle = <0xbd>;
		phandle = <0xbd>;
	};

	oppo_fp_common {
		compatible = "oppo,fp_common";
		linux,phandle = <0x8f>;
		phandle = <0x8f>;
		status = "okay";
	};

	oppo_secure_common {
		compatible = "oppo,secure_common";
		linux,phandle = <0x90>;
		phandle = <0x90>;
	};

	otg_iddig {
		compatible = "mediatek,usb_iddig_bi_eint";
		linux,phandle = <0x86>;
		phandle = <0x86>;
		pinctrl-0 = <0x21>;
		pinctrl-1 = <0x22>;
		pinctrl-names = "iddig_init", "iddig_low";
		usbid-gpio = <0x20 0x29 0x0>;
	};

	pericfg@10003000 {
		#clock-cells = <0x1>;
		compatible = "mediatek,pericfg", "syscon";
		linux,phandle = <0x63>;
		phandle = <0x63>;
		reg = <0x0 0x10003000 0x0 0x1000>;
	};

	pinctrl@1000b000 {
		#gpio-cells = <0x2>;
		#interrupt-cells = <0x4>;
		compatible = "mediatek,mt6765-pinctrl";
		gpio-controller;
		interrupt-controller;
		interrupts = <0x0 0xab 0x4>;
		linux,phandle = <0x20>;
		mediatek,pctl-regmap = <0x12 0x13 0x14 0x15 0x16 0x17 0x18 0x19>;
		phandle = <0x20>;
		pins-are-numbered;
		reg = <0x0 0x1000b000 0x0 0x1000>;

		default {
			linux,phandle = <0x5b>;
			phandle = <0x5b>;
		};

		flashlight_pins_default {
			linux,phandle = <0x54>;
			phandle = <0x54>;

			pins_cmd_dat0 {
				output-low;
				pinmux = <0x600>;
				slew-rate = <0x1>;
			};

			pins_cmd_dat1 {
				output-low;
				pinmux = <0x9d00>;
				slew-rate = <0x1>;
			};
		};

		flashlight_pins_srobe_off {
			linux,phandle = <0x56>;
			phandle = <0x56>;

			pins_cmd_dat {
				output-low;
				pinmux = <0x9d00>;
				slew-rate = <0x1>;
			};
		};

		flashlight_pins_srobe_on {
			linux,phandle = <0x55>;
			phandle = <0x55>;

			pins_cmd_dat {
				output-high;
				pinmux = <0x9d00>;
				slew-rate = <0x1>;
			};
		};

		flashlight_pins_torch_off {
			linux,phandle = <0x58>;
			phandle = <0x58>;

			pins_cmd_dat {
				output-low;
				pinmux = <0x600>;
				slew-rate = <0x1>;
			};
		};

		flashlight_pins_torch_on {
			linux,phandle = <0x57>;
			phandle = <0x57>;

			pins_cmd_dat {
				output-high;
				pinmux = <0x600>;
				slew-rate = <0x1>;
			};
		};

		flashlight_pins_torch_pwm {
			linux,phandle = <0x59>;
			phandle = <0x59>;

			pins_cmd_dat {
				output-low;
				pinmux = <0x603>;
				slew-rate = <0x1>;
			};
		};

		iddig_high {
			linux,phandle = <0x21>;
			phandle = <0x21>;

			pins_cmd_dat {
				bias-pull-up;
				pinmux = <0x2900>;
				slew-rate = <0x0>;
			};
		};

		iddig_low {
			linux,phandle = <0x22>;
			phandle = <0x22>;

			pins_cmd_dat {
				output-low;
				pinmux = <0x2900>;
				slew-rate = <0x1>;
			};
		};

		lcd_bias_gpio_enn0 {
			linux,phandle = <0x5e>;
			phandle = <0x5e>;

			pins_cmd_dat {
				output-low;
				pinmux = <0xa500>;
				slew-rate = <0x1>;
			};
		};

		lcd_bias_gpio_enn1 {
			linux,phandle = <0x5f>;
			phandle = <0x5f>;

			pins_cmd_dat {
				output-high;
				pinmux = <0xa500>;
				slew-rate = <0x1>;
			};
		};

		lcd_bias_gpio_enp0 {
			linux,phandle = <0x5c>;
			phandle = <0x5c>;

			pins_cmd_dat {
				output-low;
				pinmux = <0xa600>;
				slew-rate = <0x1>;
			};
		};

		lcd_bias_gpio_enp1 {
			linux,phandle = <0x5d>;
			phandle = <0x5d>;

			pins_cmd_dat {
				output-high;
				pinmux = <0xa600>;
				slew-rate = <0x1>;
			};
		};

		msdc0@default {
			linux,phandle = <0x36>;
			phandle = <0x36>;

			pins_clk {
				drive-strength = [03];
			};

			pins_cmd {
				drive-strength = [03];
			};

			pins_dat {
				drive-strength = [03];
			};

			pins_ds {
				drive-strength = [03];
			};

			pins_rst {
				drive-strength = [03];
			};
		};

		msdc0@hs200 {
			linux,phandle = <0x38>;
			phandle = <0x38>;

			pins_clk {
				drive-strength = [04];
			};

			pins_cmd {
				drive-strength = [03];
			};

			pins_dat {
				drive-strength = [04];
			};

			pins_ds {
				drive-strength = [04];
			};

			pins_rst {
				drive-strength = [03];
			};
		};

		msdc0@hs400 {
			linux,phandle = <0x37>;
			phandle = <0x37>;

			pins_clk {
				drive-strength = [04];
			};

			pins_cmd {
				drive-strength = [03];
			};

			pins_dat {
				drive-strength = [04];
			};

			pins_ds {
				drive-strength = [04];
			};

			pins_rst {
				drive-strength = [03];
			};
		};

		msdc0@register_default {
			cmd_edge = [00];
			linux,phandle = <0x39>;
			phandle = <0x39>;
			rdata_edge = [00];
			wdata_edge = [00];
		};

		msdc1@ddr50 {
			linux,phandle = <0x3e>;
			phandle = <0x3e>;

			pins_clk {
				drive-strength = [03];
			};

			pins_cmd {
				drive-strength = [03];
			};

			pins_dat {
				drive-strength = [03];
			};
		};

		msdc1@default {
			linux,phandle = <0x3b>;
			phandle = <0x3b>;

			pins_clk {
				drive-strength = [03];
			};

			pins_cmd {
				drive-strength = [03];
			};

			pins_dat {
				drive-strength = [03];
			};
		};

		msdc1@register_default {
			cmd_edge = [00];
			linux,phandle = <0x3f>;
			phandle = <0x3f>;
			rdata_edge = [00];
			wdata_edge = [00];
		};

		msdc1@sdr104 {
			linux,phandle = <0x3c>;
			phandle = <0x3c>;

			pins_clk {
				drive-strength = [03];
			};

			pins_cmd {
				drive-strength = [03];
			};

			pins_dat {
				drive-strength = [03];
			};
		};

		msdc1@sdr50 {
			linux,phandle = <0x3d>;
			phandle = <0x3d>;

			pins_clk {
				drive-strength = [03];
			};

			pins_cmd {
				drive-strength = [03];
			};

			pins_dat {
				drive-strength = [03];
			};
		};

		msdc3@default {
			linux,phandle = <0x66>;
			phandle = <0x66>;

			pins_clk {
				drive-strength = [04];
			};

			pins_cmd {
				drive-strength = [04];
			};

			pins_dat {
				drive-strength = [04];
			};
		};

		msdc3@register_default {
			cmd_edge = [01];
			linux,phandle = <0x67>;
			phandle = <0x67>;
			rdata_edge = [01];
			wdata_edge = [01];
		};

		nfc_default {
			linux,phandle = <0x45>;
			phandle = <0x45>;
		};

		nfc_dwn_high {
			linux,phandle = <0x48>;
			phandle = <0x48>;

			pins_cmd_dat {
				output-high;
				pinmux = <0x800>;
				slew-rate = <0x1>;
			};
		};

		nfc_dwn_low {
			linux,phandle = <0x49>;
			phandle = <0x49>;

			pins_cmd_dat {
				output-low;
				pinmux = <0x800>;
				slew-rate = <0x1>;
			};
		};

		nfc_eint_as_int {
			linux,phandle = <0x4a>;
			phandle = <0x4a>;

			pins_cmd_dat {
				bias-disable;
				pinmux = <0x400>;
				slew-rate = <0x0>;
			};
		};

		nfc_ven_high {
			linux,phandle = <0x46>;
			phandle = <0x46>;

			pins_cmd_dat {
				output-high;
				pinmux = <0x9f00>;
				slew-rate = <0x1>;
			};
		};

		nfc_ven_low {
			linux,phandle = <0x47>;
			phandle = <0x47>;

			pins_cmd_dat {
				output-low;
				pinmux = <0x9f00>;
				slew-rate = <0x1>;
			};
		};
	};

	plat_sram_flag@0011db00 {
		compatible = "mediatek,plat_sram_flag";
		reg = <0x0 0x10e5f0 0x0 0x10>;
	};

	pmic_clock_buffer_ctrl {
		compatible = "mediatek,pmic_clock_buffer";
		linux,phandle = <0xbf>;
		mediatek,clkbuf-config = <0x2 0x1 0x1 0x2 0x0 0x0 0x0>;
		mediatek,clkbuf-driving-current = <0x1 0x1 0x1 0x1 0x1 0x1 0x1>;
		mediatek,clkbuf-quantity = <0x7>;
		phandle = <0xbf>;
	};

	pmu {
		compatible = "arm,armv8-pmuv3";
		interrupt-parent = <0x11>;
		interrupts = <0x1 0x7 0x8>;
	};

	psci {
		compatible = "arm,psci-1.0";
		method = "smc";
	};

	pseudo_m4u {
		compatible = "mediatek,mt-pseudo_m4u";
		iommus = <0x5a 0x2>;
	};

	pseudo_m4u-larb0 {
		compatible = "mediatek,mt-pseudo_m4u-port";
		iommus = <0x5a 0x0 0x5a 0x1 0x5a 0x2 0x5a 0x3 0x5a 0x4 0x5a 0x5 0x5a 0x6 0x5a 0x7>;
		mediatek,larbid = <0x0>;
	};

	pseudo_m4u-larb1 {
		compatible = "mediatek,mt-pseudo_m4u-port";
		iommus = <0x5a 0x20 0x5a 0x21>;
		mediatek,larbid = <0x1>;
	};

	pseudo_m4u-larb2 {
		compatible = "mediatek,mt-pseudo_m4u-port";
		iommus = <0x5a 0x40 0x5a 0x41>;
		mediatek,larbid = <0x2>;
	};

	pseudo_m4u-larb3 {
		compatible = "mediatek,mt-pseudo_m4u-port";
		iommus = <0x5a 0x60 0x5a 0x61>;
		mediatek,larbid = <0x3>;
	};

	pwm@11006000 {
		clock-names = "PWM1-main", "PWM2-main", "PWM3-main", "PWM4-main", "PWM5-main", "PWM6-main", "PWM-HCLK-main", "PWM-main";
		clocks = <0x27 0x10 0x27 0x11 0x27 0x12 0x27 0x13 0x27 0x14 0x27 0x30 0x27 0xf 0x27 0x15>;
		compatible = "mediatek,pwm";
		interrupts = <0x0 0x4d 0x8>;
		linux,phandle = <0x9f>;
		phandle = <0x9f>;
		reg = <0x0 0x11006000 0x0 0x10000>;
	};

	pwrap@1000d000 {
		compatible = "mediatek,pwrap";
		interrupts = <0x0 0xb3 0x4>;
		reg = <0x0 0x1000d000 0x0 0x1000>;
	};

	radio_md_cfg {
		compatible = "mediatek,radio_md_cfg";
		linux,phandle = <0xc9>;
		phandle = <0xc9>;
	};

	reserved-memory {
		#address-cells = <0x2>;
		#size-cells = <0x2>;
		linux,phandle = <0x61>;
		phandle = <0x61>;
		ranges;

		consys-reserve-memory {
			alignment = <0x0 0x1000000>;
			alloc-ranges = <0x0 0x40000000 0x0 0x80000000>;
			compatible = "mediatek,consys-reserve-memory";
			no-map;
			size = <0x0 0x400000>;
		};

		reserve-memory-scp_share {
			alignment = <0x0 0x1000000>;
			alloc-ranges = <0x0 0x40000000 0x0 0x50000000>;
			compatible = "mediatek,reserve-memory-scp_share";
			no-map;
			size = <0x0 0x300000>;
		};

		reserve-memory-sspm_share {
			alignment = <0x0 0x10000>;
			alloc-ranges = <0x0 0x40000000 0x0 0x60000000>;
			compatible = "mediatek,reserve-memory-sspm_share";
			no-map;
			size = <0x0 0x110000>;
			status = "okay";
		};

		wifi-reserve-memory {
			alignment = <0x0 0x1000000>;
			alloc-ranges = <0x0 0x40000000 0x0 0x80000000>;
			compatible = "mediatek,wifi-reserve-memory";
			no-map;
			size = <0x0 0x300000>;
		};

		zmc-default {
			alignment = <0x0 0x10000000>;
			alloc-ranges = <0x0 0xc0000000 0x1 0x80000000>;
			compatible = "mediatek,zone_movable_cma";
			size = <0x0 0x2d000000>;
		};
	};

	rt-pd-manager {
		compatible = "mediatek,rt-pd-manager";
	};

	rt9465_slave_chr {
		compatible = "richtek,rt9465";
		linux,phandle = <0xb9>;
		phandle = <0xb9>;
		status = "disabled";
	};

	scp@10500000 {
		compatible = "mediatek,scp";
		core_1 = "enable";
		interrupts = <0x0 0xc0 0x4>;
		reg = <0x0 0x10500000 0x0 0x40000 0x0 0x105c0000 0x0 0x3000 0x0 0x105c4000 0x0 0x1000 0x0 0x105d4000 0x0 0x6000>;
		scp_sramSize = <0x40000>;
		status = "okay";
	};

	scp_dvfs {
		clock-names = "clk_mux", "clk_pll_0", "clk_pll_1", "clk_pll_2", "clk_pll_3", "clk_pll_4", "clk_pll_5", "clk_pll_6";
		clocks = <0x1e 0x63 0x1f 0x1e 0xe 0x1e 0x1a 0x1e 0x2 0x1e 0x17 0x1e 0x6 0x1e 0x19>;
		compatible = "mediatek,scp_dvfs";
	};

	scpsys@10001000 {
		#clock-cells = <0x1>;
		compatible = "mediatek,scpsys", "syscon";
		linux,phandle = <0x28>;
		phandle = <0x28>;
		reg = <0x0 0x10001000 0x0 0x1000 0x0 0x10006000 0x0 0x1000 0x0 0x14002000 0x0 0x1000 0x0 0x1020e000 0x0 0x1000 0x0 0x18004000 0x0 0x1000 0x0 0x18002000 0x0 0x1000>;
	};

	security_ao@1001a000 {
		compatible = "mediatek,security_ao";
		reg = <0x0 0x1001a000 0x0 0x1000>;
	};

	seninf1@1a040000 {
		compatible = "mediatek,seninf1";
		reg = <0x0 0x1a040000 0x0 0x1000>;
	};

	seninf2@1a041000 {
		compatible = "mediatek,seninf2";
		reg = <0x0 0x1a041000 0x0 0x1000>;
	};

	seninf3@1a042000 {
		compatible = "mediatek,seninf3";
		reg = <0x0 0x1a042000 0x0 0x1000>;
	};

	seninf4@1a043000 {
		compatible = "mediatek,seninf4";
		reg = <0x0 0x1a043000 0x0 0x1000>;
	};

	serial@11020000 {
		clock-names = "baud", "bus";
		clocks = <0x1f 0x27 0x16>;
		compatible = "mediatek,mt6758-uart", "mediatek,mt6577-uart";
		dma-names = "tx", "rx";
		dmas = <0x34 0x0 0x34 0x1>;
		interrupts = <0x0 0x5b 0x8>;
		linux,phandle = <0x95>;
		phandle = <0x95>;
		reg = <0x0 0x11002000 0x0 0x1000>;
	};

	serial@11030000 {
		clock-names = "baud", "bus";
		clocks = <0x1f 0x27 0x17>;
		compatible = "mediatek,mt6758-uart", "mediatek,mt6577-uart";
		interrupts = <0x0 0x5c 0x8>;
		linux,phandle = <0x96>;
		phandle = <0x96>;
		reg = <0x0 0x11003000 0x0 0x1000>;
	};

	silead_fp {
		compatible = "mediatek,finger-fp";
		linux,phandle = <0x8d>;
		phandle = <0x8d>;
	};

	sleep@10006000 {
		compatible = "mediatek,sleep";
		interrupts = <0x0 0xb5 0x8>;
		reg = <0x0 0x10006000 0x0 0x1000>;
		wakeup-source = <0x1a 0x0 0x4 0x1b 0x1 0x20 0x1c 0x3 0x2000000>;
	};

	sleep_reg_md@1000f000 {
		compatible = "mediatek,sleep_reg_md";
		reg = <0x0 0x1000f000 0x0 0x1000>;
	};

	smart_pa {
		linux,phandle = <0xc3>;
		phandle = <0xc3>;
	};

	smi_common@14002000 {
		clock-names = "mtcmos-mm", "smi-common-gals-comm0", "smi-common-gals-comm1", "smi-common", "mmdvfs_clk_mm_sel_ck", "mmdvfs_clk_mmpll_ck", "mmdvfs_clk_univpll1_d2_ck", "mmdvfs_clk_mmpll_d2_ck";
		clocks = <0x28 0x3 0x29 0x15 0x29 0x16 0x29 0x13 0x1e 0x62 0x1e 0x21 0x1e 0x17 0x1e 0x22>;
		compatible = "mediatek,smi_common";
		larbs = <0x23 0x24 0x25 0x26>;
		mmsys_config = <0x29>;
		nr_larbs = <0x4>;
		reg = <0x0 0x14002000 0x0 0x1000>;
	};

	smi_larb0@14003000 {
		cell-index = <0x0>;
		clock-names = "mtcmos-mm", "mm-larb0";
		clocks = <0x28 0x3 0x29 0x14>;
		compatible = "mediatek,smi_larb0", "mediatek,smi_larb";
		linux,phandle = <0x23>;
		phandle = <0x23>;
		reg = <0x0 0x14003000 0x0 0x1000>;
	};

	smi_larb1@17010000 {
		cell-index = <0x1>;
		clock-names = "mtcmos-vcodec", "venc-larb1";
		clocks = <0x28 0xa 0x4d 0x1>;
		compatible = "mediatek,smi_larb1", "mediatek,smi_larb";
		linux,phandle = <0x24>;
		phandle = <0x24>;
		reg = <0x0 0x17010000 0x0 0x1000>;
	};

	smi_larb2@15021000 {
		cell-index = <0x2>;
		clock-names = "mtcmos-isp", "gals-img2mm", "img-larb2";
		clocks = <0x28 0x5 0x29 0x18 0x4b 0x0>;
		compatible = "mediatek,smi_larb2", "mediatek,smi_larb";
		linux,phandle = <0x25>;
		phandle = <0x25>;
		reg = <0x0 0x15021000 0x0 0x1000>;
	};

	smi_larb3@1a002000 {
		cell-index = <0x3>;
		clock-names = "mtcmos-cam", "gals-cam2mm", "cam-larb3";
		clocks = <0x28 0x9 0x29 0x19 0x4c 0x0>;
		compatible = "mediatek,smi_larb3", "mediatek,smi_larb";
		linux,phandle = <0x26>;
		phandle = <0x26>;
		reg = <0x0 0x1a002000 0x0 0x1000>;
	};

	spi@1100a000 {
		clock-names = "parent-clk", "sel-clk", "spi-clk";
		clocks = <0x1e 0xb 0x1e 0x6b 0x27 0x1b>;
		compatible = "mediatek,mt6765-spi";
		interrupts = <0x0 0x76 0x8>;
		linux,phandle = <0xa0>;
		mediatek,pad-select = <0x0>;
		phandle = <0xa0>;
		reg = <0x0 0x1100a000 0x0 0x1000>;
	};

	spi@11010000 {
		clock-names = "parent-clk", "sel-clk", "spi-clk";
		clocks = <0x1e 0xb 0x1e 0x6b 0x27 0x34>;
		compatible = "mediatek,mt6765-spi";
		interrupts = <0x0 0x7a 0x8>;
		linux,phandle = <0xa2>;
		mediatek,pad-select = <0x0>;
		phandle = <0xa2>;
		reg = <0x0 0x11010000 0x0 0x1000>;
	};

	spi@11012000 {
		clock-names = "parent-clk", "sel-clk", "spi-clk";
		clocks = <0x1e 0xb 0x1e 0x6b 0x27 0x37>;
		compatible = "mediatek,mt6765-spi";
		interrupts = <0x0 0x80 0x8>;
		linux,phandle = <0xa3>;
		mediatek,pad-select = <0x0>;
		phandle = <0xa3>;
		reg = <0x0 0x11012000 0x0 0x1000>;
	};

	spi@11013000 {
		clock-names = "parent-clk", "sel-clk", "spi-clk";
		clocks = <0x1e 0xb 0x1e 0x6b 0x27 0x38>;
		compatible = "mediatek,mt6765-spi";
		interrupts = <0x0 0x81 0x8>;
		linux,phandle = <0xa4>;
		mediatek,pad-select = <0x0>;
		phandle = <0xa4>;
		reg = <0x0 0x11013000 0x0 0x1000>;
	};

	spi@11014000 {
		clock-names = "parent-clk", "sel-clk", "spi-clk";
		clocks = <0x1e 0xb 0x1e 0x6b 0x27 0x41>;
		compatible = "mediatek,mt6765-spi";
		interrupts = <0x0 0x5f 0x8>;
		linux,phandle = <0xa5>;
		mediatek,pad-select = <0x0>;
		phandle = <0xa5>;
		reg = <0x0 0x11014000 0x0 0x1000>;
	};

	spi@11015000 {
		clock-names = "parent-clk", "sel-clk", "spi-clk";
		clocks = <0x1e 0xb 0x1e 0x6b 0x27 0x42>;
		compatible = "mediatek,mt6765-spi";
		interrupts = <0x0 0x60 0x8>;
		linux,phandle = <0xa6>;
		mediatek,pad-select = <0x0>;
		phandle = <0xa6>;
		reg = <0x0 0x11015000 0x0 0x1000>;
	};

	sramrom@10214000 {
		compatible = "mediatek,sramrom";
		reg = <0x0 0x10214000 0x0 0x1000>;
	};

	sspm@10440000 {
		compatible = "mediatek,sspm";
		interrupt-names = "ipc", "mbox0", "mbox1", "mbox2", "mbox3", "mbox4";
		interrupts = <0x0 0xca 0x4 0x0 0xcd 0x4 0x0 0xce 0x4 0x0 0xcf 0x4 0x0 0xd0 0x4 0x0 0xd1 0x4>;
		reg = <0x0 0x10440000 0x0 0x10000 0x0 0x10450000 0x0 0x100 0x0 0x10451000 0x0 0x8 0x0 0x10460000 0x0 0x100 0x0 0x10461000 0x0 0x8 0x0 0x10470000 0x0 0x100 0x0 0x10471000 0x0 0x8 0x0 0x10480000 0x0 0x100 0x0 0x10481000 0x0 0x8 0x0 0x10490000 0x0 0x100 0x0 0x10491000 0x0 0x8>;
		reg-names = "cfgreg", "mbox0_base", "mbox0_ctrl", "mbox1_base", "mbox1_ctrl", "mbox2_base", "mbox2_ctrl", "mbox3_base", "mbox3_ctrl", "mbox4_base", "mbox4_ctrl";
	};

	swtp {
		compatible = "mediatek, swtp-eint";
		linux,phandle = <0x88>;
		phandle = <0x88>;
	};

	sys_cirq@10204000 {
		compatible = "mediatek,sys_cirq";
		interrupts = <0x0 0x118 0x8>;
		mediatek,cirq_num = <0xd1>;
		mediatek,spi_start_offset = <0x48>;
		reg = <0x0 0x10204000 0x0 0x1000>;
	};

	sys_timer@10017000 {
		compatible = "mediatek,sys_timer";
		interrupts = <0x0 0xc2 0x4>;
		reg = <0x0 0x10017000 0x0 0x1000>;
		reg-names = "sys_timer_base";
	};

	syscfg_pctl_0@10005000 {
		compatible = "mediatek,mt6765-pctl-0-syscfg", "syscon";
		linux,phandle = <0x12>;
		phandle = <0x12>;
		reg = <0x0 0x10005000 0x0 0x1000>;
	};

	syscfg_pctl_1@0x10002000 {
		compatible = "mediatek,mt6765-pctl-1-syscfg", "syscon";
		linux,phandle = <0x13>;
		phandle = <0x13>;
		reg = <0x0 0x10002000 0x0 0x1000>;
	};

	syscfg_pctl_2@0x10002200 {
		compatible = "mediatek,mt6765-pctl-2-syscfg", "syscon";
		linux,phandle = <0x14>;
		phandle = <0x14>;
		reg = <0x0 0x10002200 0x0 0x1000>;
	};

	syscfg_pctl_3@0x10002400 {
		compatible = "mediatek,mt6765-pctl-3-syscfg", "syscon";
		linux,phandle = <0x15>;
		phandle = <0x15>;
		reg = <0x0 0x10002400 0x0 0x1000>;
	};

	syscfg_pctl_4@0x10002600 {
		compatible = "mediatek,mt6765-pctl-4-syscfg", "syscon";
		linux,phandle = <0x16>;
		phandle = <0x16>;
		reg = <0x0 0x10002600 0x0 0x1000>;
	};

	syscfg_pctl_5@0x10002800 {
		compatible = "mediatek,mt6765-pctl-5-syscfg", "syscon";
		linux,phandle = <0x17>;
		phandle = <0x17>;
		reg = <0x0 0x10002800 0x0 0x1000>;
	};

	syscfg_pctl_6@0x10002a00 {
		compatible = "mediatek,mt6765-pctl-6-syscfg", "syscon";
		linux,phandle = <0x18>;
		phandle = <0x18>;
		reg = <0x0 0x10002a00 0x0 0x1000>;
	};

	syscfg_pctl_7@0x10002c00 {
		compatible = "mediatek,mt6765-pctl-7-syscfg", "syscon";
		linux,phandle = <0x19>;
		phandle = <0x19>;
		reg = <0x0 0x10002c00 0x0 0x1000>;
	};

	therm_ctrl@1100b000 {
		clock-names = "therm-main";
		clocks = <0x27 0xa>;
		compatible = "mediatek,therm_ctrl";
		interrupts = <0x0 0x4e 0x8>;
		reg = <0x0 0x1100b000 0x0 0x1000>;
	};

	timer {
		clock-frequency = <0xc65d40>;
		compatible = "arm,armv8-timer";
		interrupt-parent = <0x11>;
		interrupts = <0x1 0xd 0x8 0x1 0xe 0x8 0x1 0xb 0x8 0x1 0xa 0x8>;
	};

	tkcore {
		compatible = "trustkernel,tkcore";
		interrupts = <0x0 0xf8 0x1>;
	};

	topckgen@10000000 {
		#clock-cells = <0x1>;
		compatible = "mediatek,topckgen", "syscon";
		linux,phandle = <0x1e>;
		phandle = <0x1e>;
		reg = <0x0 0x10000000 0x0 0x1000>;
	};

	topckgen_ao@1001b000 {
		compatible = "mediatek,topckgen_ao";
		reg = <0x0 0x1001b000 0x0 0x1000>;
	};

	topmisc@10011000 {
		compatible = "mediatek,topmisc";
		reg = <0x0 0x10011000 0x0 0x1000>;
	};

	toprgu@10007000 {
		compatible = "mediatek,mt6765-toprgu";
		interrupts = <0x0 0x8b 0x0>;
		reg = <0x0 0x10007000 0x0 0x1000>;
	};

	touch {
		compatible = "mediatek,touch";
		linux,phandle = <0x89>;
		phandle = <0x89>;
	};

	trng@1020f000 {
		compatible = "mediatek,trng";
		interrupts = <0x0 0xa1 0x8>;
		reg = <0x0 0x1020f000 0x0 0x1000>;
	};

	type_c_port0 {
		linux,phandle = <0xcd>;
		mt-tcpc,name = "type_c_port0";
		mt-tcpc,role_def = <0x4>;
		mt-tcpc,rp_level = <0x0>;
		mt-tcpc,vconn_supply = <0x1>;
		mt6370pd,intr_gpio = <0x20 0x18 0x0>;
		mt6370pd,intr_gpio_num = <0x18>;
		phandle = <0xcd>;
		tcpc-dual,supported_modes = <0x0>;

		dpm_caps {
			attemp_discover_cable;
			attemp_discover_id;
			attemp_enter_dp_mode;
			dr_check = <0x0>;
			local_dr_data;
			local_dr_power;
			local_no_suspend;
			local_usb_comm;
			local_vconn_supply;
			pr_check = <0x0>;
			pr_check_gp_source;
		};

		pd-data {
			bat,nr = <0x1>;
			pd,charging_policy = <0x21>;
			pd,country_nr = <0x0>;
			pd,id-vdo-data = <0xd10029cf 0x0 0x10000>;
			pd,id-vdo-size = <0x3>;
			pd,mfrs = "RichtekTCPC";
			pd,pid = <0x5081>;
			pd,sink-pdo-data = <0x190c8 0xc0761e3c>;
			pd,sink-pdo-size = <0x2>;
			pd,source-cap-ext = <0x171129cf 0x0 0x102 0x0 0x0 0x2000000>;
			pd,source-pdo-data = <0x19032>;
			pd,source-pdo-size = <0x1>;
			pd,vid = <0x29cf>;

			bat-info0 {
				bat,design_cap = <0xbb8>;
				bat,mfrs = "bat1";
				bat,pid = <0x1711>;
				bat,vid = <0x29cf>;
			};
		};
	};

	usb0@11200000 {
		clock-names = "usb0", "usb0_clk_top_sel", "usb0_clk_univpll3_d4";
		clocks = <0x27 0x8 0x1e 0x76 0x1e 0x20>;
		compatible = "mediatek,mt6765-usb20";
		interrupts = <0x0 0x49 0x8>;
		mode = <0x2>;
		multipoint = <0x1>;
		num_eps = <0x10>;
		reg = <0x0 0x11200000 0x0 0x10000 0x0 0x11cc0000 0x0 0x10000>;
	};

	usb1p_sif@11210000 {
		compatible = "mediatek,usb1p_sif";
		reg = <0x0 0x11210000 0x0 0x10000>;
	};

	usb_sif@11210000 {
		compatible = "mediatek,usb_sif";
		reg = <0x0 0x11210000 0x0 0x10000>;
	};

	utos {
		compatible = "microtrust,utos";
		interrupts = <0x0 0xf9 0x1 0x0 0xfa 0x1>;
	};

	utos_tester {
		compatible = "microtrust,tester-v1";
	};

	vdec@17040000 {
		compatible = "mediatek,vdec";
		interrupts = <0x0 0xe9 0x8>;
		reg = <0x0 0x17040000 0x0 0x10000>;
	};

	venc@17020000 {
		compatible = "mediatek,venc";
		interrupts = <0x0 0xe6 0x8>;
		reg = <0x0 0x17020000 0x0 0x10000>;
	};

	venc_gcon@17000000 {
		#clock-cells = <0x1>;
		clock-names = "MT_SCP_SYS_DIS", "MT_SCP_SYS_VCODEC", "MT_CG_MM_SMI_COMM0", "MT_CG_MM_SMI_COMM1", "MT_CG_MM_SMI_COMMON", "MT_CG_VDEC", "MT_CG_VENC";
		clocks = <0x28 0x3 0x28 0xa 0x29 0x15 0x29 0x16 0x29 0x13 0x4d 0x3 0x4d 0x1>;
		compatible = "mediatek,venc_gcon", "syscon";
		linux,phandle = <0x4d>;
		phandle = <0x4d>;
		reg = <0x0 0x17000000 0x0 0x10000>;
	};

	venc_jpg@17030000 {
		clock-names = "MT_CG_VENC_JPGENC";
		clocks = <0x4d 0x2>;
		compatible = "mediatek,venc_jpg";
		interrupts = <0x0 0xe8 0x8>;
		reg = <0x0 0x17030000 0x0 0x10000>;
	};

	wifi@18000000 {
		compatible = "mediatek,wifi";
		interrupts = <0x0 0x10c 0x8>;
		reg = <0x0 0x18000000 0x0 0x100000>;
	};
};
